## drivers/mtd/nand/spi/Kconfig
```kconfig
# SPDX-License-Identifier: GPL-2.0-only
menuconfig MTD_SPI_NAND
	tristate "SPI NAND device Support"
	select MTD_NAND_CORE
	depends on SPI_MASTER
	select SPI_MEM
	help
	  This is the framework for the SPI NAND device drivers.

if MTD_SPI_NAND

config MTD_SPI_NAND_MESON
        tristate "MESON SPI NAND support"
        default n
	select MTD_RESV_MESON
	select SPI_MESON_SPIFC
        depends on MTD_SPI_NAND && AMLOGIC_MODIFY
        help
          This is based on MTD_SPI_NAND, adding partition and rsv management.
          Say Y, Will register partitions according to dts and add rsv management.
          Say N, Only register one mtd device.

endif #MTD_SPI_NAND
```

## drivers/pcie_mhi/Kconfig
```kconfig
config PCIE_RM500Q
    tristate "Quectel 5G Module"
    default n
    help
      QUECTEL 5G Module with PCIe
```

## drivers/pinctrl/meson/Kconfig
```kconfig
# SPDX-License-Identifier: GPL-2.0-only

config AMLOGIC_PINCTRL_MODULE
	tristate "support pinctrl build option"
	select PINCTRL_MESON
	default y
	help
		amlogic pinctrl driver compile option
		select y for built-in
		select m for ko
		select n for disable

menuconfig PINCTRL_MESON
	bool "Amlogic SoC pinctrl drivers"
	depends on ARCH_MESON
	depends on OF
	select PINMUX
	select PINCONF
	select GENERIC_PINCONF
	select GPIOLIB
	select OF_GPIO
	select REGMAP_MMIO

if PINCTRL_MESON

config PINCTRL_MESON8
	bool "Meson 8 SoC pinctrl driver"
	depends on ARM
	select PINCTRL_MESON8_PMX
	default n

config PINCTRL_MESON8B
	bool "Meson 8b SoC pinctrl driver"
	depends on ARM
	select PINCTRL_MESON8_PMX
	default n

config PINCTRL_MESON_GXBB
	bool "Meson gxbb SoC pinctrl driver"
	depends on ARM64
	select PINCTRL_MESON8_PMX
	default n

config PINCTRL_MESON_GXL
	bool "Meson gxl SoC pinctrl driver"
	depends on ARM64
	select PINCTRL_MESON8_PMX
	default n

config PINCTRL_MESON8_PMX
	bool

config PINCTRL_MESON_AXG
	bool "Meson axg Soc pinctrl driver"
	depends on ARM64
	select PINCTRL_MESON_AXG_PMX
	default n

config PINCTRL_MESON_AXG_PMX
	bool

config PINCTRL_MESON_G12A
	bool "Meson g12a Soc pinctrl driver"
	depends on ARM64 || AMLOGIC_ARMV8_AARCH32
	select PINCTRL_MESON_AXG_PMX
	default n

config PINCTRL_MESON_A1
	bool "Meson a1 Soc pinctrl driver"
	depends on ARM64
	select PINCTRL_MESON_AXG_PMX
	default n

config PINCTRL_MESON_TM2
	bool "Meson tm2 Soc pinctrl driver"
	depends on ARM64 || AMLOGIC_ARMV8_AARCH32
	select PINCTRL_MESON_AXG_PMX
	default n

config PINCTRL_MESON_SC2
	bool "Meson sc2 Soc pinctrl driver"
	depends on ARM64 || AMLOGIC_ARMV8_AARCH32
	select PINCTRL_MESON_AXG_PMX
	default n

config PINCTRL_MESON_T5D
	bool "Meson t5d Soc pinctrl driver"
	depends on ARM64 || AMLOGIC_ARMV8_AARCH32
	select PINCTRL_MESON_AXG_PMX
	default n

config PINCTRL_MESON_T7
	bool "Meson t7 Soc pinctrl driver"
	depends on ARM64 || AMLOGIC_ARMV8_AARCH32
	select PINCTRL_MESON_AXG_PMX
	default n

config PINCTRL_MESON_S4
	bool "Meson s4 Soc pinctrl driver"
	depends on ARM64 || AMLOGIC_ARMV8_AARCH32
	select PINCTRL_MESON_AXG_PMX
	default n
endif
```

## drivers/power/Kconfig
```kconfig
source "drivers/power/avs/Kconfig"
source "drivers/power/reset/Kconfig"
source "drivers/power/supply/Kconfig"

config CHARGER_BQ25700
	tristate "TI BQ25700 battery charger driver"
	depends on I2C
	help
		Say Y to enable support for the TI BQ25700 battery charger.

config BATTERY_CW2015
	tristate "BATTERY_CW2015 Battery driver"
	depends on I2C
	help
		If you say yes here you will get support for the battery of CW2015.
		This driver can give support for CW2015 Battery Interface.
```

## drivers/staging/android/Kconfig
```kconfig
# SPDX-License-Identifier: GPL-2.0
menu "Android"

if ANDROID

config ASHMEM
	bool "Enable the Anonymous Shared Memory Subsystem"
	depends on SHMEM
	help
	  The ashmem subsystem is a new shared memory allocator, similar to
	  POSIX SHM but with different behavior and sporting a simpler
	  file-based API.

	  It is, in theory, a good memory allocator for low-memory devices,
	  because it can discard shared memory units when under memory pressure.

config ANDROID_LOGGER
        tristate "Android log driver"
        default n
        ---help---
          This adds support for system-wide logging using four log buffers.

          These are:

              1: main
              2: events
              3: radio
              4: system

          Log reading and writing is performed via normal Linux reads and
          optimized writes. This optimization avoids logging having too
          much overhead in the system.
config ANDROID_VSOC
	tristate "Android Virtual SoC support"
	depends on PCI_MSI
	help
	  This option adds support for the Virtual SoC driver needed to boot
	  a 'cuttlefish' Android image inside QEmu. The driver interacts with
	  a QEmu ivshmem device. If built as a module, it will be called vsoc.

source "drivers/staging/android/ion/Kconfig"

endif # if ANDROID

endmenu
```

## fs/exfat/Kconfig
```kconfig
config EXFAT_FS
	tristate "exFAT fs support"
	select NLS
	help
	  This adds support for the exFAT file system.
	  Your system would support exFAT format storage,
	  such as U Disk with exfat file system and so on.

	  If you need exfat just enable it.

config EXFAT_DISCARD
	bool "enable discard support"
	depends on EXFAT_FS
	default y
	help
	   blkdiscard is used to discard device sectors.
	   This is useful for solid state drivers and
	   thinly provisioned storage.The blkdiscard will
	   discard all blocks on the device.

config EXFAT_DELAYED_SYNC
	bool "enable delayed sync"
	depends on EXFAT_FS
	default n
	help
	  Add exFAT file system delayed sync support
	  This function depends on exFAT
	  The default is disabled

	  If you need the function, please enable it.

config EXFAT_KERNEL_DEBUG
	bool "enable kernel debug features via ioctl"
	depends on EXFAT_FS
	default n
	help
	  This enable exFAT kernel debug function.
	  You can debug it via ioctl.
	  This function depends on exFAT
	  The default is disabled

	  If you need the function, please enable it.

config EXFAT_DEBUG_MSG
	bool "print debug messages"
	depends on EXFAT_FS
	default n
	help
	  This enable exFAT kernel print debug messages.
	  You can print exFAT debug messages by it.
	  This function depends on exFAT
	  The default is disabled

	  If you need the function, please enable it.

config EXFAT_DEFAULT_CODEPAGE
	int "Default codepage for exFAT"
	default 437
	depends on EXFAT_FS
	help
	  This option should be set to the codepage of your exFAT filesystems.

config EXFAT_DEFAULT_IOCHARSET
	string "Default iocharset for exFAT"
	default "utf8"
	depends on EXFAT_FS
	help
	  Set this to the default input/output character set you'd like exFAT to use.
```

## kernel/Kconfig.evenless
```kconfig
# Evenless real-time co-kernel
config HAVE_ARCH_EVENLESS
	bool

menuconfig EVENLESS
	bool "Enable the Evenless core"
	depends on HAVE_ARCH_EVENLESS
	select DOVETAIL
	help

	  The Evenless core is a real-time component of the Linux
	  kernel, which exhibits very short interrupt and scheduling
	  latency, without affecting the regular kernel services.

if EVENLESS

source "kernel/evenless/Kconfig"

if WARN_CPUFREQ_GOVERNOR
comment "WARNING! CPU_FREQ governors other than 'performance'"
comment "or 'powersave' may significantly increase latency"
comment "on this platform during the frequency transitions."
endif

endif

config WARN_CPUFREQ_GOVERNOR
       def_bool n
```

## kernel/Kconfig.evl
```kconfig
# EVL real-time core
config HAVE_ARCH_EVL
	bool

menuconfig EVL
	bool "EVL real-time core"
	depends on HAVE_ARCH_EVL
	select DOVETAIL
	help

	  The EVL core is a real-time component of the Linux kernel,
	  which delivers very short and bounded response time to
	  interrupt and task events.  EVL runs asynchronously to the
	  common kernel services, on the high-priority, out-of-band
	  stage managed by the Dovetail layer.

if EVL

source "kernel/evl/Kconfig"

if WARN_CPUFREQ_GOVERNOR
comment "WARNING! CPU_FREQ governors other than 'performance'"
comment "or 'powersave' may significantly increase latency"
comment "on this platform during the frequency transitions."
endif

endif

config WARN_CPUFREQ_GOVERNOR
       def_bool n
```
