## sound/soc/aml/m8/Kconfig
```kconfig
menuconfig SND_AML_M8
	tristate "AML-SND-M8 Board"
	depends on SND_AML_M8_SOC
	select SWITCH
	select SND_SOC_PCM2BT
	select SND_SOC_DUMMY_CODEC
	select SND_SOC_AMLPMU4 if AML_PMU4
	select SND_SOC_TAS5707
	select SND_SOC_TAS5717
	select SND_SOC_TAS5731
	select SND_SOC_AMLT9015
	select SND_SOC_AMLT9015S
	select SND_SOC_TLV320AIC32X4

if SND_AML_M8

config SND_AML_SPLIT_MODE
	tristate "AIU split mode, otherwise normal mode"
	depends on SND_AML_M8_SOC
	help
		Say 'Y' to enable AIU split mode. If not, it's normal mode.

config SND_AML_SPLIT_MODE_MMAP
	tristate "AIU split mode, mmap"
	depends on SND_AML_SPLIT_MODE
	depends on SND_AML_M8_SOC
	help
		Say 'Y' or 'N' to enable/disable AIU split mmap

endif
```

## sound/soc/amlogic/Kconfig
```kconfig
#
# Amlogic SoC audio configuration
#

config AMLOGIC_SND_SOC
	tristate "Amlogic ASoC"
	default n
	help
	  Say Y or M if you want to add support for codecs attached to
	  the Amlogic Asoc interface. You will also need
	  to select the audio interfaces to support below.

config AMLOGIC_SND_SOC_AUGE
	bool "Amlogic Auge Asoc"
	depends on AMLOGIC_SND_SOC
	default y if AMLOGIC_SND_SOC=m || AMLOGIC_SND_SOC=y
	help
	  Say Y or M if you want to add support for audio arch Auge
	  to the Amlogic Asoc Interface. it is a new audio arch to
	  distinguish Meson audio arch. it is base on kernel 4.9

config AMLOGIC_SND_SOC_COMMON
	bool "Amlogic Common for ASoC"
	default y if AMLOGIC_SND_SOC=m || AMLOGIC_SND_SOC=y
	help
		Say Y or M if you want to add support for common interface attached to
		the Amlogic Asoc interface. You will also need
		to select the audio interfaces to support below.

config AMLOGIC_SND_NOTIFY
	tristate "Amlogic sound notify interface"
	default y if AMLOGIC_SND_SOC=m || AMLOGIC_SND_SOC=y
	depends on AMLOGIC_GKI
	help
		Say Y or M if you want to add support for sound
		notify interface. This config is used to remove
		cycle dependence of aml_media -> snd_soc -> aml_media
		if all drivers build to modules.
```
