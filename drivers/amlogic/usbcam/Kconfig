## drivers/amlogic/usbcam/Kconfig
```kconfig
#
# Amlogic USBCAM configuration
#
config AMLOGIC_USBCAM
	tristate "amlogic usbcam driver"
	default y
	help
                select it to support amlogic usbcam driver.
```

## drivers/amlogic/vfm/Kconfig
```kconfig
#
# VFM configuration
#

config AML_VFM
	bool "Amlogic VFM Support"
	default n
	help
	  Select to enable VFM support
```

## drivers/amlogic/vpu/Kconfig
```kconfig
comment "Amlogic VPU Drivers"

menu "Amlogic VPU Driver"

config AML_VPU
	boolean "Amlogic VPU driver"
	default n
	help
		"Amlogic VPU module Managment"

config AML_VPU_DYNAMIC_ADJ
	boolean "Amlogic VPU Frequency Dynamic Adjust"
	default n
	depends on AML_VPU
	help
		"Amlogic VPU frequency dynamic adjust"

endmenu
```

## drivers/amlogic/watchdog/Kconfig
```kconfig
#
# watchdog configuration
#


menuconfig AML_WDT
	boolean "Amlogic Watchdog driver"
	select WATCHDOG
	select WATCHDOG_CORE
	default n
	help
	  say y to enable Amlogic watchdog driver.

if	AML_WDT
config GX_WDT
	tristate "Amlogic Meson GXBB SoCs watchdog support"
	default n
	help
	  Say Y here to include support for the watchdog timer
	  in Amlogic Meson GXBB SoCs.
	  To compile this driver as a module, choose M here: the
	  module will be called meson_gxbb_wdt.
endif
```

## drivers/amlogic/watchpoint/Kconfig
```kconfig
config	AMLOGIC_WATCHPOINT
	tristate "Amlogic point driver"
	depends on HAVE_HW_BREAKPOINT
	default y
	help
	  say y to enable Amlogic watch point driver
```

## drivers/amlogic/wifi/Kconfig
```kconfig
menuconfig AMLOGIC_WIFI
	tristate "WiFi support"
	select WIRELESS_EXT
	select WEXT_PRIV
	default n
	help
		select y to support wifi

if AMLOGIC_WIFI

config AMLOGIC_PWM_32K
	bool "amlogic soc pwm 32k support"
	depends on PWM_MESON
	default y
	help
		WiFi usually needs a 32K frequency clock signal.
		There are three possibilities:
		using the internal 32K clock or using the 32K input from our SOC,
		or using the onboard active 32K crystal oscillator.
		By default,32K of SOC input is enabled,
		if not, you can disable it by selecting n.


config WIFI_POWER_INIT_OFF
	bool "wifi power init off"
	default n
	help
		Different OS has some different scenarios. Default wifi power is reset
		and on for android, but other system like yoctos might not fit this
		strategy. We add a macro CONFIG_YOCTO_WIFI so WIFI can be inited power off
		to handle dirrerent scenarios.
endif
```

## drivers/amlogic/yk_power/Kconfig
```kconfig
menuconfig AMLOGIC_YK618
	bool "YK Power drivers"
	depends on I2C
	depends on OF
	select MFD_CORE
	select REGMAP_I2C
	default y
	---help---
	  This option allows you to select YK power driver

if AMLOGIC_YK618

choice
	prompt "YK PMU type"
	default YK618

config YK618
	bool "YK618 driver"
	---help---
	  YK618 driver

endchoice

config YK_DEBUG
	bool "YK debug interface"
	default n

config KP_OUTPUTINIT
	bool "YK output init"
	default n

config YK_CHARGEINIT
	bool "YK initial charging environment set"
	default y

config YK_CHGCHANGE
	bool "YK charging current set when suspend\resume\shutdown"
	default y

endif # !YK618
```

## drivers/evenless/Kconfig
```kconfig
menu "Out-of-band device drivers"

config EVL_LATMUS
	bool "Latency calibration and measurement"
	depends on EVL
	default y

config EVL_HECTIC
	bool "OOB context switching validator"
	depends on EVL
	default y

endmenu
```

## drivers/evl/Kconfig
```kconfig
menu "Out-of-band device drivers"

config EVL_LATMUS
	bool "Timer latency calibration and measurement"
	depends on EVL
	default y
	help
	  This driver supports the latmus application for
	  determining the best gravity values for the EVL core
	  clock, and measuring the response time to timer events.
	  If in doubt, say 'Y'.

config EVL_HECTIC
	bool "OOB context switching validator"
	depends on EVL
	default y
	help
	  This driver provides kernel support mainly to the
	  hectic application, which validates the out-of-band
	  context switching machinery. It is also required
	  for running some tests from the EVL test suite.
	  If in doubt, say 'Y'.

endmenu
```

## drivers/firmware/meson/Kconfig
```kconfig
# SPDX-License-Identifier: GPL-2.0-only
#
# Amlogic Secure Monitor driver
#
config MESON_SM
	tristate "Meson secure monitor"
	default n
	help
	  Say y here to enable the Amlogic secure monitor driver
```

## drivers/gpu/arm/utgard/r5p1/Kconfig
```kconfig
menu "Mali GPU OpenGL device driver"
config MALI400
	tristate "Mali-300/400/450 support"
	depends on ARM || ARM64
	default m
	select DMA_SHARED_BUFFER
	---help---
	  This enables support for the ARM Mali-300, Mali-400, and Mali-450
	  GPUs.

	  To compile this driver as a module, choose M here: the module will be
	  called mali.

config MALI400_DEBUG
	bool "Enable debug in Mali driver"
	depends on MALI400
	default n
	---help---
	  This enabled extra debug checks and messages in the Mali driver.

config MALI400_PROFILING_EXTRA_SUPPORT
	bool "Select other items in kernel to support PROFILING."
	depends on MALI400_PROFILING
	select PROFILING
	select FTRACE
	select PERF_EVENTS
	select ENABLE_DEFAULT_TRACERS
	select DEBUG_MUTEXES
	select HIGH_RES_TIMERS
	select HW_PERF_EVENTS
	select CPU_FREQ
	select MALI400_DEBUG

config MALI400_PROFILING
	bool "Enable Mali profiling"
	depends on MALI400
	select TRACEPOINTS
	default n
	---help---
	  This enables gator profiling of Mali GPU events.

config MALI400_INTERNAL_PROFILING
	bool "Enable internal Mali profiling API"
	depends on MALI400_PROFILING
	default n
	---help---
	  This enables the internal legacy Mali profiling API.

config MALI400_UMP
	bool "Enable UMP support"
	depends on MALI400
	---help---
	  This enables support for the UMP memory sharing API in the Mali driver.

config MALI_DVFS
	bool "Enable Mali dynamically frequency change"
	depends on MALI400
	default n
	---help---
	  This enables support for dynamic change frequency of Mali with the goal of lowering power consumption.

config MALI_DMA_BUF_MAP_ON_ATTACH
	bool "Map dma-buf attachments on attach"
	depends on MALI400 && DMA_SHARED_BUFFER
	default y
	---help---
	  This makes the Mali driver map dma-buf attachments after doing
	  attach. If this is not set the dma-buf attachments will be mapped for
	  every time the GPU need to access the buffer.

	  Mapping for each access can cause lower performance.

config MALI_SHARED_INTERRUPTS
	bool "Support for shared interrupts"
	depends on MALI400
	default n
	---help---
	  Adds functionality required to properly support shared interrupts.  Without this support,
	  the device driver will fail during insmod if it detects shared interrupts.  This also
	  works when the GPU is not using shared interrupts, but might have a slight performance
	  impact.

if ARCH_MESON6
config	MESON6_GPU_EXTRA
	bool "M6 fix"
	depends on MALI400
	default y
	select MALI_SHARED_INTERRUPTS
endif

config MALI_PMU_PARALLEL_POWER_UP
	bool "Power up Mali PMU domains in parallel"
	depends on MALI400
	default n
	---help---
	  This makes the Mali driver power up all PMU power domains in parallel, instead of
	  powering up domains one by one, with a slight delay in between. Powering on all power
	  domains at the same time may cause peak currents higher than what some systems can handle.
	  These systems must not enable this option.

config MALI_DT
	bool "Using device tree to initialize module"
	depends on MALI400 && OF
	default n
	---help---
	  This enable the Mali driver to choose the device tree path to get platform resoures
	  and disable the old config method. Mali driver could run on the platform which the
	  device tree is enabled in kernel and corresponding hardware description is implemented
	  properly in device DTS file.

config MALI_QUIET
	bool "Make Mali driver very quiet"
	depends on MALI400 && !MALI400_DEBUG
	default n
	---help---
	  This forces the Mali driver to never print any messages.

	  If unsure, say N.
endmenu
```

## drivers/gpu/drm/rockchip/ebc-dev/Kconfig
```kconfig
# SPDX-License-Identifier: GPL-2.0

menuconfig ROCKCHIP_EBC_DEV
	bool "Rockchip eBook Device Driver"
	help
	Rockchip eBook Device Dirver could help to driver the electronic ink screen.

config EPD_TPS65185_SENSOR
    bool "eink pmic Tps65185"
    depends on ROCKCHIP_EBC_DEV
    default y

config EPD_SY7636A_PMIC
	bool "EINK PMIC SY7636A Support"
	depends on ROCKCHIP_EBC_DEV
	default y
	help
	  If you say yes here you get support for the Silergy SY7636A PMIC.
```

## drivers/input/sensors/Kconfig
```kconfig
# SPDX-License-Identifier: GPL-2.0
#
# all sensors drivers configuration
#

comment "handle all sensors"

menuconfig SENSOR_DEVICE
	tristate "handle accel"
	default n

if SENSOR_DEVICE
source "drivers/input/sensors/accel/Kconfig"

endif
```

## drivers/input/sensors/accel/Kconfig
```kconfig
# SPDX-License-Identifier: GPL-2.0
#
# gsensor drivers configuration
#

menuconfig GSENSOR_DEVICE
	tristate "g_sensor device support"
	default y
	help
	  Enable this to be able to choose the drivers for controlling the
	  g_sensor on some platforms, for example on PDAs.

if GSENSOR_DEVICE
config GS_KXTJ3
	bool "gsensor kxtj3"
	default y
	help
	  To have support for your specific gsesnor you will have to
	  select the proper drivers which depend on this option.

endif
```

## drivers/input/touchscreen/chipone_tddi/Kconfig
```kconfig
# SPDX-License-Identifier: GPL-2.0-or-later
#
# chipone Touchscreen driver configuration
#

config TOUCHSCREEN_CHIPONE_9551R
    tristate "chipone Touchscreen"
    depends on I2C
    default n
    help
      Say Y here if you have chipone touch panel.
      If unsure, say N.
```

## drivers/input/touchscreen/focaltech_touch/Kconfig
```kconfig
#
# Focaltech Touchscreen driver configuration
#

config TOUCHSCREEN_FTS_3427
	bool "Focaltech Touchscreen FT3427"
	depends on I2C
	default n
	help
		Say Y here if you have Focaltech 3427 IC.
		If unsure, say N.

config TOUCHSCREEN_FTS_5726
	bool "Focaltech Touchscreen FT5726"
	depends on I2C
	default n
	help
		Say Y here if you have FocalTech 5726 IC.
		If unsure, say N.

if TOUCHSCREEN_FTS_5726

config TOUCHSCREEN_FTS_5726_P1
	bool "Focaltech Touchscreen FT5726 for P1 Build Only"
	depends on I2C
	default n
	help
		Say Y here if you have FocalTech 5726 IC for P1 build.
		If unsure, say N.

config TOUCHSCREEN_FTS_5726_MP_POR
	bool "Focaltech Touchscreen FT5726 for EVT Build Onwards"
	depends on I2C
	default n
	help
		Say Y here if you have FocalTech 5726 IC with the POR
		touch configuration and HW. This should only be used
		for devices from the EVT build onwards.
		If unsure, say N.

config TOUCHSCREEN_FTS_5726_UPDATE_TOPTOUCH_FW
	bool "Focaltech Touchscreen Update TopTouch FW"
	depends on I2C
	default n
	help
		Say Y here if you have FocalTech 5726 IC,
		and want to update FW for a TopTouch panel.
		If unsure, say N.

config TOUCHSCREEN_FTS_5726_UPDATE_TOPGROUP_FW
	bool "Focaltech Touchscreen Update TopGroup FW"
	depends on I2C
	default n
	help
		Say Y here if you have FocalTech 5726 IC,
		and want to update FW for a TopGroup panel.
		If unsure, say N.

config TOUCHSCREEN_FTS_5726_UPDATE_LENSONE_FW
	bool "Focaltech Touchscreen Update Lensone FW"
	depends on I2C
	default n
	help
		Say Y here if you have FocalTech 5726 IC,
		and want to update FW for a Lensone panel.
		If unsure, say N.

endif # TOUCHSCREEN_FTS_5726

config TOUCHSCREEN_FTS_DIRECTORY
	string "Focaltech Touchscreen Directory"
	default "focaltech_touch"
	depends on TOUCHSCREEN_FTS_3427 || TOUCHSCREEN_FTS_5726
```

## drivers/media/i2c/maxim/remote/Kconfig
```kconfig
# SPDX-License-Identifier: GPL-2.0-only
#
# Maxim GMSL serializer devices
#

menu "Maxim GMSL Remote Serializer devices support"
	visible if VIDEO_MAXIM_SERDES

config VIDEO_MAXIM_SER_MAX9295
	tristate "Maxim GMSL2 serializer max9295 support"
	depends on VIDEO_MAXIM_SERDES
	help
	  This driver supports the Maxim GMSL2 max9295 serializer.

	  To compile this driver as a module, choose M here: the
	  module will be called max9295.

config VIDEO_MAXIM_SER_MAX96715
	tristate "Maxim GMSL1 Serializer max96715 support"
	depends on VIDEO_MAXIM_SERDES
	help
	  This driver supports the Maxim GMSL1 max96715 serializer.

	  To compile this driver as a module, choose M here: the
	  module will be called max96715.

config VIDEO_MAXIM_SER_MAX96717
	tristate "Maxim GMSL2 Serializer max96717 support"
	depends on VIDEO_MAXIM_SERDES
	help
	  This driver supports the Maxim GMSL2 max96717 serializer.

	  To compile this driver as a module, choose M here: the
	  module will be called max96717.

endmenu
```

## drivers/media/i2c/rkserdes/Kconfig
```kconfig
# SPDX-License-Identifier: GPL-2.0-only
#
# Rockchip Camera SerDes devices
#
config VIDEO_RKSERDES
	tristate "Rockchip Camera SerDes Support"
	depends on I2C && VIDEO_DEV
	depends on MEDIA_CAMERA_SUPPORT
	select MEDIA_CONTROLLER
	select VIDEO_V4L2_SUBDEV_API
	select V4L2_FWNODE
	help
	  This driver supports the Rockchip Camera SerDes.

	  To compile this driver as a module, choose M here: the
	  module will be called rkserdes.

source "drivers/media/i2c/rkserdes/local/Kconfig"
source "drivers/media/i2c/rkserdes/remote/Kconfig"
```

## drivers/media/i2c/rkserdes/local/Kconfig
```kconfig
# SPDX-License-Identifier: GPL-2.0-only
#
# Rockchip Local Deserializer devices
#
menu "Rockchip Local Deserializer devices support"
	visible if VIDEO_RKSERDES

source "drivers/media/i2c/rkserdes/local/rkx12x/Kconfig"

endmenu
```

## drivers/media/i2c/rkserdes/local/rkx12x/Kconfig
```kconfig
# SPDX-License-Identifier: GPL-2.0-only
#
# Rockchip Local Deserializer devices
#
config VIDEO_RK_DES_RKX12X
	tristate "Rockchip deserializer rkx12x support"
	depends on VIDEO_RKSERDES
	help
	  This driver supports the rkx12x deserializer.

	  To compile this driver as a module, choose M here: the
	  module will be called rkx12x.
```

## drivers/media/i2c/rkserdes/remote/Kconfig
```kconfig
# SPDX-License-Identifier: GPL-2.0-only
#
# Rockchip Remote Serializer and Sensor devices
#
menu "Rockchip Remote Serializer devices support"
	visible if VIDEO_RKSERDES

source "drivers/media/i2c/rkserdes/remote/rkx11x/Kconfig"

endmenu

menu "Rockchip Remote Sensor devices support"
	visible if VIDEO_RKSERDES

config VIDEO_RK_CAM_DUMMY
	tristate "Rockchip remote dummy sensor support"
	depends on VIDEO_RKSERDES
	help
	  This driver supports the dummy sensor.

	  To compile this driver as a module, choose M here: the
	  module will be called dummy.

config VIDEO_RK_CAM_AR0330
	tristate "Rockchip remote ar0330 sensor support"
	depends on VIDEO_RKSERDES
	help
	  This driver supports the ar0330 sensor.

	  To compile this driver as a module, choose M here: the
	  module will be called ar0330.

config VIDEO_RK_CAM_OS04A10
	tristate "Rockchip remote os04a10 sensor support"
	depends on VIDEO_RKSERDES
	help
	  This driver supports the os04a10 sensor.

	  To compile this driver as a module, choose M here: the
	  module will be called os04a10.

config VIDEO_RK_CAM_GC2145
	tristate "Rockchip remote gc2145 sensor support"
	depends on VIDEO_RKSERDES
	help
	  This driver supports the gc2145 sensor.

	  To compile this driver as a module, choose M here: the
	  module will be called gc2145.

endmenu
```

## drivers/media/i2c/rkserdes/remote/rkx11x/Kconfig
```kconfig
# SPDX-License-Identifier: GPL-2.0-only
#
# Rockchip Remote Serializer devices
#
config VIDEO_RK_SER_RKX11X
	tristate "Rockchip remote serializer rkx11x support"
	depends on VIDEO_RKSERDES
	help
	  This driver supports the rkx11x serializer.

	  To compile this driver as a module, choose M here: the
	  module will be called rkx11x.
```

## drivers/media/platform/rockchip/vpss/Kconfig
```kconfig
# SPDX-License-Identifier: GPL-2.0
config VIDEO_ROCKCHIP_VPSS
	tristate "Rockchip Video Processing Sub System driver"
	depends on V4L_PLATFORM_DRIVERS
	depends on VIDEO_DEV
	depends on ARCH_ROCKCHIP || COMPILE_TEST
	depends on CPU_RK3576
	select VIDEO_V4L2_SUBDEV_API
	select VIDEOBUF2_CMA_SG
	default n
	help
	  Support for VPSS on the rockchip SoC.
```
