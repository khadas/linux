## drivers/amlogic/ddr_tool/Kconfig
```kconfig
config AMLOGIC_DDR_TOOL
	tristate "Meson cpu ddr tool"
	depends on AMLOGIC_DRIVER
	default n
	help
		This config add some debug tools for DDR, including test ddr
		bandwidth, ddr window and other configs.
		For more information.
		Please see folllowing configs

config AMLOGIC_DDR_BANDWIDTH
	bool "Meson ddr bandwidth"
	default n
	depends on AMLOGIC_DDR_TOOL
	help
		This config enables ddr bandwidth measure.
		If open it, this driver will export interface
		to get ddr total bandwidth, it can be used for
		ddr DVFS/devfreq system.

config AMLOGIC_DDR_BANDWIDTH_GXL
	bool "Meson ddr bandwidth for GXL"
	default n
	depends on AMLOGIC_DDR_BANDWIDTH
	help
		This config enables ddr bandwidth measure for GXL.
		If open it, this driver will export interface
		to get ddr total bandwidth, it can be used for
		ddr DVFS/devfreq system.

config AMLOGIC_DDR_BANDWIDTH_GX
	bool "Meson ddr bandwidth for GX"
	default n
	depends on AMLOGIC_DDR_BANDWIDTH
	help
		This config enables ddr bandwidth measure for GX.
		If open it, this driver will export interface
		to get ddr total bandwidth, it can be used for
		ddr DVFS/devfreq system.

config AMLOGIC_DDR_BANDWIDTH_G12
	bool "Meson ddr bandwidth for G12"
	default n
	depends on AMLOGIC_DDR_BANDWIDTH
	help
		This config enables ddr bandwidth measure for G12.
		If open it, this driver will export interface
		to get ddr total bandwidth, it can be used for
		ddr DVFS/devfreq system.

config AMLOGIC_DDR_BANDWIDTH_T7
	bool "Meson ddr bandwidth for T7"
	default n
	depends on AMLOGIC_DDR_BANDWIDTH
	help
		This config enables ddr bandwidth measure for T7.
		If open it, this driver will export interface
		to get ddr total bandwidth, it can be used for
		ddr DVFS/devfreq system.

config AMLOGIC_DDR_BANDWIDTH_A1
	bool "Meson ddr bandwidth for A1"
	default n
	depends on AMLOGIC_DDR_BANDWIDTH
	help
		This config enables ddr bandwidth measure for A1.
		If open it, this driver will export interface
		to get ddr total bandwidth, it can be used for
		ddr DVFS/devfreq system.

config AMLOGIC_DDR_BANDWIDTH_T5
	bool "Meson ddr bandwidth for T5"
	default n
	depends on AMLOGIC_DDR_BANDWIDTH
	help
		This config enables ddr bandwidth measure for T5.
		If open it, this driver will export interface
		to get ddr total bandwidth, it can be used for
		ddr DVFS/devfreq system.

config AMLOGIC_DDR_BANDWIDTH_S4
        bool "Meson ddr bandwidth for S4"
        default n
        depends on AMLOGIC_DDR_BANDWIDTH
        help
                This config enables ddr bandwidth measure for S4.
                If open it, this driver will export interface
                to get ddr total bandwidth, it can be used for
                ddr DVFS/devfreq system.

config AMLOGIC_DMC_MONITOR
	bool "Amlogic dmc monitor"
	depends on AMLOGIC_DDR_TOOL
	default n
	help
		DMC monitor for hardware connected to DMC master. Using it can
		set up an address range and assign R/W permission for each
		hardware. If hardware violated R/W permission, then interrupt
		will generated and can help to debug memory pollution.

config AMLOGIC_DMC_MONITOR_G12
	bool "Amlogic dmc monitor for G12"
	depends on AMLOGIC_DMC_MONITOR
	default n
	help
		This config enables dmc monitor for g12 chip
		DMC monitor for hardware connected to DMC master. Using it can
		set up an address range and assign R/W permission for each
		hardware. If hardware violated R/W permission, then interrupt
		will generated and can help to debug memory pollution.

config AMLOGIC_DMC_MONITOR_TM2
	bool "Amlogic dmc monitor for TM2 revb"
	depends on AMLOGIC_DMC_MONITOR
	default n
	help
		This config enables dmc monitor for tm2 chip
		DMC monitor for hardware connected to DMC master. Using it can
		set up an address range and assign R/W permission for each
		hardware. If hardware violated R/W permission, then interrupt
		will generated and can help to debug memory pollution.

config AMLOGIC_DMC_MONITOR_GX
	bool "Amlogic dmc monitor for GX"
	depends on AMLOGIC_DMC_MONITOR
	default n
	help
		This config enables dmc monitor for gx chip
		DMC monitor for hardware connected to DMC master. Using it can
		set up an address range and assign R/W permission for each
		hardware. If hardware violated R/W permission, then interrupt
		will generated and can help to debug memory pollution.

config AMLOGIC_DMC_MONITOR_C1
	bool "Amlogic dmc monitor for C1"
	depends on AMLOGIC_DMC_MONITOR
	default n
	help
		This config enables dmc monitor for c1 chip
		DMC monitor for hardware connected to DMC master. Using it can
		set up an address range and assign R/W permission for each
		hardware. If hardware violated R/W permission, then interrupt
		will generated and can help to debug memory pollution.

config AMLOGIC_DMC_MONITOR_T7
	bool "Amlogic dmc monitor for T7"
	depends on AMLOGIC_DMC_MONITOR
	default n
	help
		This config enables dmc monitor for t7 chip
		DMC monitor for hardware connected to DMC master. Using it can
		set up an address range and assign R/W permission for each
		hardware. If hardware violated R/W permission, then interrupt
		will generated and can help to debug memory pollution.

config AMLOGIC_DMC_MONITOR_S4
        bool "Amlogic dmc monitor for S4"
        depends on AMLOGIC_DMC_MONITOR
        default n
        help
                This config enables dmc monitor for s4 chip
                DMC monitor for hardware connected to DMC master. Using it can
                set up an address range and assign R/W permission for each
                hardware. If hardware violated R/W permission, then interrupt
                will generated and can help to debug memory pollution.
```

## drivers/amlogic/debug/Kconfig
```kconfig
menuconfig AMLOGIC_DEBUG
	bool "AMLOGIC kernel debug"
	default n
	help
		This option is set up for Amlogic kernel debug,
		Modifying the source code, we will use the AMLOGIC_
		prefix.If you want to add debug code to the kernel,please
		use this option switch it.

config AMLOGIC_DEBUG_LOCKUP
	bool "Amlogic Kernel Lockup debug"
	depends on AMLOGIC_DEBUG
	depends on HARDLOCKUP_DETECTOR
	default n
	help
		Debug lockup in isr and deadlock whit irq disabled.
		When enable this config, Watchdog should be disabled.

config AMLOGIC_DEBUG_ATRACE
	bool "Amlogic Kernel ATrace"
	depends on AMLOGIC_DEBUG
	depends on TRACING
	default y
	help
		Add android atrace compatible function.
		Support Tags

config AMLOGIC_BOOT_TIME
	bool "AMLOGIC boot time optimization"
	default n
	help
	  This option is set up for Amlogic boot time optimization,
	  if you want to optimize boot time, please set this config to y.

config AMLOGIC_DEBUG_FTRACE_PSTORE
	bool "Amlogic ftrace pstore debug"
	depends on AMLOGIC_DEBUG
	depends on PSTORE_FTRACE
	default y
	help
		Dump function call and register access to ramoops after watchdog
		reboot.
		Enable if doubt

config AMLOGIC_DEBUG_SCRAMBLER_RAMOOPS
	bool "Amlogic ddr scrambler keypreserve mode for pstore debug"
	depends on AMLOGIC_DEBUG
	depends on PSTORE
	default n
	help
		Preserve ddr scrambler key to dump kernel console message and panic/oops
		message.
```
