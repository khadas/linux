## drivers/amlogic/aml_tee/Kconfig
```kconfig
# SPDX-License-Identifier: GPL-2.0-only
# Generic Trusted Execution Environment Configuration
config AML_TEE
	tristate "Trusted Execution Environment support"
	depends on HAVE_ARM_SMCCC || COMPILE_TEST || CPU_SUP_AMD
	select CRYPTO
	select CRYPTO_SHA1
	select DMA_SHARED_BUFFER
	select GENERIC_ALLOCATOR
	help
	  This implements a generic interface towards a Trusted Execution
	  Environment (TEE).

if AML_TEE

menu "TEE drivers"

source "drivers/amlogic/aml_tee/optee/Kconfig"
endmenu

endif
```

## drivers/amlogic/amlisp/Kconfig
```kconfig
menu "Amlogic AML ISP Support"

config AMLOGIC_AML_ISP
	tristate "amlogic AML ISP module"
	default m
	help
	  Driver for AML ISP.

endmenu
```

## drivers/amlogic/amlkaraoke/Kconfig
```kconfig
# AML Karaoke control drivers

menuconfig AMLKARAOKE
        bool "Amlogic karaoke Interface V1"
        default y
        help
                Amlogic karaoke Interface V1, usb capture audio data, mix with i2s out directly.
		---
		---

if	AMLKARAOKE

config AMLOGIC_SND_USB_CAPTURE_DATA
	tristate "USB Capture Audio Data In, for aml karaoke"
	depends on AMLOGIC_SND_SOC_MESON
	help
		capture usb audio data into a ring buffer. The ring buffer data would be mixed with i2s out data.
		Say 'Y' for aml karaoker driver.


endif
```

## drivers/amlogic/amlnf/Kconfig
```kconfig
#
# Amlogic NAND device configuration
#

menuconfig AML_NAND
	bool "Meson NAND Device Support(For NEXT GEN NAND DRIV)"
	default n
	help
	  Amlogic nand drvier support.
	  when it is Y here, we use aml nand driver, need choice below;
	  when it is n here, need not other choice,we do not use aml nand
	  driver.

if	AML_NAND

config AML_NEXT_GEN_NAND
	bool "Meson NAND flash device(Next gen driver)"
	default n
	help
	  Support for NAND flash
	  on Amlogic Meson
	  platforms for Next gen driver
	  here

config AML_NFTL_NEW
	tristate "Meson NAND flash new nftl"
	default m
	help
	  Support for NAND flash
	  on Amlogic Meson platforms
	  for Next nftl
	  here

config AML_NAND_KEY
	bool "Meson key data store in nand device(dev/nand_key) support"
	depends on AML_NEXT_GEN_NAND
	default n
	help
	  Support key variable store in NAND device
	  if say Y here , select
	  if say N here , do not select
	  ---

config SECURE_NAND
	bool "Meson secure data store in nand device support"
	depends on AML_NEXT_GEN_NAND
	default n
	help
	  Support secure storage in NAND device
	  ---
	  ---
	  ---
endif
```

## drivers/amlogic/amports/Kconfig
```kconfig
#
# Amlogic streaming device configuration
#
config  AM_PTSSERVER
	boolean
	default n

config  H264_4K2K_SINGLE_CORE
	boolean
	default n


config  VSYNC_RDMA
	boolean "VSYNC CBUS RDMA"
	default n
	select AML_RDMA
	---help---
	  Select to enable VSYNC CBUS RDMA.

config TVIN_VIUIN
	boolean "Amlogic TVIN VIUIN device"
	default n
	---help---
	  VIUIN device driver.

config AM_VIDEO
	boolean "Video management"
	default n
	select AML_CODEC_MM
	select AM_CANVAS
	select AM_PTSMGR
	select AM_TIMESYNC
	select AM_PTSSERVER
	---help---
	  Driver for video display.

config AM_VIDEO2
	boolean "Video2 management"
	default n
	select AM_VIDEO
	---help---
	  Driver for video2 display.

config SUPPORT_VIDEO_ON_VPP2
	boolean "Support video on vpp2"
	default n
	depends on !AM_VIDEO2
	---help---
	  Support displaying video on vpp2

config GE2D_KEEP_FRAME
	boolean "Amlogic Video protect video streambuf framebuf"
	default n
	depends on  AM_VIDEO
	---help---
		Select to enable protect video streambuf framebuf.

menu "Video Decoders"
	depends on AM_VIDEO

config AM_VDEC_MPEG12
	tristate "Amlogic MPEG1/2 Video Decoder"
	default y
	select AM_PTSSERVER
	---help---
	   Driver for mpeg1/2 video decoder.
	   select AM_PTSSERVER...
	   select for build for support mpeg1 &2
	   ...

config AM_VDEC_MPEG4
	tristate "Amlogic MPEG4 Video Decoder"
	default y
	select AM_PTSSERVER
	---help---
	  Driver for mpeg4 video decoder.
	  need write more details...
	  write need more.....
	  need more...
	  more...

config AM_VDEC_MMPEG4
	tristate "Amlogic MMPEG4 Video Decoder"
	default n
	---help---
	  Driver for Mmpeg4 video decoder.
	  need write more details...
	  write need more.....
	  need more...
	  more...

config AM_VDEC_VC1
	tristate "Amlogic VC1 Video Decoder"
	default y
	select AM_PTSSERVER
	---help---
	  Driver for vc1 video decoder.
	  need write more details...
	  write need more.....
	  need more...
	  more...

config AM_VDEC_H264
	tristate "Amlogic H264 Video Decoder"
	default y
	select AM_PTSSERVER
	---help---
	  Driver for h264 video decoder.
	  need write more details...
	  write need more.....
	  need more...
	  more...

config AM_VDEC_MH264
	tristate "Amlogic MH264 Video Decoder"
	default n
	select AM_PTSSERVER
	---help---
	  Driver for Mh264 video decoder.
	  need write more details...
	  write need more.....
	  need more...
	  more...

config AM_VDEC_H264MVC
	tristate "Amlogic H264MVC Video Decoder"
	default y
	select AM_PTSSERVER
	---help---
	  Driver for h264mvc video decoder.
	  need write more details...
	  write need more.....
	  need more...
	  more...

config AM_VDEC_H264_4K2K
        tristate "Amlogic H264_4K2K Video Decoder"
        default y

        select AM_PTSSERVER
        ---help---
          Driver for h264 4Kx2K video decoder.
	  need write more details...
	  write need more.....
	  need more...
	  more...

config AM_VDEC_H265
        tristate "Amlogic H265 Video Decoder"
        default y

        select AM_PTSSERVER
        ---help---
          Driver for h265 video decoder.
	  need write more details...
	  write need more.....
	  need more...
	  more...

config AM_VDEC_VP9
        tristate "Amlogic VP9 Video Decoder"
        default y

        select AM_PTSSERVER
        ---help---
          Driver for vp9 video decoder.
	  need write more details...
	  write need more.....
	  need more...
	  more...

config AM_VDEC_MJPEG
	tristate "Amlogic Motion JPEG Video Decoder"
	default y

	select AM_PTSSERVER
	---help---
	  Driver for motion jpeg video decoder.
	  need write more details...
	  write need more.....
	  need more...
	  more...

config AM_ENCODER
	tristate "Amlogic AVC encoder"
	default n

	---help---
	  Driver for avc encoder.
	  need write more details...
	  write need more.....
	  need more...
	  more...

config AM_JPEG_ENCODER
	tristate "Amlogic jpeg encoder"
	default n

	---help---
	  Driver for jpeg encoder.
	  need write more details...
	  write need more.....
	  need more...
	  more...

config AM_PIC_DEC
	tristate "Amlogic picture decoder"
	default n

	select AM_PTSSERVER
	---help---
	  Driver for picture decoder.
	  need write more details...
	  write need more.....
	  need more...
	  more...

config AM_VDEC_REAL
	tristate "Amlogic Real Video Decoder"
	default y

	select AM_PTSSERVER
	---help---
	  Driver for real video decoder.
	  need write more details...
	  write need more.....
	  need more...
	  more...

config AM_VDEC_AVS
	tristate "Amlogic AVS Video Decoder"
    default y

	select AM_PTSSERVER
	---help---
	  Driver for avs video decoder.
	  need write more details...
	  write need more.....
	  need more...
	  more...

config AM_JPEGDEC
	tristate "Amlogic HW jpeg decoder"
	default n

	select AM_PTSSERVER
	---help---
	  Select to enable HW jpeg decoder.
	  need write more details...
	  write need more.....
	  need more...

config AM_TIMESYNC
	boolean "Amlogic Time sync driver"
	default y
	---help---
	  AV sync and play rate control management.

config AM_STREAMING
	boolean "Amlogic AV Streaming support"
	default y
	select AM_PTSSERVER
	---help---
	  Driver for the AV streaming ports.

config AM_SUBTITLE
	boolean "Amlogic SubTitle support"
	default n
	---help---
	  Internal Sub Title support driver

config AM_VIDEOCAPTURE
	boolean "Amlogic Video Capture support"
	default n
	---help---
		Internal Video Capture driver

config AM_HEVCENC
	boolean "Amlogic Hevc Encoder support"
	default n
	---help---
		Internal Hevc Encoder driver
endmenu
```

## drivers/amlogic/amvecm/Kconfig
```kconfig
#
# AMLOGIC amvecm devices configuration
#

comment "Amlogic VECM Drivers"

menu "Amlogic amvecm Driver"

config AM_VECM
        boolean "Amlogic amvecm driver"
        default n
        help
                "Amlogic amvecm module init"

endmenu
```

## drivers/amlogic/asr/Kconfig
```kconfig
config VAD_WAKEUP_ASR
	bool "Automatic Speech Recognition for voice wakeup"
	default n
```

## drivers/amlogic/audinfo_kernel/Kconfig
```kconfig
config AUDIO_DATA
	tristate "audio data debug Driver"
	default n
	help
	This is audio data debug Driver.
```

## drivers/amlogic/audiobridge/Kconfig
```kconfig
# audio bridge configuration
#
#menu "AMLOGIC AUDIO BRIDGE"

config AMLOGIC_AUDIO_BRIDGE
	tristate "audio bridge support"
	default n
	help
		This is the Amlogic.
		add audio bridge function.
		kernel audio bridge driver.
		support the amlogic audio bridge.

config AMLOGIC_BRIDGE_UAC
	bool "audio UAC bridge support"
	depends on AMLOGIC_AUDIO_BRIDGE && (USB_CONFIGFS_F_UAC1 || USB_CONFIGFS_F_UAC2)
	default n
	help
		This is the Amlogic.
		add uac audio on bridge.
		kernel bridge uac driver.
		support the amlogic uac bridge.

config AMLOGIC_BRIDGE_DSP
	bool "audio DSP bridge support"
	depends on AMLOGIC_AUDIO_BRIDGE && AMLOGIC_HIFI4DSP
	default n
	help
		This is the Amlogic.
		add dsp audio on bridge.
		kernel bridge dsp driver.
		support the amlogic dsp bridge.
#endmenu
```

## drivers/amlogic/audioinfo/Kconfig
```kconfig
# audio info  configuration
#
config AMLOGIC_AUDIO_INFO
	tristate "Amlogic audio info support"
	default n
	help
		support the amlogic audio info;
```

## drivers/amlogic/bluetooth/Kconfig
```kconfig
# Amlogic Bluetooth

config AMLOGIC_BT_DEVICE
    bool "BT Device support"
    depends on BT && RFKILL
    default n
    help
      Say Y here if you want to use the BT device.

config AMLOGIC_BT_WAKE_NOT_REPORT
    bool "BT wake up not resport key event"
    depends on AMLOGIC_BT_DEVICE
    default n
    help
      Say Y here if you dont want to help reporting key event
      when system waken up by BT
```

## drivers/amlogic/board_info/Kconfig
```kconfig
config	AMLOGIC_BOARD_INFO
	bool "Amlogic board id"
	default n
	help
	  say y to enable Amlogic board id driver.
```

## drivers/amlogic/canvas/Kconfig
```kconfig
#
# Canvas management driver configuration
#

menu "Canvas management driver"

config AML_CANVAS
    bool "Amlogic Canvas management driver"
    default y
	help
	  Select to enable Canvas management driver.

endmenu
```

## drivers/amlogic/clk/Kconfig
```kconfig
# Amlogic clock driver


config AMLOGIC_CLK
    bool "Amlogic clock driver  support"
    select COMMON_CLK
    help
      This is the Amlogic Clock  driver
```

## drivers/amlogic/clk_debug/Kconfig
```kconfig
# Amlogic CLK DEBUG

config AMLOGIC_CLK_DEBUG
	tristate "Amlogic Meson SoC Clock Debug Driver"
	help
	  Say yes to support of debugging online a set of SoC clocks
	  from the debugfs interface.
```

## drivers/amlogic/clocksource/Kconfig
```kconfig
menuconfig MESON_TIMER
    boolean "Amlogic Meson timer driver"
    default n
    help
      This is the Amlogic Meson driver interface driver
if MESON_TIMER
config MESON_LOCAL_TIMER
	boolean "meson local timer support"
	def_bool n
	depends on MESON_TIMER
	select CLKSRC_OF if OF
	help
	  This is a new clocksource driver for amlogic timer

config MESON_BC_TIMER
	boolean "meson broadcast timer support"
	def_bool n
	depends on MESON_TIMER
	select CLKSRC_OF if OF
	help
	  This is a new clocksource driver for amlogic timer
endif
```

## drivers/amlogic/codec_mm/Kconfig
```kconfig
#
# Codec mermory manager driver configuration
#
#
config AML_CODEC_MM
	boolean "Amlogic codec memory management driver"
	default n
	---help---
          Select to enable codec related memory management driver.
```

## drivers/amlogic/cpu_hotplug/Kconfig
```kconfig
config	AMLOGIC_CPU_HOTPLUG
	tristate "Amlogic cpu hotplug"
	depends on HOTPLUG_CPU
	default n
	help
	  say y to enable Amlogic cpu hotplug for IPA.Now the cpu can be
	  controlled by calling API. If you want to shut down one CPU,it
	  will choose one of the idlest CPU to shut down.
```

## drivers/amlogic/cpu_info/Kconfig
```kconfig
config	AMLOGIC_CPU_INFO
	boolean "Amlogic chipid"
	default n
	help
	  say y to enable Amlogic chipid driver.
```

## drivers/amlogic/cpu_version/Kconfig
```kconfig
menuconfig AMLOGIC_CPU_VERSION
    tristate "Amlogic cpu version support"
    default n
    help
      This is the Amlogic CPU version interface driver
```

## drivers/amlogic/cpufreq/Kconfig
```kconfig
config AMLOGIC_MESON_CPUFREQ
	tristate  "MESON based CPUfreq driver"
	default n
        help
          This adds the CPUfreq driver support for ARM big.LITTLE platforms
          using MESON dt for CPU power management.

          This driver uses meson cpufreq driver to interact with the
          firmware providing the CPU DVFS functionality.

config AMLOGIC_SCPI_CPUFREQ
	tristate "scpi based cpufreq driver"
	default n
	help
	  this is scpi cpufreq driver for old chips of amlogic

	  this driver use mailbox communicate with uboot to do dvfs
```

## drivers/amlogic/cpuidle/Kconfig
```kconfig
config AMLOGIC_CPUIDLE
	bool "Amlogic Board cpuidle"
	default n
    help
		This is the Amlogic
		Board cpuidle
		driver.
```

## drivers/amlogic/crypto/Kconfig
```kconfig
menu "Amlogic Crypto Support"

config AMLOGIC_CRYPTO
	bool "amlogic HW CRYPTO module"
	depends on CRYPTO_ALGAPI
	depends on CRYPTO_BLKCIPHER
	depends on CRYPTO_HASH
	default n

config AMLOGIC_CRYPTO_DMA
	tristate "amlogic HW CRYPTO module based on DMA"
	depends on AMLOGIC_CRYPTO
	default n
	help
		New Crypto DMA engine starting from S905-X
		Current supported Socs are S905-X, S905-D, S912
		Drivers using new dma engine are in file name
		such aml-xxx-dma.c

endmenu
```
