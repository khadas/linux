## drivers/amlogic/dvb_tv/Kconfig
```kconfig
#
# DVB driver configuration
#

menu "Amlogic DVB driver"

config AM_DVB
	tristate "AMLOGIC DVB driver"
	default n
	select DVB_CORE
	help
		Select to enable AMLogic DVB driver.
		Y: enable
		N: disable
		M: build as module

config AM_ATVDEMOD
	tristate "Amlogic ATVDEMOD device driver"
	default n
	help
	  ATVDEMOD device driver.
		Y: enable
		N: disable
		M: build as module

config AM_DTVDEMOD
	tristate "Amlogic DTVDEMOD device driver"
	default n
	depends on AM_DVB
	help
		DTVDEMOD device driver.
		Y: enable
		N: disable
		M: build as module
menu "AMLOGIC CI Driver"

config AM_CI
	tristate "Amlogic Common Interface driver"
	default n
	depends on AM_DVB
	select AM_PCMCIA
	select AM_SPI
	help
		Select to enable Amlogic CI driver.
		Y: enable
		N: disable
		M: build as module
config AM_PCMCIA
	tristate "Amlogic PCMCIA driver"
	default n
	help
		Select to enable Amlogic PCMCIA driver.
		Y: enable
		N: disable
		M: build as module
config AM_SPI
	tristate "Amlogic SPI driver"
	default n
	help
		Select to enable Amlogic SPI driver.
		Y: enable
		N: disable
		M: build as module
endmenu

if !OF

config AMLOGIC_TS0
	bool "Enable TS0"
	default n
	depends on AM_DVB
	help
		Enable TS0.
		Y: enable
		N: disable
		M: build as module
config AMLOGIC_S_TS0
	bool "Serial TS0"
	default n
	depends on AMLOGIC_TS0
	help
		TS0 in serial mode.
		Y: enable
		N: disable
		M: build as module
config AMLOGIC_TS0_INVERT_S2P1_FEC_ERROR
	bool "Invert FEC_ERROR TS0"
	default n
	depends on AMLOGIC_S_TS0
	help
		TS0 FEC_ERROR invert
		Y: enable
		N: disable
		M: build as module
config AMLOGIC_TS0_INVERT_S2P1_FEC_DATA
	bool "Invert FEC_DATA TS0"
	default n
	depends on AMLOGIC_S_TS0
	help
		TS0 FEC_DATA invert
		Y: enable
		N: disable
		M: build as module
config AMLOGIC_TS0_INVERT_S2P1_FEC_SYNC
	bool "Invert FEC_SYNC TS0"
	default n
	depends on AMLOGIC_S_TS0
	help
		TS0 FEC_SYNC invert
		Y: enable
		N: disable
		M: build as module
config AMLOGIC_TS0_INVERT_S2P1_FEC_VALID
	bool "Invert FEC_VALID TS0"
	default n
	depends on AMLOGIC_S_TS0
	help
		TS0 FEC_VALID invert
		Y: enable
		N: disable
		M: build as module
config AMLOGIC_TS0_INVERT_S2P1_FEC_CLK
	bool "Invert FEC_CLK TS0"
	default n
	depends on AMLOGIC_S_TS0
	help
		TS0 FEC_CLK invert
		Y: enable
		N: disable
		M: build as module
config AMLOGIC_TS1
	bool "Enable TS1"
	default n
	depends on AM_DVB
	help
		Enable TS1.
		Y: enable
		N: disable
		M: build as module
config AMLOGIC_S_TS1
	bool "Serial TS1"
	default n
	depends on AMLOGIC_TS1
	help
		TS1 in serial mode.
		Y: enable
		N: disable
		M: build as module
config AMLOGIC_TS1_INVERT_S2P1_FEC_ERROR
	bool "Invert FEC_ERROR TS1"
	default n
	depends on AMLOGIC_S_TS1
	help
		TS1 FEC_ERROR invert
		Y: enable
		N: disable
		M: build as module
config AMLOGIC_TS1_INVERT_S2P1_FEC_DATA
	bool "Invert FEC_DATA TS1"
	default n
	depends on AMLOGIC_S_TS1
	help
		TS1 FEC_DATA invert
		Y: enable
		N: disable
		M: build as module
config AMLOGIC_TS1_INVERT_S2P1_FEC_SYNC
	bool "Invert FEC_SYNC TS1"
	default n
	depends on AMLOGIC_S_TS1
	help
		TS1 FEC_SYNC invert
		Y: enable
		N: disable
		M: build as module
config AMLOGIC_TS1_INVERT_S2P1_FEC_VALID
	bool "Invert FEC_VALID TS1"
	default n
	depends on AMLOGIC_S_TS1
	help
		TS1 FEC_VALID invert
		Y: enable
		N: disable
		M: build as module
config AMLOGIC_TS1_INVERT_S2P1_FEC_CLK
	bool "Invert FEC_CLK TS1"
	default n
	depends on AMLOGIC_S_TS1
	help
		TS1 FEC_CLK invert
		Y: enable
		N: disable
		M: build as module
config AMLOGIC_TS2
	bool "Enable TS2"
	default n
	depends on AM_DVB
	help
		Enable TS2.
		Y: enable
		N: disable
		M: build as module
config AMLOGIC_S_TS2
	bool "Serial TS2"
	default n
	depends on AMLOGIC_TS2
	help
		TS2 in serial mode.
		Y: enable
		N: disable
		M: build as module
config AMLOGIC_TS2_INVERT_S2P1_FEC_ERROR
	bool "Invert FEC_ERROR TS2"
	default n
	depends on AMLOGIC_S_TS2
	help
		TS2 FEC_ERROR invert
		Y: enable
		N: disable
		M: build as module
config AMLOGIC_TS2_INVERT_S2P1_FEC_DATA
	bool "Invert FEC_DATA TS2"
	default n
	depends on AMLOGIC_S_TS2
	help
		TS2 FEC_DATA invert
		Y: enable
		N: disable
		M: build as module
config AMLOGIC_TS2_INVERT_S2P1_FEC_SYNC
	bool "Invert FEC_SYNC TS2"
	default n
	depends on AMLOGIC_S_TS2
	help
		TS2 FEC_SYNC invert
		Y: enable
		N: disable
		M: build as module
config AMLOGIC_TS2_INVERT_S2P1_FEC_VALID
	bool "Invert FEC_VALID TS2"
	default n
	depends on AMLOGIC_S_TS2
	help
		TS2 FEC_VALID invert
		Y: enable
		N: disable
		M: build as module
config AMLOGIC_TS2_INVERT_S2P1_FEC_CLK
	bool "Invert FEC_CLK TS2"
	default n
	depends on AMLOGIC_S_TS2
	help
		TS2 FEC_CLK invert
		Y: enable
		N: disable
		M: build as module
endif
source "drivers/amlogic/dvb_tv/smartcard/Kconfig"





























endmenu
```

## drivers/amlogic/dvb_tv/smartcard/Kconfig
```kconfig
#
#Smart card driver configuration
#

config AML_SMARTCARD
	bool "Amlogic Smartcard driver"
	default n
```

## drivers/amlogic/efuse/Kconfig
```kconfig
#
# Amlogic efuse device configuration
#

config AMLOGIC_EFUSE
	bool "Amlogic EFUSE driver support"
	default n
	help
    amlogic EFUSE device driver
    not choose by default
```

## drivers/amlogic/efuse_unifykey/Kconfig
```kconfig
#
# Amlogic efuse&unifykey device configuration
#
config AMLOGIC_EFUSE_UNIFYKEY
	tristate "Amlogic EUSE and UNIFYKEY support"
	default n
	help
	    amlogic EFUSE and UNIFYKEY glue driver
	    choose by default

config AMLOGIC_EFUSE
	bool "Amlogic EFUSE driver support"
	default n
	help
	    amlogic EFUSE device driver
	    not choose by default

config AMLOGIC_UNIFYKEY
	bool "Amlogic unifykey driver support"
	default n
	help
	    platform independent part of unifykey driver
	    not choose by default

config AMLOGIC_EFUSE_BURN
	bool "Amlogic efuse pattern burn suppot"
	default n
	help
	    if project need burn efuse pattern file, then
	    it can enable this. if efuse pattern size exceed
	    4KB, it must enable this. it write efuse pattern
	    file through /dev/efuse_burn.
```
