## drivers/amlogic/defendkey/Kconfig
```kconfig
#
# Amlogic defendkey device configuration
#

config AMLOGIC_DEFENDKEY
	tristate "Amlogic defendkey driver support"
	default n
	help
		amlogic defendkey device driver
		not choose by default
```

## drivers/amlogic/deinterlace/Kconfig
```kconfig
#
# Deinterlace driver configuration
#

menu "Deinterlace driver"

config DEINTERLACE
	tristate "DEINTERLACE driver"
	default n
	help
		Select to enable AMLOGIC DEINTERLACE driver
		process interlace source need three continueed fields,
		wave progressive source with two interlace fields from
		one progreesive fields


if DEINTERLACE
config AM_DEINTERLACE_SD_ONLY
        bool "Enable DI Only for SD"
        default n
        help
			The buffer size will be smaller
			only support sd interlace source process,
			others will be bypassd
endif

endmenu
```

## drivers/amlogic/display/Kconfig
```kconfig
comment "Amlogic Display Driver"
menuconfig AML_DISPLAY
	bool "Amlogic Display Driver"
	default n
	help
	  Display module includes OSD, VOUT, GE2D, LCD, backlight etc.
	  If unsure, select 'Y'.

if AML_DISPLAY
source "drivers/amlogic/display/vout/Kconfig"
source "drivers/amlogic/display/osd/Kconfig"
source "drivers/amlogic/display/vout2/Kconfig"
source "drivers/amlogic/display/osd_ext/Kconfig"
source "drivers/amlogic/display/ge2d/Kconfig"
source "drivers/amlogic/display/logo/Kconfig"
source "drivers/amlogic/display/lcd/Kconfig"
source "drivers/amlogic/display/backlight/Kconfig"
endif
```

## drivers/amlogic/display/backlight/Kconfig
```kconfig
menu "Amlogic Backlight Support"

config AML_BACKLIGHT
	boolean "Amlogic backlight support"
	select BACKLIGHT_LCD_SUPPORT
	select BACKLIGHT_CLASS_DEVICE
	default n
	help
		Say Y here if you want to use the Amlogic backlight management.

if AML_BACKLIGHT
source "drivers/amlogic/display/backlight/bl_extern/Kconfig"
source "drivers/amlogic/display/backlight/aml_ldim/Kconfig"
endif

endmenu
```

## drivers/amlogic/display/backlight/aml_ldim/Kconfig
```kconfig
#
# LDIM Device Driver Configuration
#
config AML_LOCAL_DIMMING
	boolean "Amlogic Local dimming"
	default n
	help
	  Say Y if you want to use Amlogic Local dimming.

config IW7019_BACKLIGHT
	boolean "iW7019 Backlight"
	default n
	depends on AML_LOCAL_DIMMING
	help
	  iW7019 LED Driver for LCD Panel Backlight.

config IW7019_USE_EEPROM
	boolean "iW7019 use eeprom to backup data"
	default n
	depends on AML_LOCAL_DIMMING
	help
	  Say Y if you use eeprom to backup data of iw7019.
```

## drivers/amlogic/display/backlight/aml_tablet_bl_extern/Kconfig
```kconfig
config AML_TABLET_BL_EXTERN
	boolean "Amlogic backlight extern"
	default y
	help
	Say Y if you want to use Amlogic backlight extern control.

config AML_BL_EXTERN_PMU_AML1218
	boolean "Amlogic backlight pmu aml1218"
	depends on AML_TABLET_BL_EXTERN
	default y
	help
	Say Y if you want to use pmu aml1218 to control Amlogic backlight.


config AML_BL_EXTERN_I2C_LP8556
	boolean "Amlogic backlight i2c lp8556"
	depends on AML_TABLET_BL_EXTERN
	default n
	help
	Say Y if you want to use i2c lp8556 to control Amlogic backlight.

config CONFIG_AML_BL_EXTERN_MIPI_LT070ME05
	boolean "Amlogic backlight mipi LT070ME05"
	depends on AML_TABLET_BL_EXTERN
	default n
	help
	Say Y if you want to use mipi LT070ME05 to control Amlogic backlight.
```

## drivers/amlogic/display/backlight/bl_extern/Kconfig
```kconfig
config AML_BL_EXTERN
	boolean "Amlogic backlight extern driver support"
	default n
	help
		Say Y if you want to use Amlogic backlight external controller.

config AML_BL_EXTERN_PMU_AML1218
	boolean "Amlogic backlight pmu aml1218"
	depends on AML_BL_EXTERN
	default n
	help
		pmu aml1218 backlight controller support.


config AML_BL_EXTERN_I2C_LP8556
	boolean "Amlogic backlight i2c lp8556"
	depends on AML_BL_EXTERN
	default n
	help
		i2c lp8556 backlight controller support.

config AML_BL_EXTERN_MIPI_LT070ME05
	boolean "Amlogic backlight mipi LT070ME05"
	depends on AML_BL_EXTERN
	default n
	help
		mipi LT070ME05 backlight controller support.
```

## drivers/amlogic/display/ge2d/Kconfig
```kconfig
#
# GE2D Module
#
menu "Amlogic GE2D Module"
config  AM_GE2D
	boolean "Amlogic GE2D Module"
	default n
	help
		Select to enable GE2D graphic 2D engine.
config	AM_GE2D_MORE_SECURITY
	boolean "Amlogic GE2D not use physical addr"
	default n
	depends on AM_GE2D
	help
		Select to enable GE2D not use physical addr.
endmenu
```

## drivers/amlogic/display/lcd/Kconfig
```kconfig
#
# Video output configuration
#
menu "Amlogic LCD Output Module"

config AML_LCD
	boolean "LCD Output Module"
	default n
	help
		LCD output module

config AML_LCD_TV
	boolean "LCD TV Output Module"
	default n
	depends on AML_LCD
	help
		LCD TV output module

config AML_LCD_TABLET
	boolean "LCD Tablet Output Module"
	default n
	depends on AML_LCD
	help
		LCD Tablet output module

if AML_LCD
source "drivers/amlogic/display/lcd/lcd_extern/Kconfig"
endif

endmenu
```

## drivers/amlogic/display/lcd/lcd_extern/Kconfig
```kconfig
menuconfig AML_LCD_EXTERN
	boolean "LCD external driver support"
	default n
	help
		"Amlogic LCD external driver support, such as i2c initial..."

config AML_LCD_EXTERN_I2C_T5800Q
	boolean "lcd external i2c T5800Q init driver"
	default n
	depends on AML_LCD_EXTERN
	help
		"Amlogic LCD external i2c_T5800Q init driver support"

config AML_LCD_EXTERN_I2C_DLPC3439
	boolean "lcd external i2c DLPC3439 init driver"
	default n
	depends on AML_LCD_EXTERN
	help
		"Amlogic LCD external i2c_DLPC3439 init driver support"

config AML_LCD_EXTERN_I2C_ANX6345
	boolean "lcd external i2c ANX6345 init driver"
	default n
	depends on AML_LCD_EXTERN
	help
		"Amlogic LCD external i2c_ANX6345 init driver support"

config AML_LCD_EXTERN_I2C_TC101
	boolean "lcd external i2c TC101 init driver"
	default n
	depends on AML_LCD_EXTERN
	help
		"Amlogic LCD external i2c_TC101 init driver support"

config AML_LCD_EXTERN_SPI_LD070WS2
	boolean "lcd external spi LD070WS2 init driver"
	default n
	depends on AML_LCD_EXTERN
	help
		"Amlogic LCD external spi_LD070WS2 init driver support"

config AML_LCD_EXTERN_MIPI_KD080D13
	boolean "lcd external mipi KD080D13 init driver"
	default n
	depends on AML_LCD_EXTERN
	help
		"Amlogic LCD external mipi_KD080D13 init driver support"

config AML_LCD_EXTERN_MIPI_N070ICN
	boolean "lcd external mipi N070ICN init driver"
	default n
	depends on AML_LCD_EXTERN
	help
		"Amlogic LCD external mipi_N070ICN init driver support"
```

## drivers/amlogic/display/lcd/lcd_tablet/Kconfig
```kconfig
config AML_LCD_GAMMA_DEBUG
	boolean "LCD Gamma debug support"
	default n
	help
		Amlogic LCD gamma debug
```

## drivers/amlogic/display/logo/Kconfig
```kconfig
#
# Amlogic Logo configuration
#
config AM_LOGO
	boolean "Amlogic Logo Module"
	default n
	depends on AM_VOUT
	help
		Select to enable Logo module
```

## drivers/amlogic/display/osd/Kconfig
```kconfig
#
# Frame buffer configuration
#
menu "Amlogic OSD Module"

config AM_FB
	boolean "Amlogic OSD Support"
	select FB
	select FB_CFB_FILLRECT
	select FB_CFB_COPYAREA
	select FB_CFB_IMAGEBLIT
	select AM_CANVAS
	select AM_VOUT
	default n
	help
		This is the frame buffer device driver.

config FB_OSD_SUPPORT_SYNC_FENCE
	boolean "OSD SYNC FENCE"
	default n
	depends on AM_FB
	select STAGING
	select ANDROID
	select SYNC
	select SW_SYNC
	help
		Select to enable OSD SYNC FENCE.

config FB_OSD_VSYNC_RDMA
	boolean "OSD VSYNC RDMA"
	default n
	depends on AM_FB
	help
		Select to enable OSD VSYNC RDMA.

config FB_OSD2_ENABLE
	boolean "OSD2 Layer Support"
	default n
	depends on AM_FB
	help
		Select to enable OSD2 Layer.

config FB_OSD2_CURSOR
	boolean "OSD2 Cursor Support"
	depends on FB_OSD2_ENABLE
	default n
	help
		Select to enable OSD2 cursor.
endmenu
```

## drivers/amlogic/display/osd_ext/Kconfig
```kconfig
#
# Frame buffer configuration
#
menu "Amlogic OSD_EXT Module"

config AM_FB_EXT
	boolean "Amlogic OSD_EXT Support"
	default n
	depends on AM_FB
	select FB_CFB_FILLRECT
	select FB_CFB_COPYAREA
	select FB_CFB_IMAGEBLIT
	select AM_CANVAS
	select AM_VOUT2
	help
		This is the frame buffer device driver.
endmenu
```

## drivers/amlogic/display/vout/Kconfig
```kconfig
#
# Video output configuration
#
menu "Amlogic VOUT Module"

config AM_VOUT
	boolean "Video Output Module"
	default n
	help
		Select to enable VOUT module

config AM_TV_OUTPUT
	boolean "TV Output Module"
	default n
	depends on AM_VOUT
	help
		TV output module

config AML_VOUT_FRAMERATE_AUTOMATION
	boolean "Framerate Automation"
	default n
	depends on AM_TV_OUTPUT
	help
		framerate adjustment automatically from video source

config AML_VOUT_CC_BYPASS
	boolean "closed caption bypass"
	default n
	depends on AM_TV_OUTPUT
	help
		add cvbsout closed caption bypass function

config AML_VDAC_HW_SWITCH
	boolean "vdac hardware switch"
	default n
	depends on AM_TV_OUTPUT
	help
		vdac hardware switch of cvbs/ypbpr for mx.

config AML_WSS
	bool "WSS function"
	default y
	depends on AM_TV_OUTPUT
	help
		Wide Screen Signalling config.
endmenu
```

## drivers/amlogic/display/vout/lcd/Kconfig
```kconfig
config AML_LCD_GAMMA_DEBUG
	boolean "LCD Gamma debug support"
	default y
	help
		Amlogic LCD gamma debug

source "drivers/amlogic/display/vout/lcd/lcd_extern/Kconfig"
```

## drivers/amlogic/display/vout2/Kconfig
```kconfig
#
# Video output configuration
#
menu "Amlogic VOUT2 Module"

config AM_VOUT2
	boolean "Video Output2 Module"
	default n
	help
		Select to enable VOUT2 module

config AM_TV_OUTPUT2
	boolean "TV Output2 Module"
	default n
	select AM_VOUT2
	help
		TV output2 module

endmenu
```

## drivers/amlogic/drm/Kconfig
```kconfig
config AMLOGIC_DRM
	tristate "DRM Support for Amlogic new Display Controller"
	default n
	depends on AMLOGIC_DRIVER && DRM && OF && (ARM || ARM64)
	select DRM_KMS_HELPER
	select DRM_KMS_CMA_HELPER
	select DRM_GEM_CMA_HELPER
	select VIDEOMODE_HELPERS
	select REGMAP_MMIO
	help
		amlogic new soc display controller
		use the pipeline and modularized

config DRM_MESON_VPU
	bool "support drm vpu function for meson drm display."
	default n
	depends on AMLOGIC_DRM
	help
		add drm vpu support.
		Choose this option if you have a aMLOGIC soc chipset.
		This driver provides KMS.
		This driver also provides crtcs and planes management.

config DRM_MESON_HDMI
	bool "support drm hdmi function for meson drm display."
	default n
	depends on AMLOGIC_DRM
	depends on AMLOGIC_HDMITX
	help
		add drm hdmi support.
		use internal amlogic media vout hdmi driver.
		We should confirm AMLOGIC_HDMITX is configured if
		DRM_MESON_HDMI is selected.

config DRM_MESON_CVBS
	bool "support drm cvbs function for meson drm display."
	default n
	depends on AMLOGIC_DRM
	depends on AMLOGIC_CVBS_OUTPUT
	help
		add drm cvbs support.
		use internal amlogic media vout cvbs driver.
		We should confirm AMLOGIC_CVBSOUT is configured if
		DRM_MESON_CVBS is selected.

config DRM_MESON_PANEL
	bool "support drm panel function for meson drm display."
	default n
	depends on AMLOGIC_DRM
	depends on AMLOGIC_LCD
	select DRM_PANEL
	select DRM_MIPI_DSI
	help
		add drm panel support.
		use internal amlogic media vout lcd driver.
		We should confirm AMLOGIC_LCD is configured if
		DRM_MESON_PANEL is selected.

config DRM_MESON_USE_ION
	bool "gem use ion to alloc/free graphic buffer."
	default n
	depends on AMLOGIC_DRM
	help
		MESON DRM use CMA HELPER to manage framebuffer.
		It need reserve memory in CMA pool.
		We implement GEM to allocate/free framebuffer from ion.
		For dumb used by displaycontrol we alloc from the ION CMA HEAP.
		For dumb used by app, we can alloc from the ION.
		SYSTEM HEAP which dont need reserve memory.

config DRM_MESON_EMULATE_FBDEV
	bool "emulate framebuffer dev by drm."
	default n
	depends on AMLOGIC_DRM && DRM_MESON_USE_ION
	help
		Emulate framebuffer device for device
		which need use fbdev api.

config DRM_MESON_FBDEV_UI_W
	int "fbdev ui size width"
	default 1920
	depends on DRM_MESON_EMULATE_FBDEV
	help
		UI size width


config DRM_MESON_FBDEV_UI_H
	int "fbdev ui size hight"
	default 1080
	depends on DRM_MESON_EMULATE_FBDEV
	help
		UI size height
```

## drivers/amlogic/drm/drm-v0/Kconfig
```kconfig
config DRM_MESON_VPU
	tristate "support drm vpu function for meson drm display."
	default n
	depends on DRM_MESON_V0
	help
		add drm vpu support.
		Choose this option if you have a aMLOGIC soc chipset.
		This driver provides KMS.
		This driver also provides crtcs and planes management.

config DRM_MESON_HDMI
	tristate "support drm hdmi function for meson drm display."
	default n
	depends on DRM_MESON_V0
	depends on AMLOGIC_HDMITX
	help
		add drm hdmi support.
		use internal amlogic media vout hdmi driver.
		We should confirm AMLOGIC_HDMITX is configured if
		DRM_MESON_HDMI is selected.

config DRM_MESON_PANEL
	tristate "support drm panel function for meson drm display."
	default n
	depends on DRM_MESON_V0
	depends on AMLOGIC_LCD
	select DRM_PANEL
	select DRM_MIPI_DSI
	help
		add drm panel support.
		use internal amlogic media vout lcd driver.
		We should confirm AMLOGIC_LCD is configured if
		DRM_MESON_PANEL is selected.

config DRM_MESON_USE_ION
	bool "gem use ion to alloc/free graphic buffer."
	default n
	depends on DRM_MESON_V0
	help
		MESON DRM use CMA HELPER to manage framebuffer.
		It need reserve memory in CMA pool.
		We implement GEM to allocate/free framebuffer from ion.
		For dumb used by displaycontrol we alloc from the ION CMA HEAP.
		For dumb used by app, we can alloc from the ION.
		SYSTEM HEAP which dont need reserve memory.

config DRM_MESON_EMULATE_FBDEV
	bool "emulate framebuffer dev by drm."
	default n
	depends on DRM_MESON_V0 && DRM_MESON_USE_ION
	help
		Emulate framebuffer device for device which need use fbdev api.
```

## drivers/amlogic/dvb/Kconfig
```kconfig
menu "AMLOGIC DVB EXTERN support"

config AMLOGIC_DVB_EXTERN
	tristate "Amlogic dvb extern drivers"
	default N
	help
		select it to support amlogic dvb extern driver.
		Y: enable
		N: disable
		M: build as module
endmenu

menu "DVB AUCPU support"
source "drivers/amlogic/dvb/aucpu/Kconfig"
endmenu
#
#dvb driver for demux
#
menu "AMLOGIC DVB demux/dsc support"

config AMLOGIC_DVB_DMX
   tristate "AMLOGIC DVB DMX"
#   default m
#   bool "AMLOGIC DVB DMX"
   default (DVB_CORE && DVB_PLATFORM_DRIVER && AMLOGIC_DVB && AMLOGIC_DVB_COMPAT)
   help
     support dmx/dsc driver.

config AMLOGIC_DVB_DSM
	tristate "AMLOGIC DVB DSM"
	default N
	help
		Amlogic DVB Descrambler Session Manager
		Y: enable
		N: disable
		M: build as module

endmenu
```

## drivers/amlogic/dvb/aucpu/Kconfig
```kconfig
#
# Amlogic AUCPU driver configuration
#
config AMLOGIC_AUCPU
	tristate "Amlogic Aucpu driver"
	default n
#	depends on AMLOGIC_MEDIA_CODEC_MM
	help
		Amlogic AUCPU Driver module support
		This module driver support amlogic aucpu
```
