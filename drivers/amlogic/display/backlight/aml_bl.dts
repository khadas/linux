backlight{
		compatible = "amlogic, backlight";
		dev_name = "backlight";
		mode = "tv";
		status = "okay";
		pinctrl-names = "default","pwm_vs";
		pinctrl-0 = <&bl_pwm_pins>;
		pinctrl-1 = <&bl_pwm_vs_pins>;

		bl-gpios = <&gpio GPIOY_6 GPIO_ACTIVE_HIGH
			&gpio GPIOY_7 GPIO_ACTIVE_HIGH>;
		bl_gpio_names = "GPIOY_6","GPIOY_7";

		backlight_0{
			index = <0>;
			bl_name = "backlight_0";
			bl_level_default_uboot_kernel = <100 100>;
			bl_level_max_min = <255 10>;

			bl_ctrl_method = <1>; /** 0=gpio, 1=pwm, 2=extern */
			bl_en_gpio_on_off = <0 0 1>; /** index(point to bl-gpios, 0xff=invalid), on/off_value(1=output high, 0=output low) **/
			bl_power_on_off_delay = <200 200>; /** unit: ms */

			bl_pwm_method = <0>; /** 0=negative, 1=positive */
			bl_pwm_port = "PWM_B"; /* PWM_A, PWM_B, PWM_C, PWM_D, PWM_VS */
			bl_pwm_freq = <1000>; /* pwm_vs: 1~4(vfreq multiple), other pwm: real freq(unit: Hz) */
			bl_pwm_duty_max_min = <100 25>; /* 100% - 25%*/
			bl_pwm_gpio_off = <1 1>; /** index(point to bl-gpios, 0xff=invalid), off_value(1=output high, 0=output low) **/
			bl_pwm_on_off_delay  = <200 200>; /* unit: ms */
		};
		backlight_1{
			index = <1>;
			bl_name = "backlight_1";
			bl_level_default_uboot_kernel = <100 100>;
			bl_level_max_min = <255 10>;

			bl_ctrl_method = <1>; /** 0=gpio, 1=pwm, 2=extern */
			bl_en_gpio_on_off = <0 0 1>; /** index(point to bl-gpios, 0xff=invalid), on/off_value(1=output high, 0=output low) **/
			bl_power_on_off_delay = <200 200>; /** unit: ms */

			bl_pwm_method = <0>; /** 0=negative, 1=positive */
			bl_pwm_port = "PWM_VS"; /* PWM_A, PWM_B, PWM_C, PWM_D, PWM_VS */
			bl_pwm_freq = <2>; /* pwm_vs: 1~4(vfreq multiple), other pwm: real freq(unit: Hz) */
			bl_pwm_duty_max_min = <100 25>; /* 100% - 25%*/
			bl_pwm_gpio_off = <1 1>; /** index(point to bl-gpios, 0xff=invalid), off_value(1=output high, 0=output low) **/
			bl_pwm_on_off_delay  = <200 200>; /* unit: ms */
		};
	};