bl_extern_pmu_aml1218{
	compatible = "amlogic, bl_pmu_aml1218";
	dev_name ="bl_pmu_aml1218";
	status = "disabled"; /** "disabled" or "okay" */
	GPIODV_28-gpios = <&gpio GPIODV_28 0>;
	gpio_enable_on_off = "GPIODV_28","1","0"; /** gpio("n"for none), on/off(1=output high, 0=output low, 2=input)*/
	type = <2>;	/** bl_extern_driver type: 0=i2c, 1=spi, 2=other */
	dim_max_min = <0x1 0x1b>;
};


bl_extern_i2c_lp8556{
	compatible = "amlogic, bl_i2c_lp8556";
	dev_name ="bl_i2c_lp8556";
	status = "disabled"; /** "disabled" or "okay" */
	GPIODV_28-gpios = <&gpio GPIODV_28 0>;
	gpio_enable_on_off = "GPIODV_28","1","0"; /** gpio("n"for none), on/off(1=output high, 0=output low, 2=input)*/
	type = <0>;	/** bl_extern_driver type: 0=i2c, 1=spi, 2=other */
	i2c_address = <0x2c>; /** 7bit i2c address */
	i2c_bus = "i2c_bus_b";
	dim_max_min = <255 10>;
};


bl_extern_mipi_LT070ME05{
	compatible = "amlogic, bl_mipi_LT070ME05";
	dev_name ="bl_mipi_LT070ME056";
	status = "disabled"; /** "disabled" or "okay" */
	GPIODV_28-gpios = <&gpio GPIODV_28 0>;
	gpio_enable_on_off = "GPIODV_28","1","0"; /** gpio("n"for none), on/off(1=output high, 0=output low, 2=input)*/
	type = <2>;	/** bl_extern_driver type: 0=i2c, 1=spi, 2=other */
	dim_max_min = <255 10>;
};
