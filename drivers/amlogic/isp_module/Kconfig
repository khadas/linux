## drivers/amlogic/isp_module/Kconfig
```kconfig
menu "Amlogic ISP Support"

config AMLOGIC_ISP
	tristate "amlogic ISP module"
	default m
	help
	  Driver for ISP.

endmenu
```

## drivers/amlogic/jtag/Kconfig
```kconfig
#
# Amlogic jtag configuration
#

menuconfig AMLOGIC_JTAG
	bool "Amlogic JTAG Support"
	default n
	help
		Say Y here to enable jtag support.
		This option alone does not add any
		kernel code. Ability to debug the
		system using jtag

if AMLOGIC_JTAG

config	AMLOGIC_JTAG_MESON
	tristate "meson jtag setup driver"
	default n
	help
		This option enables support jtag setup.
		Enable this option to allow setup jtag
		with uboot parameter. Ability to debug
		the system using jtag

endif
```

## drivers/amlogic/keytable/Kconfig
```kconfig
menu "Amlogic Keytable Support"

config AMLOGIC_KT
	tristate "amlogic Keytable driver"
	default y
	help
		Keytable driver using the H/W keytable.
		This module deposits keys into h/w KeyTable with usage flags.

endmenu
```

## drivers/amlogic/led/Kconfig
```kconfig
#
# LED drivers configuration
#

menuconfig AMLOGIC_LED
	bool "Amlogic LED Support"
	default n
	help
	  Say Y here to get to see options for led drivers.
	  This option alone does not add any kernel code.

	  If you say N, all options in this submenu will be
	  skipped and disabled.


if AMLOGIC_LED

config AMLOGIC_LEDS_TLC59116
	tristate "LED Support for the TLC59116"
	depends on LEDS_CLASS
	default n
	help
	  Choose this option if you want to use the LED on
	  TLC59116.

config AMLOGIC_LEDS_AW9523B
	tristate "LED Support for the AW9523B"
	depends on LEDS_CLASS
	default n
	help
	  Choose this option if you want to use the LED on
	  AW9523B.

config AMLOGIC_LEDS_STATE
	tristate "LED state support"
	depends on LEDS_CLASS
	default n
	help
	  Choose this option if you want to use the LED state
		and led function

endif
```

## drivers/amlogic/mailbox/Kconfig
```kconfig
#
# Amlogic mhu mailbox device configuration
#

menu "MESON MHU mailbox Support"

config AMLOGIC_MHU_MBOX
	tristate "MESON MHU Mailbox"
	default n
	select MAILBOX
	select ARM_SCPI_PROTOCOL
	help
		MESON MHU Mailbox driver.
		.
		.
		.

endmenu
```

## drivers/amlogic/media/Kconfig
```kconfig
#
# Amlogic multimedia configuration
#

menu "Amlogic multimedia configuration"

config AMLOGIC_MEDIA_MODULE
	tristate "Amlogic Multimedia compile support"
	default y
	help
		media module compile support
		select y for built-in
		select m for ko
		select n for disable

config AMLOGIC_MEDIA_ENABLE
	bool "Amlogic Multimedia Support"
	default n
	help
		Amlogic multimedia framework composed of two parts,
		the first part is common which consists of modules
		such as arch, codec_mm, vfm, the second is driver
		part of the media, both of which depends on this
		configuration options.

config AMLOGIC_MEDIA_COMMON
	bool "Amlogic the common of the media"
	depends on AMLOGIC_MEDIA_ENABLE
	default n
	help
		This option is used to configure Amlogic common
		for media, it as the basis for drivers of the
		multimedia, mainly on the operation of the
		registers, memory allocation and the chain of
		responsibility management of the frame processing.


config AMLOGIC_MEDIA_DRIVERS
	bool "Amlogic drivers of the media"
	depends on AMLOGIC_MEDIA_COMMON
	default n
	help
		This option is used to configure Amlogic drivers
		of the multimedia, which consists of video decoder
		module, video decoder management module and post
		processing of the frame.

config AMLOGIC_MEDIA_MULTI_DEC
	bool "Support multi-instance decoding"
	default n
	help
		Support for multi-instance decoding features,
		this option must be configured if multi playback
		is required, the feature supports decoding
		at the same time.

config AMLOGIC_MEDIA_NO_PARSER
	bool "The stream buffer works on non-parser mode."
	depends on AMLOGIC_MEDIA_DRIVERS
	default n
	help
		The module of hardware parser will be removed after
		SC2 platform. therefore the parser modules can't be
		builded in ko if enable this item.

if AMLOGIC_MEDIA_COMMON
source "drivers/amlogic/media/common/Kconfig"
endif

source "drivers/amlogic/media/camera/Kconfig"
if AMLOGIC_MEDIA_DRIVERS
source "drivers/amlogic/media/video_sink/Kconfig"
source "drivers/amlogic/media/vout/Kconfig"
source "drivers/amlogic/media/vrr/Kconfig"
source "drivers/amlogic/media/osd/Kconfig"
source "drivers/amlogic/media/deinterlace/Kconfig"
source "drivers/amlogic/media/di_multi/Kconfig"
source "drivers/amlogic/media/di_local/Kconfig"
source "drivers/amlogic/media/video_processor/Kconfig"
source "drivers/amlogic/media/enhancement/Kconfig"
source "drivers/amlogic/media/frame_sync/Kconfig"
source "drivers/amlogic/media/gdc/Kconfig"
source "drivers/amlogic/media/vin/Kconfig"
source "drivers/amlogic/media/cec/Kconfig"
source "drivers/amlogic/media/esm/Kconfig"
source "drivers/amlogic/media/atv_demod/Kconfig"
source "drivers/amlogic/media/avsync/Kconfig"
source "drivers/amlogic/media/dtv_demod/Kconfig"
source "drivers/amlogic/media/frc/Kconfig"
source "drivers/amlogic/media/di_v4l/Kconfig"
source "drivers/amlogic/media/vpp/Kconfig"
source "drivers/amlogic/media/vpq/Kconfig"
endif
endmenu
```

## drivers/amlogic/media/avsync/Kconfig
```kconfig
#
# Amlogic multi-instance AVsync
#
config AMLOGIC_MEDIA_MSYNC
	bool "Multi-Instance AVSync"
	default n
	help
		Amlogic multi instance AVSync support
```

## drivers/amlogic/media/camera/Kconfig
```kconfig
#
# amlogic camera driver configuration
#

config AMLOGIC_MEDIA_CAMERA
	bool "Amlogic Camera driver"
	select VIDEOBUF2_DMA_CONTIG
	select V4L2_FWNODE
	default n
	help
		This option is used to configure amlogic camera driver,
		which need use dma contig and v4l2 fwnode.
```

## drivers/amlogic/media/common/Kconfig
```kconfig
#Ascending by module name's ASCII
source "drivers/amlogic/media/common/canvas/Kconfig"
source "drivers/amlogic/media/common/ge2d/Kconfig"
source "drivers/amlogic/media/common/ion_dev/Kconfig"
source "drivers/amlogic/media/common/vpu/Kconfig"
source "drivers/amlogic/media/common/rdma/Kconfig"
source "drivers/amlogic/media/common/vfm/Kconfig"
source "drivers/amlogic/media/common/codec_mm/Kconfig"
source "drivers/amlogic/media/common/v4l_util/Kconfig"
source "drivers/amlogic/media/common/uvm/Kconfig"
source "drivers/amlogic/media/common/lut_dma/Kconfig"
source "drivers/amlogic/media/common/vpu_security/Kconfig"
source "drivers/amlogic/media/common/resource_mgr/Kconfig"
source "drivers/amlogic/media/common/dma-buf-heaps/Kconfig"
source "drivers/amlogic/media/common/vicp/Kconfig"
```

## drivers/amlogic/media/common/canvas/Kconfig
```kconfig
#
# Canvas management driver configuration
#

menu "Canvas management driver"

config AMLOGIC_MEDIA_CANVAS
	bool "Amlogic Canvas management driver"
	default n
	help
		This option is used to configure Amlogic drivers
		of the multimedia Canvas management module,
		it as the basis for drivers of the multimedia,
		mainly on the operation of the canvas.

endmenu
```

## drivers/amlogic/media/common/dma-buf-heaps/Kconfig
```kconfig
menu "Amlogic dma-buf support"

config AMLOGIC_SECURE_DMABUF
	tristate "Amlogic secure dma buf memory management support"
	depends on DMABUF_HEAPS
	default n
	help
		Select to enable "Amlogic secure dma buf device support.
endmenu
```

## drivers/amlogic/media/common/ge2d/Kconfig
```kconfig
#
# GE2D Module
#

menu "Amlogic GE2D Module"

config  AMLOGIC_MEDIA_GE2D
	tristate "Amlogic GE2D Module"
	default n
	help
		This option is used to configure Amlogic drivers
		of the GE2d module, it as the basis for drivers of
		the multimedia, mainly on the operation of GE2D.
		Select to enable GE2D graphic 2D engine.

config	AMLOGIC_MEDIA_GE2D_MORE_SECURITY
	bool "Amlogic GE2D not use physical addr"
	default n
	depends on AMLOGIC_MEDIA_GE2D
	help
		This option is used to configure Amlogic drivers
		of the GE2d module, it as the basis for drivers of
		the multimedia, mainly on the operation of GE2D.
		Select to enable GE2D not use physical addr.

endmenu
```

## drivers/amlogic/media/common/ion_dev/Kconfig
```kconfig
menu "ION support"

config AMLOGIC_ION
	tristate "ION memory management support"
	depends on ION
	default n
	help
		Select to enable "Amlogic ion device support.
endmenu
```

## drivers/amlogic/media/common/lut_dma/Kconfig
```kconfig
#
# LUT DMA management driver configuration
#

menu "LUT DMA management driver"

config AMLOGIC_MEDIA_LUT_DMA
	bool "Amlogic LUT DMA management driver"
	default n
	help
		This option is used to configure Amlogic drivers
		of the lut dma module,
		Select to enable LUT DMA management driver.
endmenu
```

## drivers/amlogic/media/common/rdma/Kconfig
```kconfig
#
# RDMA management driver configuration
#

menu "RDMA management driver"

config AMLOGIC_MEDIA_RDMA
	bool "Amlogic RDMA management driver"
	default n
	help
		This option is used to configure Amlogic drivers
		of the multimedia RDMA management module,
		it as the basis for drivers of the multimedia,
		mainly on the operation of the RDMA.
		Select to enable RDMA management driver.

config AMLOGIC_MEDIA_VSYNC_RDMA
	bool "Amlogic RDMA VSYNC"
	depends on AMLOGIC_MEDIA_RDMA
	default n
	help
		This option is used to configure Amlogic drivers
		of the multimedia RDMA VSYNC function,
		it as the basis for drivers of the multimedia,
		mainly on the operation of the RDMA.
		Select to enable RDMA VSYNC.
endmenu
```

## drivers/amlogic/media/common/resource_mgr/Kconfig
```kconfig
#
# resmanage driver configuration
#

menu "ResManage driver"

config AMLOGIC_MEDIA_RESMANAGE
	tristate "RESMANAGE driver"
	default n
	help
		Select to enable AMLOGIC RESMANAGE driver to
		manage decoder resource
endmenu
```

## drivers/amlogic/media/common/uvm/Kconfig
```kconfig
#
# uvm core configuration
#


menuconfig AMLOGIC_UVM_CORE
	bool "Amlogic unified video memory management"
	default n
	help
	  say y to enable Amlogic unified video memory management.
	  The uvm core is dmabuf wrap vframe framework.

menuconfig AMLOGIC_UVM_ALLOCATOR
	bool "Amlogic uvm allocator device driver"
	default n
	select AMLOGIC_UVM_CORE
	help
	  say y to enable amlogic uvm allocator device driver.
	  gralloc will call it to allocate dmabuf fd.
```

## drivers/amlogic/media/common/vfm/Kconfig
```kconfig
#
# VFM configuration
#

config AMLOGIC_MEDIA_VFM
	bool "Amlogic VFM Support"
	default n
	help
		Select to enable VFM support

config AMLOGIC_MEDIA_VFM_GRABBER
	bool "Amlogic VFM Grabber Support"
	default n
	help
		Select to enable VFM Grabber support
```

## drivers/amlogic/media/common/vicp/Kconfig
```kconfig
#
# vicp driver configuration
#

menu "Amlogic VICP Module"

config  AMLOGIC_MEDIA_VICP
	tristate "Amlogic vicp driver"
	default n
	help
		Select to enable vicp driver.

endmenu
```

## drivers/amlogic/media/common/vpu/Kconfig
```kconfig
#
# Amlogic VPU driver configuration
#

menu "Amlogic VPU Driver Support"

config AMLOGIC_VPU
	bool "Amlogic VPU driver"
	default n
	help
		Amlogic vpu driver support.
		Manage vpu domain clock,
			memory power down,
			and vpu clock gate.
		All the video modules work on vpu domain.

config AMLOGIC_VPU_CLK_DYNAMIC_ADJ
	bool "Amlogic VPU Clock Frequency Dynamic Adjust"
	default n
	depends on AMLOGIC_VPU
	help
		Amlogic vpu frequency dynamic adjust,
		allow the vpu clk frequency adjusting dynamically by
		video modules,
		and manage the max frequency what video modules required.

endmenu
```

## drivers/amlogic/media/common/vpu_security/Kconfig
```kconfig
#
# VPU SECURITY driver configuration
#

menu "VPU SECURITY driver"

config AMLOGIC_MEDIA_SECURITY
	bool "Amlogic VPU SECURITY driver"
	default n
	help
		This option is used to configure Amlogic drivers
		of the vpu security module,
		Select to enable VPU SECURITY driver.
endmenu
```

## drivers/amlogic/media/di_local/Kconfig
```kconfig
#
# Deinterlace driver configuration
#

menu "DI_LOCAL driver"

config AMLOGIC_MEDIA_DEINTERLACE
	tristate "DI_LOCAL driver"
	default n
	help
		Select to enable AMLOGIC DEINTERLACE driver
		process interlace source need three continueed fields,
		wave progressive source with two interlace fields from
		one progreesive fields
endmenu
```

## drivers/amlogic/media/di_multi/Kconfig
```kconfig
#
# Deinterlace driver configuration
#

menu "DI_MULTI driver"

config AMLOGIC_MEDIA_DEINTERLACE
	tristate "DI_MULTI driver"
	default n
	help
		Select to enable AMLOGIC DEINTERLACE driver
		process interlace source need three continueed fields,
		wave progressive source with two interlace fields from
		one progreesive fields
endmenu
```

## drivers/amlogic/media/di_v4l/Kconfig
```kconfig
#
# Amlogic v4lvideo device configuration
#

menu "Amlogic di v4l support"

config AMLOGIC_DI_V4L
	tristate "Amlogic di v4l device support"
	depends on VIDEO_DEV
	depends on VIDEO_V4L2
	depends on VIDEOBUF2_CORE
	depends on VIDEOBUF2_MEMOPS
	depends on DMA_SHARED_BUFFER
	default n

	help
		Select to enable "Amlogic di v4l device support.

endmenu
```

## drivers/amlogic/media/enhancement/Kconfig
```kconfig
#
# Amlogic multimedia input configuration
#
menu "Amlogic Enhancement drivers"
config AMLOGIC_MEDIA_ENHANCEMENT
    bool "Amlogic driver of enhancement"
		depends on AMLOGIC_MEDIA_DRIVERS
    default n
    help
			Amlogic media enhancement support.
			Media enhancement module includes amvecm amdolby_vision amprime_sl etc.

if AMLOGIC_MEDIA_ENHANCEMENT
source "drivers/amlogic/media/enhancement/amdolby_vision/Kconfig"
source "drivers/amlogic/media/enhancement/amvecm/Kconfig"
source "drivers/amlogic/media/enhancement/amprime_sl/Kconfig"
endif

endmenu
```
