## drivers/amlogic/esm/Kconfig
```kconfig
menu "ESM Support"

if AML_HDMI_TX || TVIN_HDMI
config AML_ESM
        bool "Embedded Security Module Enable"
        default y
        help
                Embedded Security Module(ESM) for HDCP22
endif

endmenu
```

## drivers/amlogic/ethernet/Kconfig
```kconfig
#
# Amlogic Ethernet Driver configuration
#
menu "Ethernet Support"
config AM_PHY
	tristate "Amloigc PHY support"
	select NET
	help
		Ethernet controllers are usually attached to amlogic
		PHY choose devices.
if AM_PHY
source "drivers/amlogic/ethernet/phy/Kconfig"
endif
endmenu
```

## drivers/amlogic/ethernet/phy/Kconfig
```kconfig
#
# PHY Layer Configuration
#
menuconfig PHYLIB
	tristate "PHY Device support and infrastructure"
	depends on NETDEVICES
	help
	  Ethernet controllers are usually attached to PHY
	  devices.  This option provides infrastructure for
	  managing PHY devices.

if PHYLIB
comment "MII PHY device drivers"

config AML_PHY
	boolean "Drivers for AMLOGIC PHY"
	default n
	help
		Currently has a driver for the AMLOGIC INTERNAL PHY
		Support internal phy & pmu4 phy

config	AML_SMSC
	boolean "Drivers for SMSC LAN8720 PHYs"
	default n
	help
		Currently supports the LAN83C185, LAN8187 and LAN8700
		Lan8742 Lan8720 phys

config	AML_ICPLUS
	boolean "Drivers for ICPlus IP101GR PHYs"
	default n
	help
		Currently supports the IP101gr  PHYs.
		ip101gr not support wol.

config	AML_MICREL
	boolean "Driver for Micrel KSZ8091 PHYs"
	default n
	help
		Supports the KSZ9031, ksz8091, KS8001
		ksz8081 phys

config	AML_REALTEK
	boolean "Drivers for RTL8211F"
	default n
	help
		Currently supports the RTL8211F
		phys.

endif # PHYLIB
```

## drivers/amlogic/firmware/Kconfig
```kconfig
# firmware configuration
#
menu "AMLOGIC firmware boot"

config AMLOGIC_FIRMWARE
	bool "firmware bootup support"
	default n
	help
		support the amlogic firmware bootup;

endmenu
```

## drivers/amlogic/free_reserved/Kconfig
```kconfig
# Amlogic free reserved memory

config AMLOGIC_AUTO_CAPTURE
	bool "Amlogic camera auto capture"
	default n
	help
		This option is used to configure Amlogic camera auto capture.
		User space would use a block of reserved memory to save captured camera,
		then free this reserved memory after using it.
```

## drivers/amlogic/freertos/Kconfig
```kconfig
# SPDX-License-Identifier: (GPL-2.0+ OR MIT)
#
# Amlogic freertos configuration
#

config AMLOGIC_FREERTOS
	bool "Amlogic Freertos Support"
	default n
	help
	  Say Y here to enable freertos support.
```

## drivers/amlogic/gki_tool/Kconfig
```kconfig
config AMLOGIC_GKI_TOOL
	tristate "Meson gki tool"
	depends on AMLOGIC_DRIVER
	default n
	help
		provide common tools for GKI ko,
		including __setup...
```

## drivers/amlogic/global_timer/Kconfig
```kconfig
#
# Amlogic GLOBAL TIMER configuration
#
menuconfig AMLOGIC_GLOBAL_TIMER
	tristate "amlogic global timer driver"
	default n
	help
		This option enables meson global timer which is
		a multi-function timer support gpio/mipi trigger and gpio
		output and includes several parts sub module

if AMLOGIC_GLOBAL_TIMER

config AMLOGIC_GLOBAL_TIMER_CORE
	tristate "amlogic global timer core driver"
	default n
	help
		This option enables meson global timer core which is
		used to get current time stamp counter. Also, api for other
		driver, sysfs and ioctl for user land are supported.

config AMLOGIC_GLOBAL_TIMER_ISP
	tristate "amlogic global timer isp driver"
	default n
	help
		This option support time stamp for ISP to get the current counter
		of starting frame and ending frame. There are 10 such trigger
		source.

config AMLOGIC_GLOBAL_TIMER_OUTPUT
	tristate "amlogic global timer output driver"
	default n
	help
		Output pulse function is used to output specified pulse, pulse
		width, interval between pulses, oneshot or continue mode are
		supported. This function is independent among global timer
		drivers.

config AMLOGIC_GLOBAL_TIMER_INPUT
	tristate "amlogic global timer input driver"
	default n
	help
		This driver is used to latch counter value of global timer when
		specified GPIO interrupt trigger. 32 GPIOs are supported at the
		same time.

endif
```

## drivers/amlogic/gpio/Kconfig
```kconfig
#
# Amlogic MCLK GPIO configuration
#
config AMLOGIC_MCLK_GPIO
	tristate "amlogic mclk gpio driver"
	default n
	help
		This option enables meson mclk gpio driver which is
		used to config gpioq_0-4 analog pin as gpio. Enable
		it, if want to use, but only support for P1.
```

## drivers/amlogic/hdmi/Kconfig
```kconfig
#HDMITX

menu "HDMI TX Support"

config AML_HDMI_TX
    boolean "HDMI 1.4 Output Enable"
    default y
    select SWITCH
    select AM_DISPLAY_MODULE
    help
        hdmi 1.4 output enable, It should be enalbe if board have hdmi 1.4 out interface

if AML_HDMI_TX
config AML_HDMI_TX_HDCP
    boolean "HDMI HDCP Enable"
    default n
    help
        hdmitx hdcp enable, it should be enalbe if board burned hdmitx hdcp keys
endif

endmenu
```

## drivers/amlogic/hifi4dsp/Kconfig
```kconfig
# audio hifi4dsp  configuration
#
#menu "AMLOGIC HiFi4DSP process"

config AMLOGIC_HIFI4DSP
	tristate "hifi4dsp control support"
	default n
	help
		This is the Amlogic
		kernel load dsp driver
		support the amlogic hifi4dsp;

#endmenu
```

## drivers/amlogic/i2c/Kconfig
```kconfig
menu  "I2C Hardware Bus support"

config I2C_AML
	boolean "Amlogic I2C Driver"
	select I2C
	select I2C_CHARDEV
	select I2C_ALGOBIT
	help
		Yet another Amlogic I2C Driver, normal master

config I2C_SLAVE_AML
	boolean "Amlogic I2C Slave Driver"
	help
		Yet  Amlogic I2C Slave Driver

config I2C_SW_AML
	boolean "Amlogic software I2C Driver"
	select I2C
	select I2C_CHARDEV
	select I2C_ALGOBIT
	help
		Amlogic software I2C Driver, normal gpio simulate I2C, bit algo

config BCM2079X_I2C
	boolean "BCM2079X_I2C support"
	depends on I2C_AML
	help
		If you say yes here you get support for BCM2079x_I2C support

endmenu
```

## drivers/amlogic/i2c_slave/Kconfig
```kconfig
#
# Amlogic i2c device configuration
#

config MESON_I2C_SLAVE
	bool "Amlogic I2C Slave Driver"
	help
		Amlogic I2C Slave Driver.
```

## drivers/amlogic/iio/adc/Kconfig
```kconfig
#
# ADC drivers
#
# When adding new entries keep the list in alphabetical order

menu "Analog to digital converters"

config AMLOGIC_SARADC
	tristate "Amlogic Meson SAR ADC driver"
	depends on OF && COMMON_CLK && (ARCH_MESON || COMPILE_TEST)
	depends on REGMAP_MMIO
	depends on IIO
	depends on IIO_BUFFER
	depends on IIO_KFIFO_BUF
	default n
	help
	  Say yes here to build support for the SAR ADC found in Amlogic Meson
	  SoCs.

	  To compile this driver as a module, choose M here: the
	  module will be called meson_saradc.

endmenu
```

## drivers/amlogic/input/Kconfig
```kconfig
menuconfig AMLOGIC_INPUT
	bool "Amlogic input device support"
	default n
	help
	  Say Y here to enable Amlogic input
	  devices. Include keyboard, third part
	  touchscreen, sensor, gpio-key, adc-key,
	  ir remote control etc.

if AMLOGIC_INPUT

source "drivers/amlogic/input/ir/Kconfig"

source "drivers/amlogic/input/keyboard/Kconfig"

source "drivers/amlogic/input/touchscreen/Kconfig"
endif
```

## drivers/amlogic/input/avin_detect/Kconfig
```kconfig
#
# avin detect drivers configuration
#

menuconfig AMLOGIC_AVIN_DETECT
	tristate "Amlogic AVIN Detect Support"
	default n
	help
	  Say Y here to get to see options for avin detect drivers.
	  This option alone does not add any kernel code.

	  If you say N, all options in this submenu will be
	  skipped and disabled.


if AMLOGIC_AVIN_DETECT

config AML_AVIN_DETECT
	tristate "tv av-in detect module support"
	default n
	help
		Amlogic TV AV-IN detect management.


endif
```

## drivers/amlogic/input/ir/Kconfig
```kconfig
#
#Amlogic  IR Remote control drivers
#
config AMLOGIC_MESON_IR
	tristate  "Amlogic Meson IR remote control support"
	default n
	help
	  Say Y here if you want to use the Meson IR remote control.
```

## drivers/amlogic/input/keyboard/Kconfig
```kconfig
#
# Kyeboard device configuration
#

menuconfig AMLOGIC_INPUT_KEYBOARD
	bool "Keyboards and keypads"
	default n
	help
	  Say Y here, and a list of supported keyboards and keypads will be displayed.
	  This option doesn't affect the kernel.

	  If unsure, say Y.

config AMLOGIC_ADC_KEYPADS
	tristate "Meson ADC keypad support"
	depends on AMLOGIC_INPUT_KEYBOARD
	depends on MESON_SARADC
	default n
	help
	  Say Y here if you want to use the Meson ADC keypad.

config AMLOGIC_GPIO_KEY
        tristate "Amlogic gpio key device surport"
        depends on AMLOGIC_INPUT_KEYBOARD
	default n
        help
          Say Y here if you want to use the amlogic hold key.
```

## drivers/amlogic/input/remote/Kconfig
```kconfig
#
# Remote control drivers
#
menuconfig MESON_NEW_INPUT_REMOTE
	bool "GX Remotes"
	default y
	help
	  Say Y here, and a list of supported remote controls will be displayed.
	  This option doesn't affect the kernel.

	  If unsure, say Y.

if MESON_NEW_INPUT_REMOTE

config NEW_AM_REMOTE
	tristate "GX IR remote control support"
	default n
	help
	  Say Y here if you want to use the Meson IR remote control.



endif # MESON_INPUT_REMOTE
```

## drivers/amlogic/input/touchscreen/Kconfig
```kconfig
menuconfig AMLOGIC_INPUT_TOUCHSCREEN
	tristate "amlogic third-part touchscreen support"
	default n
	help
	  Say Y here, and a list of supported touchscreen driver will be displayed

	  If say N no touchscreen is displayed


if AMLOGIC_INPUT_TOUCHSCREEN

config TOUCHSCREEN_ELAN_EKTH3915N
	tristate "Goodix GT738x firmware update module"
	depends on I2C
	default n
	help
	   Say Y here if you have an Elan eKTH I2C / I2CHID touchscreen
           connected to your system.

	   If unsure, say N.

	   To compile this driver as a module, choose M here: the
	   module will be called elants_hid.

menuconfig TOUCHSCREEN_GOODIX_GT738X
	tristate "Goodix GT738x touchscreen"
	depends on I2C
	default n
	help
	  Say Y here if you have a Goodix GT738x touch controller
	  to your system.

	  If unsure, say N.

if TOUCHSCREEN_GOODIX_GT738X

config TOUCHSCREEN_GOODIX_GT738X_UPDATE
	tristate "Goodix GT738x firmware update module"
	default n
	help
	  Say Y here to enable support for doing firmware update.

	  If unsure, say N.

	  To compile this driver as a module, choose M here.

config TOUCHSCREEN_GOODIX_GT738X_GESTURE
	tristate "Goodix GT738x gesture wakeup feature"
	default n
	help
	  Say Y here to enable support for gesture wakeup feature..

	  If unsure, say N.

	  To compile this driver as a module, choose M here.

config TOUCHSCREEN_GOODIX_GT738X_TOOLS
	tristate "Goodix touch tools support"
	default n
	help
	  Say Y here to enable debug tools.

	  If unsure, say N.

	  To compile this driver as a module, choose M here.

endif

endif
```

## drivers/amlogic/input/touchscreen/gslx680/Kconfig
```kconfig
#
#  Touchscreen driver configuration
#

config  AMLOGIC_GSLX680
       tristate  "GSLX680 touchscreen driver"      
       depends on INPUT && I2C
       default m
       help
         GSLX680 touchscreen driver    
```

## drivers/amlogic/instaboot/Kconfig
```kconfig
#
# Instaboot configuration
#

config INSTABOOT
	bool "Instaboot Support"
	default n
	select HIBERNATION
	select HIBERNATE_CALLBACKS
	---help---
	  Enable it to open the instaboot basical function.
	  The instaboot is a methord which use a memory snapshot saved before
	  to boost the system boot up speed.
	  Say y if you need the function.

config INSTABOOT_MEM_MG
	bool "InstaBoot Memory Management"
	depends on INSTABOOT
	default n
	---help---
	  When doing the memory snapshot, the free memory must great than the
	  memory snapshopped, that means the free memory must be bigger enough,
	  but in the reality, the free memory is not enough every time.
	  The Instaboot Memory Management is implement for resolve that problem,
	  which will find out memory usable as more as possible.
	  Say y if you need this feature.
```

## drivers/amlogic/ionvideo/Kconfig
```kconfig
menu "Amlogic ion video support"

config VIDEOBUF2_ION
	tristate "videobuf2-ion video device support"
	select VIDEO_DEV
	select VIDEO_V4L2
	select VIDEOBUF2_CORE
	select VIDEOBUF2_MEMOPS
	select DMA_SHARED_BUFFER
	default n

	---help---
		capture ion video to user
		select to enable capture ion video to user
		enabled by default
		good luck


config AMLOGIC_IONVIDEO
	tristate "Amlogic ion video device support"
        select VIDEOBUF2_ION
	default n

	---help---
	capture ion video to user
endmenu
```

## drivers/amlogic/irblaster/Kconfig
```kconfig
#
# Amlogic IRBLASTER
#

config	AMLOGIC_IRBLASTER
	tristate "Amlogic Meson SoC irblaster driver"
	default	n
	help
	  This enable irblaster support for soc mesom (irblaster communication
	  controller) available in Amlogic Meson SoCs.
	  If you want to use meson irblaster interface,
	  say Y here.If you are not sure, say N.
```

## drivers/amlogic/ircut/Kconfig
```kconfig
config AMLOGIC_IRCUT
	tristate "Amlogic ircut support"
	default n
	help
		select y to support ircut
```
