## drivers/amlogic/pwm/Kconfig
```kconfig
#
# PWM configuration
#


menuconfig AML_PWM
	boolean "Amlogic PWM driver"
	select PWM
	select PWM_SYSFS
	default n
	help
	  say y to enable Amlogic PWM driver.

if	AML_PWM
config GX_PWM
	bool "Amlogic GXBB & GXTVBB PWM driver"
	default n
	help
	  say y to enable Amlogic PWM driver.
endif
```

## drivers/amlogic/rdma/Kconfig
```kconfig
#
# RDMA management driver configuration
#

menu "RDMA management driver"

config AML_RDMA
    bool "Amlogic RDMA management driver"
    default n
	help
	  Select to enable RDMA management driver.

endmenu
```

## drivers/amlogic/reboot/Kconfig
```kconfig
# Amlogic POWER OFF
config AMLOGIC_GX_REBOOT
	tristate "Amlogic reboot gx"
	default n
    help
		This is the Amlogic GX reboot driver.
```

## drivers/amlogic/reg_access/Kconfig
```kconfig
# Amlogic DEBUG
#
config AMLOGIC_REG_ACCESS
    tristate "Amlogic register access from userspace support"
    default n
    help
      This is the debug interface for resister and memory access from user space
```

## drivers/amlogic/regulator/Kconfig
```kconfig
# SPDX-License-Identifier: GPL-2.0-only
#
# GPIO infrastructure and drivers
#

config REGULATOR_BD2657
	tristate "ROHM BD2657 Power Regulator"
	depends on MFD_ROHM_BD2657
	help
	  This driver supports voltage regulators on ROHM BD2657 PMIC.
	  Say y to enable support for four software controllable buck
	  regulators.

	  The driver can also be built as a module. If so, the module
	  will be called bd2657-regulator.
```

## drivers/amlogic/remote/Kconfig
```kconfig
#
# Remote control drivers
#
menuconfig MESON_REMOTE
	bool "Meson Remotes"
	default y
	help
	  Say Y here, and a list of supported remote controls will be displayed.
	  This option doesn't affect the kernel.

	  If unsure, say Y.

if MESON_REMOTE

config AM_REMOTE
	tristate "Meson IR remote control support"
	default n
	help
	  Say Y here if you want to use the Meson IR remote control.



endif # MESON_REMOTE
```

## drivers/amlogic/reset/Kconfig
```kconfig
# Amlogic POWER OFF
config AML_POWER_RESET
	boolean "Amlogic Board level reset or power off"
	default n
    	help
		This is the Amlogic Board reset or poweroff  driver

config M8_POWER_RESET
	boolean "Amlogic Board level reset or power off for 32bit"
	default n
	depends on AML_POWER_RESET
    	help
		This is the Amlogic Board reset or poweroff  driver

config GXBB_POWER_RESET
	boolean "Amlogic Board level reset or power off for 64bit"
	default n
	depends on AML_POWER_RESET
    	help
		This is the Amlogic Board reset or poweroff  driver
```

## drivers/amlogic/rtc/Kconfig
```kconfig
# Amlogic RTC device module configuration
config AMLOGIC_MESON_RTC
	tristate "Amlogic Meson RTC driver"
	default n
	help
		This is the Amlogic rtc driver.
		AMLOGIC_RTC provides rtc driver for A5 and later
		of this chip.
```

## drivers/amlogic/secmon/Kconfig
```kconfig
# Amlogic secure monitor driver


config AMLOGIC_SEC
    bool "Amlogic secure monitor driver support"
    help
      This is the Amlogic secure monitor driver

config AML_SERR
	bool "workaround EL0 SErr exception handler"
	help
		This is the Amlogic EL0 SErr exception handler
```

## drivers/amlogic/smartcard/Kconfig
```kconfig
#
#Smart card driver configuration
#

config AMLOGIC_SMARTCARD
	tristate "Amlogic Smartcard driver"
	default y
```

## drivers/amlogic/soc_info/Kconfig
```kconfig
config	AMLOGIC_SOC_INFO
	bool "Amlogic soc"
	default n
	help
	  say y to enable Amlogic chipid driver.
```

## drivers/amlogic/spi/Kconfig
```kconfig
config SPI_MESON_SPI_NFC
	tristate "Amlogic Meson SPI NFC controller"
	depends on ARCH_MESON || COMPILE_TEST
	select REGMAP_MMIO
	help
	  This enables master mode support for the SPI NFC (SPI flash
	  controller with host ECC) available in Amlogic Meson SoCs.

if SPI_MESON_SPI_NFC
config AML_SPI_NFC_DISABLE_HOST_ECC
	bool "disable Host ECC Driver"
	default y
	help
	  Disable host ECC on meson SoCs.
	  It should be set when user use SPI NAND without ECC or want to use
	  Host ECC.
endif
```

## drivers/amlogic/tee_driver/Kconfig
```kconfig
# Generic Trusted Execution Environment Configuration
config AMLOGIC_TEE2
	tristate "Trusted Execution Environment support"
	select DMA_SHARED_BUFFER
	select GENERIC_ALLOCATOR
	help
	  This implements a generic interface towards a Trusted Execution
	  Environment (TEE).

if AMLOGIC_TEE2

menu "TEE drivers"

source "drivers/amlogic/tee_driver/optee/Kconfig"

endmenu

endif
```

## drivers/amlogic/tee_driver/optee/Kconfig
```kconfig
# OP-TEE Trusted Execution Environment Configuration
config AMLOGIC_OPTEE2
	tristate "OP-TEE"
	depends on HAVE_ARM_SMCCC
	help
	  This implements the OP-TEE Trusted Execution Environment (TEE)
	  driver.
```

## drivers/amlogic/thermal/Kconfig
```kconfig
#
# Amlogic temperature sensor configuration
#

menu "Amlogic Thermal and Cooling devices"

config AMLOGIC_THERMAL
	tristate "Amlgoic temperature sensor Support"
	depends on THERMAL && AMLOGIC_SEC
	default n
	help
		Thermal sensor low level support for thermal
		This driver parse thermal config data from device tree files.
		And register each cooling device for thermal framework.

		If you want this support, you should say Y here.

config AMLOGIC_COOLDEV
	bool "Amlogic cooling devices Support"
	depends on AMLOGIC_THERMAL
	default n
	help
		This implements the all cooling devices
		This will be useful for platforms using the generic thermal interface
		and not the ACPI interface.

		If you want this support, you should say Y here.

config AMLOGIC_CPUCORE_THERMAL
	bool "generic cpu core cooling support"
	depends on AMLOGIC_COOLDEV
	default n
	help
		This implements the generic cpu cooling mechanism through reduce cpu core numbers
		This will be useful for platforms using the generic thermal interface
		and not the ACPI interface.

		If you want this support, you should say Y here.

config AMLOGIC_GPU_THERMAL
	tristate "generic gpu cooling support"
	depends on AMLOGIC_COOLDEV
	default n
	help
		This implements the generic gpu cooling mechanism through frequency reduction
		This will be useful for platformas using the generic thermal interface
		and not the ACPI interface.

		If you want this support, you should say Y here.

config AMLOGIC_GPUCORE_THERMAL
	tristate "generic gpu core cooling support"
	depends on AMLOGIC_COOLDEV
	default n
	help
		This implements the generic gpu cooling mechanism through reduce gpu core numbers.
		This will be useful for platforms using the generic thermal interface
		and not the ACPI interface.

		If you want this support, you should say Y here.

config AMLOGIC_DDR_THERMAL
	tristate "generic ddr cooling support"
	depends on AMLOGIC_COOLDEV
	default n
	help
		This implements change the ddr reflash rate.
		This will be useful for platforms using the generic thermal interface
		and not the ACPI interface.

		If you want this support, you should say Y here.

endmenu
```

## drivers/amlogic/tvin/bt656/Kconfig
```kconfig
#
# BT656 Device Driver Configuration
#
config  TVIN_BT656
        tristate "Amlogic bt656 device driver"
        default n
        help
            BT656 device driver.
```

## drivers/amlogic/tvin/hdmirx/Kconfig
```kconfig
#
# HDMI Rx Device Driver Configuration
#


config TVIN_HDMI
    tristate "Amlogic HDMI RX device driver"
    default n
    help
      HDMI RX device driver.
      HDMI RX device driver.
      HDMI RX device driver.
      HDMI RX device driver.

config TVIN_HDMI_CEC
    tristate "Amlogic HDMI RX CEC device driver"
    depends on TVIN_HDMI
    default n
    help
      HDMI RX CEC device driver.
```

## drivers/amlogic/tvin/hdmirx_ext/Kconfig
```kconfig
#
# Amlogic external hdmiin chips configuration
#

menuconfig TVIN_HDMI_EXT
	bool "External hdmiin chips support"
	default y

if TVIN_HDMI_EXT

source "drivers/amlogic/tvin/hdmirx_ext/hw_sii9135/Kconfig"

endif # TVIN_HDMI_EXT
```

## drivers/amlogic/tvin/hdmirx_ext/hw_sii9135/Kconfig
```kconfig
#
# Hdmirx external SII9135 Device Driver Configuration
#

config TVIN_HDMI_EXT_SII9135
	bool "hdmirx external sii9135 support"
	depends on TVIN_HDMI_EXT
	default y
	help
		sii9135 is input with hdmi siganl, and output dvp signal.
```

## drivers/amlogic/tvin/tvafe/Kconfig
```kconfig
#
# AMLOGIC TVAFE Device Driver Configuration
#

config TVIN_AFE
	tristate "Amlogic AFE device driver"
	default n
	help
		AFE device driver,
		process input source of av/atv/vga/ypbpr/atvdemod,
		translate analog signal to digtal to vdin process

if TVIN_AFE
config ADC_DOUBLE_SAMPLING_FOR_SD
	bool "Enable double sampling function"
	default n
	help
		Adc double sampling for SD
		only for input source of Component,
		and only for Standard Definition input
		to use

config ADC_DOUBLE_SAMPLING_FOR_CVBS
	bool "Enable double sampling function for AV port"
	default n
	help
		Adc double sampling for AV port
		Only for input source of AV,
		Only support on G9TV and after G9TV
		right now,not add support on M6TV

config TVIN_VBI
	tristate "Amlogic TVIN VBI device"
	default n
	help
		VBI devices driver
		Only for ATV input,
		By now,wo only test CC is ok on M6TV & G9TV
		CC is usually used in USA
endif
```

## drivers/amlogic/tvin/vdin/Kconfig
```kconfig
#
# VDIN Device Driver Configuration
#

config TVIN_VDIN
        tristate "Amlogic VDIN device driver"
        default y
        help
            VDIN device driver.
```

## drivers/amlogic/tvin/viu/Kconfig
```kconfig
#
# Viu Device Driver Configuration
#
config VIUIN
        tristate "Amlogic VIUIN device driver"
        default n
        help
            VIUIN device driver.
```

## drivers/amlogic/uart/Kconfig
```kconfig
#
# Amlogic driver configuration
#

config AMLOGIC_UART
	tristate "Serial support"
	select SERIAL_CORE
	default n
    help
	Add support for the Amlogic serial port.
	this config only ctrl in makefile
	this config do not in meson_uart.c
	this config add

config AMLOGIC_SERIAL_MESON_CONSOLE
	bool "Console on Amlogic Serial port"
	depends on AMLOGIC_UART
	select SERIAL_CORE_CONSOLE
	select SERIAL_EARLYCON
	default n
	help
		Support for running a console on the Amlogic serial
		this config is only
		used in meson_uart.c
		so so

config AMLOGIC_PRINTK_NOBLOCK_MODE
    bool "printk with no block"
    select AMLOGIC_SERIAL_MESON_CONSOLE
    default n
    help
        printk with no block
        push tx data to internal buffer first
        default size of internal buffer is 128K
        when enabled, new_printk_enabled=1
```

## drivers/amlogic/unifykey/Kconfig
```kconfig
#
# Amlogic key management configuration
#

config AMLOGIC_UNIFYKEY
	tristate "Amlogic unifykey driver support"
	default n
	help
	    platform independent part of unifykey driver
	    y here, means select unifykey
	    n here, means don't use unifykey
```

## drivers/amlogic/usb/Kconfig
```kconfig
menu "USB Support"

config AMLOGIC_USB
	tristate "Amlogic USB controller support"
	default y
	depends on AMLOGIC_USB_HOST_ELECT_TEST
	select OF_LM
	depends on USB
	help
	   DWC_OTG
	   USB
	   host
	   controller.

config AMLOGIC_USB_DWC_OTG_HCD
	tristate "USB Host controller dwc_otg support"
	depends on AMLOGIC_USB
	help
	   USB Host
	   controller
	   dwc_otg
	   support

config AMLOGIC_CRG
        tristate "USB Host controller corigine support"
        depends on AMLOGIC_USB
        help
           USB Host
           controller
           corigine
           support

config AMLOGIC_USB_HOST_ELECT_TEST
	tristate "USB high speed electric test"
	depends on USB
	help
	   Say yes Enable this config to support USB High speed electric test,
	   othervise say no

config AMLOGIC_USBPHY
	tristate "Amlogic USB PHY Driver"
	depends on AMLOGIC_USB
	help
	  Enable this to support Amlogic USB phy helper driver for Amlogic SoCs.
	  This driver provides common interface to interact, for Amlogic USB 2.0 PHY
	  driver and later for Amlogic USB 3.0 PHY driver.

	  This driver supports GXBABYTV and G9TV.

          To compile this driver as a module, choose M here: the
          module will be called phy-aml-usb.

config AMLOGIC_USB2PHY
	tristate "Amlogic USB 2.0 PHY controller Driver"
	depends on AMLOGIC_USBPHY
	help
	  Enable this to support Amlogic USB 2.0 (High Speed) PHY controller
	  for Amlogic SoCs.

	  This driver supports GXBABYTV and G9TV.

	  To compile this driver as a module, choose M here: the
          module will be called phy-aml-usb.

config AMLOGIC_USB3PHY
	tristate "Amlogic USB 3.0 PHY controller Driver"
	depends on AMLOGIC_USBPHY
	help
	  Enable this to support Amlogic USB 3.0 (Super Speed) phy controller
	  for Amlogic SoCs.

	  This driver supports GXBABYTV and G9TV.

          To compile this driver as a module, choose M here: the
          module will be called phy-aml-usb.
endmenu
```
