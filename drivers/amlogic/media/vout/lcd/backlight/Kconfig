## drivers/amlogic/power/Kconfig
```kconfig
config AMLOGIC_POWER
	tristate "Amloigc power related driver support"
	default n
	help
		this config enables to use amlogic power management driver
		Say y here if you want power related driver(pmu/dvfs) support

if AMLOGIC_POWER
source "drivers/amlogic/power/supply/Kconfig"
endif
```

## drivers/amlogic/power/aml_dvfs/Kconfig
```kconfig
config AML_DVFS
	boolean "Amlogic DVFS interface support"
	default y
	depends on AML_POWER_SUPPORT
	help
		interface for clock adjustment and power managment

config MESON_CS_DCDC_REGULATOR
	boolean "Meson Current Source DCDC Regulator support "
	select REGULATOR
	depends on AML_DVFS
	help
		meson current source control DCDC regulator.
```

## drivers/amlogic/power/aml_pmu/Kconfig
```kconfig
menuconfig AML_PMU
	boolean "Amlogic PMU drivers"
	depends on AMLOGIC_BOARD_HAS_PMU
	select  I2C
	select  REGULATOR
	default n
	---help---
		say yes if you want add Amlogic power management unit support
if AML_PMU

config AML1212
	boolean "AML1212 driver"
	---help---
		drivers for AML1212

config AML1216
	boolean "AML1216 driver"
	---help---
		drivers for amlogic pmu AML1216

config AML1218
	boolean "AML1218 driver"
	---help---
		drivers for amlogic pmu AML1218

endif #AML_PMU
```

## drivers/amlogic/power/axp_power/Kconfig
```kconfig
menuconfig AW_AXP
	boolean "AXP Power drivers"
	select I2C
	select REGULATOR
	depends on AMLOGIC_BOARD_HAS_PMU
	default n
	---help---
		This option allows you to select AXP power driver

if AW_AXP

choice
	prompt "AXP PMU type"
	default AW_AXP20

config AW_AXP20
	boolean "AXP20 driver"
	---help---
		AXP20 driver

endchoice

config AXP_CHARGEINIT
	boolean "AXP initial charging environment set"
	default y

config AXP_CHGCHANGE
	boolean "AXP charging current set when suspend\resume\shutdown"
	default y
endif # !AW_AXP
```

## drivers/amlogic/power/supply/Kconfig
```kconfig
menuconfig AMLOGIC_POWER_SUPPLY
	tristate "Amlogic power supply class support"
	default n
	help
	  Say Y here to enable power supply class support. This allows
	  power supply (batteries, AC, USB) monitoring by userspace
	  via sysfs and uevent (if available) and/or APM kernel interface
	  (if selected below).
	  If unsure, say no.

if AMLOGIC_POWER_SUPPLY

config AMLOGIC_CHARGER_PMIC6
	tristate "Amlogic PMIC Charger Support"
	depends on AMLOGIC_MFD
	depends on AMLOGIC_MFD_PMIC6
	default n
	help
          Say Y here to enable support for the power management unit
	  provided by the Amlogic PMIC6.
	  If unsure, say no.
	  This driver can also be built as a module. If so, the module will be
	  called pmic6-charger.

config AMLOGIC_BATTERY_PMIC6
	tristate "Amlogic PMIC Fuel Gauge Support"
	depends on AMLOGIC_MFD
	depends on AMLOGIC_MFD_PMIC6
	default n
	help
          Say Y here to enable support for the power management unit
	  provided by the Fuel Gauge driver for the Amlogic PMIC.
	  If unsure, say no.
	  This driver can also be built as a module. If so, the module will be
	  called pmic6-battery.
endif
```
