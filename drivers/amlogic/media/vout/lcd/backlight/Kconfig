## drivers/amlogic/media/vout/lcd/backlight/Kconfig
```kconfig
#
# Backlight configuration
#
menu "Amlogic Backlight Support"

config AMLOGIC_BACKLIGHT
	bool "Amlogic backlight support"
	depends on BACKLIGHT_CLASS_DEVICE
	default n
	help
		Say Y here if you want to use the Amlogic backlight management.
		Backlight have five ways, including gpio, pwm, pwm_combo,
		local dimming, extern.

if AMLOGIC_BACKLIGHT
source "drivers/amlogic/media/vout/lcd/backlight/bl_extern/Kconfig"
source "drivers/amlogic/media/vout/lcd/backlight/bl_ldim/Kconfig"
endif

endmenu
```

## drivers/amlogic/media/vout/lcd/backlight/bl_ldim/Kconfig
```kconfig
#
# LDIM Device Driver Configuration
#
config AMLOGIC_BL_LDIM
	bool "Amlogic Backlight Local Dimming"
	default n
	help
		Say Y if you want to use Amlogic Local dimming.
		The role of local dimming is according to each
		image information, calculate the corresponding
		brightness values, to improve the effect of image quality

config AMLOGIC_BL_LDIM_IW7038
	bool "Amlogic local Diming Iw7038"
	depends on AMLOGIC_BL_LDIM
	default n
	help
		Spi iw7038 controller support.
		Once use the local dimming, add the spi driver
		Through the spi iw7038 to write data like brightness
		values for the local dimming

config AMLOGIC_BL_LDIM_IW7027
        bool "Amlogic local Diming Iw7027"
        depends on AMLOGIC_BL_LDIM
        default n
        help
                Spi iw7027 controller support.
		Once use the local dimming, add the spi driver
                Through the spi iw7027 to write data like brightness
                values for the local dimming

config AMLOGIC_BL_LDIM_BLMCU
        bool "Amlogic local Diming BLMCU"
        depends on AMLOGIC_BL_LDIM
        default n
        help
                Spi blmcu controller support.
		Once use the local dimming, add the spi driver
                Through the spi blmcu to write data like brightness
                values for the local dimming

config AMLOGIC_BL_LDIM_OB3350
	bool "Amlogic local Diming Iw70XX_MCU"
	depends on AMLOGIC_BL_LDIM
	default n
	help
		Spi iw70XX_MCU controller support.
		Once use the local dimming, add the spi driver for send data to mcu
		Through the spi iw70xx to write data like brightness
		values for the local dimming
```

## drivers/amlogic/media/vout/peripheral_lcd/Kconfig
```kconfig
menu "Amlogic Peripheral_lcd Support"

config AMLOGIC_PERIPHERAL_LCD
	bool "Amlogic peripheral_lcd support"
	default n
	help
		Say Y here if you want to use the Amlogic peripheral_lcd management.
		Peripheral_lcd include spi_lcd and other peripheral_lcd that you want
		to add.

endmenu
```

## drivers/amlogic/media/vout/spi/Kconfig
```kconfig
#
# Video output configuration
#

config AMLOGIC_LCD_SPI
	bool "LCD SPI Module"
	default n
	help
		Amlogic lcd spi driver support.this is based on
		display driver as LCD.
		lcd spi interface support:frame_post
		This driver is based on display driver.
```

## drivers/amlogic/media/vout/vclk_serve/Kconfig
```kconfig
#
# Amlogic VOUT_CLK_SERVE driver configuration
#

config AMLOGIC_VOUT_CLK_SERVE
	bool "Amlogic Vout_Clk_Serve Module"
	default n
	help
		Amlogic Video output Clk Server support.
		Provide display mode clk service for all of the display modules.
```

## drivers/amlogic/media/vout/vout_serve/Kconfig
```kconfig
#
# Amlogic VOUT_SERVE driver configuration
#

config AMLOGIC_VOUT_SERVE
	bool "Amlogic Vout_Serve Module"
	default n
	help
		Amlogic Video output Server support.
		Management Vout display drivers with unified api,
		Provide display mode service for all of the display modules.
		Amlogic Video output Server support.
		Management Vout display drivers with unified api,
		Provide display mode service for all of the display modules.

config AMLOGIC_VOUT2_SERVE
	bool "Amlogic Vout2_Serve Module"
	default n
	help
		Amlogic Video output2 Server support.
		Management Vout display drivers with unified api,
		Provide 2nd display mode service for all of the display modules.

config AMLOGIC_VOUT3_SERVE
	bool "Amlogic Vout3_Serve Module"
	default n
	help
		Amlogic Video output3 Server support.
		Management Vout display drivers with unified api,
		Provide 3rd display mode service for all of the display modules.
```

## drivers/amlogic/media/vpp/Kconfig
```kconfig
#
# Deinterlace driver configuration
#

menu "VPP driver"

config AMLOGIC_MEDIA_VPP
	tristate "VPP driver"
	default n
	help
		Select to enable AMLOGIC video post process driver
		process video pq modules
endmenu
```

## drivers/amlogic/media/vpq/Kconfig
```kconfig
#
# Vpq driver configuration
#


config AMLOGIC_MEDIA_VPQ
	tristate "VPQ driver"
	default n
	help
		Select to enable AMLOGIC vpq process driver
		process hal pq modules
```

## drivers/amlogic/media/vrr/Kconfig
```kconfig
#
# AMLOGIC VRR Driver configuration
#

comment "Amlogic VRR Drivers"

menu "Amlogic VRR Driver"

config AMLOGIC_MEDIA_VRR
        bool "Amlogic VRR driver"
        default n
        help
            Amlogic VRR module init
            select to enable amlogic VRR driver
endmenu
```

## drivers/amlogic/media_modules/Kconfig
```kconfig
#
# Amlogic Video Decoders configuration
#

menu "Video Decoders"
	depends on AMLOGIC_MEDIA_VIDEO

config AMLOGIC_MEDIA_VDEC_MPEG12
	tristate "Amlogic MPEG1/2 Video decoder"
	default m
	help
	  Driver for mpeg1/2 video decoder.
	  select AM_PTSSERVER...
	  select for build for support mpeg1 &2

config AMLOGIC_MEDIA_VDEC_MPEG2_MULTI
	tristate "Amlogic MMPEG2 Video decoder"
	default m
	help
	  Driver for Mmpeg2 video decoder.

config AMLOGIC_MEDIA_VDEC_MPEG4
	tristate "Amlogic MPEG4 Video decoder"
	default m
	help
	  Driver for mpeg4 video decoder.

config AMLOGIC_MEDIA_VDEC_MPEG4_MULTI
	tristate "Amlogic MMPEG4 Video decoder"
	default m
	help
	  Driver for Mmpeg4 video decoder.

config AMLOGIC_MEDIA_VDEC_VC1
	tristate "Amlogic VC1 Video decoder"
	default m
	help
	  Driver for vc1 video decoder.

config AMLOGIC_MEDIA_VDEC_H264
	tristate "Amlogic H264 Video decoder"
	default m
	help
	  Driver for h264 video decoder.

config AMLOGIC_MEDIA_VDEC_H264_MULTI
	tristate "Amlogic MH264 Video decoder"
	default m
	help
	  Driver for Mh264 video decoder.

config AMLOGIC_MEDIA_VDEC_H264_MVC
	tristate "Amlogic H264MVC Video decoder"
	default m
	help
	  Driver for h264mvc video decoder.

config AMLOGIC_MEDIA_VDEC_H265
	tristate "Amlogic H265 Video decoder"
	default m
	help
	  Driver for h265 video decoder.

config AMLOGIC_MEDIA_VDEC_VP9
	tristate "Amlogic VP9 Video decoder"
	default m
	help
	  Driver for vp9 video decoder.

config AMLOGIC_MEDIA_VDEC_MJPEG
	tristate "Amlogic MJPEG Video decoder"
	default m
	help
	  Driver for mjpeg video decoder.

config AMLOGIC_MEDIA_VDEC_MJPEG_MULTI
	tristate "Amlogic MMJPEG Video decoder"
	default m
	help
	  Driver for Mmjpeg video decoder.

config AMLOGIC_MEDIA_VDEC_REAL
	tristate "Amlogic REAL Video decoder"
	default m
	help
	  Driver for real video decoder.

config AMLOGIC_MEDIA_VDEC_AVS
	tristate "Amlogic AVS Video decoder"
	default m
	help
	  Driver for avs video decoder.

config AMLOGIC_MEDIA_VDEC_AVS_MULTI
	tristate "Amlogic AVS Multi Video decoder"
	default m
	help
	  Driver for avs multi video decoder.

config AMLOGIC_MEDIA_VDEC_AVS2
	tristate "Amlogic AVS2 Video decoder"
	default m
	help
	  Driver for avs2 video decoder.

config AMLOGIC_MEDIA_VDEC_AV1
	tristate "Amlogic AV1 Video decoder"
	default m
	help
	  Driver for av1 video decoder.

config AMLOGIC_MEDIA_VENC_H264
	tristate "Amlogic H264 Encoder support"
	default m
	help
	  Internal H264 Encoder driver.

config AMLOGIC_MEDIA_VENC_H265
	tristate "Amlogic HEVC Encoder support"
	default m
	help
	  Internal Hevc Encoder driver.

config AMLOGIC_MEDIA_VENC_MULTI
	tristate "Amlogic Multi Encoder support"
	default m
	help
	  Internal Multi Encoder driver.

config AMLOGIC_MEDIA_VENC_JPEG
	tristate "Amlogic JPEG Encoder support"
	default m
	help
	  Internal Jpeg Encoder driver.

endmenu
```

## drivers/amlogic/memory_ext/Kconfig
```kconfig
menuconfig AMLOGIC_MEMORY_EXTEND
	bool "AMLOGIC memory extend support"
	depends on AMLOGIC_DRIVER
	depends on AMLOGIC_MODIFY
	default n
	help
		Amlogic memory extend is drivers which extend for memory management
		functions, can be used for memory debug or other features.

config AMLOGIC_PAGE_TRACE
	bool "Amlogic trace for page allocate"
	depends on AMLOGIC_MEMORY_EXTEND
	depends on KALLSYMS
	depends on !NUMA_BALANCING
	default n
	help
		Amlogic page trace will record function address of caller for page
		allocate/free, according with allocate flags and order. trace
		information is stored in a pre-allocated memory block. And can be shown
		with allocate page count information of each caller functions from
		/proc/pagetrace

config AMLOGIC_SLAB_TRACE
	bool "Amlogic trace for slab usage"
	depends on SLUB
	depends on AMLOGIC_PAGE_TRACE
	default n
	help
		Amlogic slab trace will record function address of caller for slab
		allocate/free(kmalloc-xxxx only). trace information is stored in
		a rb tree. And can be shown with allocate size information of
		each caller functions from /proc/slabtrace

config AMLOGIC_RAMDUMP
	bool "Amlogic RAM DUMP support"
	depends on AMLOGIC_MEMORY_EXTEND
	depends on PANIC_TIMEOUT != 0
	default n
	help
		RAM dump support for amlogic platform, when system is rebooted
		after panic/watch dog reboot, you may need this option to save
		whole ram to /data/ partition. Which can be used for analyze
		crash reason.

config AMLOGIC_KDUMP
	bool "Amlogic KDUMP support"
	depends on KEXEC_CORE
	default n
	help
		kdump support for amlogic android platform, when system is rebooted
		after panic/watch dog reboot, you may need this option to save
		whole ram to /data/ partition. Which can be used for analyze
		crash reason.

config AMLOGIC_CMA
	bool "Amlogic CMA change"
	depends on AMLOGIC_MEMORY_EXTEND
	depends on CMA
	default n
	help
		Amlogic CMA optimization for cma alloc/free problems
		Including policy change of CMA usage

config AMLOGIC_VMAP
	bool "Amlogic kernel stack"
	depends on AMLOGIC_MEMORY_EXTEND
	select AMLOGIC_STACKPROTECTOR
	default n
	help
		This config is used to enable amlogic kernel stack
		usage optimization with vmalloc. It depends on
		AMLOGIC_MEMORY_EXTEND. This config only opened
		on 64 bit platform.

config AMLOGIC_VMALLOC_SHRINKER
	bool "Amlogic vmalloc shrinker"
	depends on AMLOGIC_MEMORY_EXTEND
	depends on 64BIT
	default n
	help
		This config is used to enable amlogic vmalloc shrinker
		function, it will compress/decompress vmalloc memory to zram
		in order to save memory. It depends on AMLOGIC_MEMORY_EXTEND.

config AMLOGIC_STACKPROTECTOR
	bool "Amlogic stack protector"
	depends on AMLOGIC_MEMORY_EXTEND
	default n
	help
		This config is used to disable CONFIG_STACKPROTECTOR
		if enabled AMLOGIC_VMAP. CONFIG_STACKPROTECTOR have
		bad effect to save stack usage.

config AMLOGIC_WATCHPOINT
	tristate "Amlogic point driver"
	depends on HAVE_HW_BREAKPOINT
	depends on AMLOGIC_MEMORY_EXTEND
	default n
	help
		This driver export a debug sysfs in order
		to using watch point function on ARMv8.
		say y to enable Amlogic watch point driver

config AMLOGIC_MEM_DEBUG
	bool "Amlogic debug mem"
	depends on AMLOGIC_DEBUG
	default n
	help
		Memory debug which hacking to kernel mm source.
		Enable if doubt.

config AMLOGIC_PIN_LOCKED_FILE
	bool "Amlogic pin locked file"
	depends on AMLOGIC_MEMORY_EXTEND
	default n
	help
		If we pin a file in android, the whole daa of this
		file will be loaded to DDR, but most of these data
		may not be used, this caused memory waste.
		delay mark mlocked flags for unevictable pages until
		it has been faulted.

config AMLOGIC_PCIE_DMA_OPS
	tristate "Amlogic PCIE dma_ops"
	depends on AMLOGIC_MEMORY_EXTEND
	default n
	help
		custom a dma_ops to limit the memory for PCIE device
		operations to a fixed area

config AMLOGIC_FAKE_SMMU
	tristate "Amlogic fake smmu"
	depends on AMLOGIC_MEMORY_EXTEND
	depends on AMLOGIC_PCIE_DMA_OPS
	default n
	help
		Register a fake smmu device to replace ops for 64bit
```

## drivers/amlogic/mfd/Kconfig
```kconfig
# SPDX-License-Identifier: GPL-2.0-only
#

config MFD_ROHM_BD2657
	tristate "ROHM BD2657 Power Management IC"
	depends on I2C=y
	depends on OF
	select REGMAP_I2C
	select REGMAP_IRQ
	select MFD_CORE
	help
	  Select this option to get support for the ROHM BD2657
	  Power Management ICs. BD2657 is intended to be used for systems
	  powered by one Li-Ion or Li-Ion polymer battery cell, or by an
	  input from 2.85 V to 5.5 V. The device provides 4 buck
	  converters supporting dynamic voltage scaling. Programmable
	  output voltage, sequencing and power state control support a
	  wide variety of processors and system implementations.
```

## drivers/amlogic/mfh/Kconfig
```kconfig
# firmware configuration
#
menu "MESON MHU M4 Support"
config AMLOGIC_MFH_MODULE
	tristate "firmware bootup support"
	default n
	help
		firmware bootup support.
                If you want this support, you should say Y here.
endmenu
```

## drivers/amlogic/mkl/Kconfig
```kconfig
menu "Amlogic MKL Support"

config AMLOGIC_MKL
	tristate "amlogic manufacturer keyladder driver"
	depends on AMLOGIC_KT
	default y
	help
		MKL driver supporting the ETSI/AML keyladder.
		This module gets KL keys deposited into KeyTable with usage flags.

endmenu
```

## drivers/amlogic/mtd/Kconfig
```kconfig
#
# Amlogic MTD RESERVED AREA MANAGEMENT configuration
#

menu "Meson MTD RESERVED AREA MANAGEMENT Support"

config MTD_RESV_MESON
	tristate "AMLOGIC MTD reserve area management"
	depends on MTD_NAND_MESON
	help
		Implements a reserve area which is used
		to manage the bbt/key/dtd/env and so on.
		we pre-allocate fixed blocks and list these
		blocks base on different usage, such as bbt,
		key. it is efficiently for power lost and
		backups and others.
endmenu
```

## drivers/amlogic/pci/Kconfig
```kconfig
menuconfig AMLOGIC_PCIE
	tristate "Amlogic pcie"
	default n
	help
	This selects support for the Amlogic PCIE Host Controller
	found on the MESON family of SoCs.  This controller is
	GEN2 compliant.
	If you have a controller with this interface, say Y here.

config AMLOGIC_PCIE_RC
	bool "amlogic pcie rc"
	depends on AMLOGIC_PCIE
	depends on PCI_MSI_IRQ_DOMAIN
	default n
	help
	This selects support for the Amlogic PCIE Host Controller
	found on the MESON family of SoCs.  This controller is
	GEN2 compliant.
	If you have a controller with this interface, say Y here.

config AMLOGIC_PCIE_V3
	bool "amlogic pcie v3"
	depends on PCI_MSI_IRQ_DOMAIN
	default n
	help
	This selects support for the Amlogic PCIE Host Controller
	found on the MESON family of SoCs.  This controller is
	GEN2 compliant.
	If you have a controller with this interface, say Y here.
```

## drivers/amlogic/pinctrl/Kconfig
```kconfig
menuconfig AMLOGIC_PINCTRL
	bool "Amlogic PINCTRL/GPIO support"
	depends on PINCTRL_MESON

if AMLOGIC_PINCTRL

config PINCTRL_MESON_TM2
	bool "Meson tm2 Soc pinctrl driver"
	select PINCTRL_MESON_AXG_PMX
	select PINCONF_MESON_DRIVE_STRENGTH if AMLOGIC_MODIFY
	depends on ARM64 || ARM
	default n

endif
```

## drivers/amlogic/pixel_probe/Kconfig
```kconfig
#
# Amlogic pixel probe driver
#
config AMLOGIC_PIXEL_PROBE
	bool "Amlogic pixel probe control"
	default n
	help
		This is the Amlogic pixel probe driver
		this config only ctrl in makefile
```

## drivers/amlogic/pm/Kconfig
```kconfig
# Amlogic GPIO


config MESON_SUSPEND
    boolean "Meson suspend driver"
    select WAKELOCK
    help
      This is the Amlogic suspend  driver

config M8M2_SUSPEND
    boolean "Meson suspend driver for 32bit"
    depends on MESON_SUSPEND
    help
      This is the Amlogic suspend  driver

config GXBB_SUSPEND
    boolean "Meson suspend driver for 64bit"
    depends on MESON_SUSPEND
    help
      This is the Amlogic suspend  driver
```

## drivers/amlogic/pmu4/Kconfig
```kconfig
config AML_PMU4
	boolean "Amlogic PMU4 drivers"
	select  I2C
	default n
	---help---
		say yes if you want add Amlogic PMU4 support
```
