## drivers/amlogic/media/enhancement/amdolby_vision/Kconfig
```kconfig
#
# AMLOGIC amdolby_vision devices configuration
#

comment "Amlogic amdolby_vision Drivers"

menu "Amlogic amdolby_vision Driver"

config AMLOGIC_MEDIA_ENHANCEMENT_DOLBYVISION
        tristate "Amlogic amdolby_vision driver"
        default n
        help
        	Select to enable amlogic amdolby_vision support
                "Amlogic amdolby_vision module init"

endmenu
```

## drivers/amlogic/media/enhancement/amprime_sl/Kconfig
```kconfig
#
# AMLOGIC amprime_sl devices configuration
#

comment "Amlogic amprime_sl Drivers"

menu "Amlogic amprime_sl Driver"

config AMLOGIC_MEDIA_ENHANCEMENT_PRIME_SL
	tristate "Amlogic Prime SL driver"
        bool "Amlogic amprime_sl driver"
        default n
        help
		Select to enable amlogic prime_sl support
                "Amlogic amprime_sl module init"

endmenu
```

## drivers/amlogic/media/frame_sync/Kconfig
```kconfig
#
# frame sync configuration
#

config AMLOGIC_MEDIA_FRAME_SYNC
        bool "Amlogic frame sync Support"
        default n
        help
                Select to enable frame sync support
```

## drivers/amlogic/media/frc/Kconfig
```kconfig
#
# frame sync configuration
#

config AMLOGIC_MEDIA_FRC
        bool "Amlogic FRC Support"
        default n
        help
                Select to enable frc support
```

## drivers/amlogic/media/gdc/Kconfig
```kconfig
#
# gdc driver configuration
#
config AMLOGIC_MEDIA_GDC
	tristate "Amlogic gdc driver"
	default n
	help
		Select to enable gdc driver.
```

## drivers/amlogic/media/info/Kconfig
```kconfig
#
# Amlogic multimedia information
#
config AMLOGIC_MEDIA_INFO
	bool "Multimedia Information"
	default n
	help
		Amlogic multimedia information support
```

## drivers/amlogic/media/video_processor/Kconfig
```kconfig
#
# Amlogic video processor configuration
#

menu "Amlogic Video Processor Support"

config AMLOGIC_MEDIA_VIDEO_PROCESSOR
	bool "Amlogic Video Processor Driver"
	default n
	help
		Amlogic Video Processor module support,
		such as ION_VIDEO, PPMGR, AML_V4L_VIDEO and etc,
		both of which depends on this
		configuration options.

if AMLOGIC_MEDIA_VIDEO_PROCESSOR
source "drivers/amlogic/media/video_processor/ppmgr/Kconfig"
source "drivers/amlogic/media/video_processor/utils/Kconfig"
source "drivers/amlogic/media/video_processor/videosync/Kconfig"
source "drivers/amlogic/media/video_processor/pic_dev/Kconfig"
source "drivers/amlogic/media/video_processor/video_dev/Kconfig"
source "drivers/amlogic/media/video_processor/ionvideo/Kconfig"
source "drivers/amlogic/media/video_processor/v4lvideo/Kconfig"
source "drivers/amlogic/media/video_processor/video_composer/Kconfig"
source "drivers/amlogic/media/video_processor/videotunnel/Kconfig"
source "drivers/amlogic/media/video_processor/vdetect/Kconfig"
source "drivers/amlogic/media/video_processor/videoqueue/Kconfig"
source "drivers/amlogic/media/video_processor/common/Kconfig"
endif

endmenu
```

## drivers/amlogic/media/video_processor/common/Kconfig
```kconfig
#
# Amlogic video_pp_common device configuration
#

menu "Amlogic video_pp_common support"

config AMLOGIC_VIDEO_PP_COMMON
	tristate "Amlogic video_pp_common device support"
	select VIDEO_DEV
	default n

	help
		Select to enable "Amlogic video_pp_common device support.

endmenu
```

## drivers/amlogic/media/video_processor/di_process/Kconfig
```kconfig
# SPDX-License-Identifier: (GPL-2.0+ OR MIT)

#
# Amlogic di_process device configuration
#

menu "Amlogic di_process support"

config AMLOGIC_DI_PROCESS
	tristate "Amlogic di_process device support"
	default n

	help
		Select to enable "Amlogic di_process device support.

endmenu
```

## drivers/amlogic/media/video_processor/pic_dev/Kconfig
```kconfig
#
# Amlogic picture decoder device configuration
#

menu "Amlogic picture decoder support"

config AMLOGIC_PIC_DEC
		tristate "Amlogic picture decoder"
		default n
		select AM_PTSSERVER
		help
			This option is used to configure Amlogic driver
			for picture decoder.
			Select to enable picture decoder.
			Disable by default.

endmenu
```

## drivers/amlogic/media/video_processor/ppmgr/Kconfig
```kconfig
#
# Post Process Manager device configuration
#

menu "Post Process Manager driver"

config AMLOGIC_POST_PROCESS_MANAGER
    tristate "Amlogic Post Process Manager driver"
    default n
	help
	  Select to
	  enable Amlogic Post Process Manager driver
	  in system
	  Disabled by default

endmenu
```

## drivers/amlogic/media/video_processor/utils/Kconfig
```kconfig
#
# Amlogic video frame queue configuration
#

menu "Video frame queue Support"

config AMLOGIC_MEDIA_UTILS
		tristate "Amlogic video frame queue support"
		select VIDEOBUF_GEN
		depends on AMLOGIC_MEDIA_GE2D
		default n
		help
			This module provides common interface
			like video frame queue and etc
			Such as using vfq_full interface and so on
			good luck

endmenu
```

## drivers/amlogic/media/video_processor/v4lvideo/Kconfig
```kconfig
#
# Amlogic v4lvideo device configuration
#

menu "Amlogic v4l video support"

config AMLOGIC_V4L_VIDEO3
	tristate "Amlogic v4l video3 device support"
	depends on VIDEO_DEV
	depends on VIDEO_V4L2
	depends on VIDEOBUF2_CORE
	depends on VIDEOBUF2_MEMOPS
	depends on DMA_SHARED_BUFFER
	default n

	help
		Select to enable "Amlogic v4l video3 device support.

endmenu
```

## drivers/amlogic/media/video_processor/vdetect/Kconfig
```kconfig
#
# Amlogic video2 device configuration
#

menu "V4L2 Video Support"

config AMLOGIC_VDETECT
	tristate "Amlogic v4l vdetect device support"
	default n

		help
				Select to enable "Amlogic v4l vdetect device support.
endmenu
```

## drivers/amlogic/media/video_processor/video_composer/Kconfig
```kconfig
#
# Amlogic video_composer device configuration
#

menu "Amlogic video_composer support"

config AMLOGIC_VIDEO_COMPOSER
	tristate "Amlogic video_composer device support"
	select VIDEO_DEV
	default n

	help
		Select to enable "Amlogic video_composer device support.

endmenu
```

## drivers/amlogic/media/video_processor/videoqueue/Kconfig
```kconfig
#
# Amlogic videoqueue device configuration
#

menu "Amlogic videoqueue support"

config AMLOGIC_VIDEOQUEUE
	tristate "amlogic videoqueue device support"
	default n

	help
		Select to enable "Amlogic videoqueue device support.

endmenu
```

## drivers/amlogic/media/video_processor/videosync/Kconfig
```kconfig
menu "Amlogic videosync support"

config AMLOGIC_VIDEOSYNC
	tristate "amlogic videosync device support"
	select VIDEO_DEV
	default n

	help
		This module provides Amlogic videosync support
		select to enable video sync to player
		enabled by default
		good luck

endmenu
```

## drivers/amlogic/media/video_processor/videotunnel/Kconfig
```kconfig
#
# Amlogic videotunnel device configuration
#

menu "Amlogic video tunnel support"

config AMLOGIC_VIDEO_TUNNEL
	tristate "Amlogic video tunnel device support"
	default n

	help
		Select to enable "Amlogic videotunnel device support.

endmenu
```

## drivers/amlogic/media/video_sink/Kconfig
```kconfig
#
# Amlogic video Sink configuration
#

menu "Amlogic Video Sink Driver Support"

config AMLOGIC_MEDIA_VIDEO
	bool "Amlogic Video Sink Driver"
	default n
	help
		Amlogic Video Sink module support.
		This module driver include basic
		video, vpp etc.

if AMLOGIC_MEDIA_VIDEO

config  AMLOGIC_MEDIA_VSYNC_RDMA
	bool "VSYNC CBUS RDMA"
	default n
    depends on AMLOGIC_MEDIA_RDMA
	help
		Amlogic Video Media RDMA support.
		Select to enable VSYNC CBUS RDMA.

endif

config AMLOGIC_MEDIA_VIDEOCAPTURE
    bool "Amlogic Video Capture support"
    default n
    help
		Amlogic Video Media Capture support.
		Internal Video Capture driver.

config AMLOGIC_MEDIA_DUMMY_PROVIDER
    bool "Amlogic Dummy Video Provider"
    default n
    help
	Amlogic Video Media Dummy Provider support
	Internal Dummy Video Provider driver

endmenu
```

## drivers/amlogic/media/vin/adc/Kconfig
```kconfig
#
# ADC Device Driver Configuration
#
config AMLOGIC_MEDIA_ADC
        tristate "Amlogic ADC device driver"
        default n
        help
            ADC device driver.
```

## drivers/amlogic/media/vout/Kconfig
```kconfig
#
# Amlogic vout driver configuration
#

menu "Amlogic Vout Driver Support"

config AMLOGIC_VOUT
	bool "Amlogic Vout Driver"
	default n
	help
		Amlogic Video output module support.
		Vout module includes HDMI-TX, CVBS, PANEL(LCD, backlight) etc.
		Also provide display mode service for all the display modules.
		Amlogic Video output module support.
		Vout module includes HDMI-TX, CVBS, PANEL(LCD, backlight) etc.
		Also provide display mode service for all the display modules.

if AMLOGIC_VOUT
source "drivers/amlogic/media/vout/vclk_serve/Kconfig"
source "drivers/amlogic/media/vout/lcd/Kconfig"
source "drivers/amlogic/media/vout/peripheral_lcd/Kconfig"
source "drivers/amlogic/media/vout/vout_serve/Kconfig"
source "drivers/amlogic/media/vout/hdmitx21/Kconfig"
source "drivers/amlogic/media/vout/hdmitx/Kconfig"
source "drivers/amlogic/media/vout/cvbs/Kconfig"
source "drivers/amlogic/media/vout/vdac/Kconfig"
endif

endmenu
```

## drivers/amlogic/media/vout/cvbs/Kconfig
```kconfig
#
# Video output configuration
#

config AMLOGIC_CVBS_OUTPUT
	bool "CVBS Output Module"
	default n
	help
		Amlogic cvbs output driver support.this is based on
		display driver as HDMI,LCD.
		cvbs output mode support:480cvbs 576cvbs.
		cvbs output performance enhancement.cvbs encoding.
		This driver is based on display driver.

config AMLOGIC_WSS
	bool "WSS function"
	default n
	depends on AMLOGIC_CVBS_OUTPUT
	help
		Wide Screen Signalling config.
		base on amlogic cvbs output driver.
		function cgms-a,wide screen,closed caption.

config AML_VOUT_CC_BYPASS
        bool "closed caption bypass"
        default n
        depends on AMLOGIC_CVBS_OUTPUT
        help
                add cvbsout closed caption bypass function
```

## drivers/amlogic/media/vout/dsc/Kconfig
```kconfig
#
# DSC_ENCODER
#
menu "Amlogic DSC_ENCODER Module"

config AMLOGIC_DSC
	bool "AMLOGIC DSC_ENCODER driver"
	default n
	help
	This option is used to configure Amlogic drivers
        of the dsc encoder

endmenu
```

## drivers/amlogic/media/vout/hdmitx/Kconfig
```kconfig
#
# HDMITX
#
menu "Amlogic HDMITX Module"

config AMLOGIC_HDMITX
	bool "AMLOGIC HDMITX driver"
	default n
	help
	This option is used to configure Amlogic drivers
        of the hdmi tx output

endmenu
```

## drivers/amlogic/media/vout/hdmitx21/Kconfig
```kconfig
#
# HDMITX
#
menu "Amlogic HDMITX Module"

config AMLOGIC_HDMITX21
	select HDMI
	bool "AMLOGIC HDMITX21 driver"
	default n
	help
	This option is used to configure Amlogic drivers
        of the hdmi tx output

endmenu
```
