## drivers/amlogic/Kconfig
```kconfig
config AMLOGIC_GKI
	bool "Amlogic GKI macro"
	default n
	help
		This macro controls GKI module build behavior, if enabled
		some internal code will be build as external module

config AMLOGIC_MODIFY
	bool "Amlogic modify for kernel code"
	default n
	help
		This option is set up for AMLOGIC modify of standard
		kernel source code. All modify of kernel standard code
		should be wrapped by this config

config AMLOGIC_ANDROIDP
	bool "Amlogic modify kernel in project androidp"
	default n
	help
		This option is set up for AMLOGIC modify of standard
		kernel source code in project androidp.

config AMLOGIC_REMOVE_OLD
	bool "Amlogic remove old soc code for g12a previous"
	default n
	help
		This option is set up for removing code for G12A
		previous.All modify of not used code should be
		wrapped by this config

config AMLOGIC_ARMV8_AARCH64
	bool "AARCH64 kernel support for Amlogic ARMv8 Soc"
	depends on AMLOGIC_MODIFY || COMPILE_TEST
	default n
	help
	  aarch32 and aarch64 kernels are supported for armv8 socs.
	  enable this config to select 64 bit kernel.
	  Select Y if doult.

config AMLOGIC_DRIVER
	bool "Amlogic Peripheral drivers"
	depends on AMLOGIC_MODIFY
	default n
	help
		this option is provided for control amlogic
		drivers, if you want to use amlogic driver
		please open it.
		Note: All amlogic driver should be placed in
		this directory

config AMLOGIC_ALLYESCONFIG
	bool "Amlogic compile config option"
	default n
	help
		This option is set up for masking frame size
		limit in drivers/Makefile file. When we compile
		kernel with --allyesconfig, we not limit the
		frame size.

config AMLOGIC_MEDIA_V4L_DEC
	bool "enable amlogic v4l decode module."
	default n
	help
		Support v4L protocol based decoding components.
		Decoding is done by AmLogic hardware, and if you
		need to support this feature, you need to enable
		this configuration item.


#
# Amlogic DVB configuration
#

menu "Amlogic dvb configuration"

config AMLOGIC_DVB
	tristate "Amlogic dvb support"
	depends on DVB_CORE && AMLOGIC_DVB_COMPAT
	default n
	help
		This option is used only to control the
		compilation of dvb related driver code, for
		example hw_demux, it is enabled by default,
		When it is turned on,it will automatically
		select DVB_CORE and AMLOGIC_DVB_COMPAT.

config AMLOGIC_DVB_COMPAT
	tristate "Compat amlogic dvb"
	depends on DVB_CORE
	default n
	help
		This option is used only to compatible with
		amlogic dvb related code, for example dvb-core,
		it is enabled by default,depending on
		AMLOGIC_DVB and DVB_CORE.

config AMLOGIC_MFD
	tristate "Compat amlogic mfd"
	default n
	help
		This option is used only to compatible with
		amlogic dvb related code,it is enabled by
		default,depending on
		AMLOGIC_MFD.

config AMLOGIC_REGULATOR
	tristate "Compat amlogic mfd"
	default n
	help
		This option is used only to compatible with
		amlogic mfd related code,it is enabled
		by default,depending on
		AMLOGIC_REGULATOR.

endmenu

if AMLOGIC_DRIVER
menu "Amlogic Device Drivers"
# Please add folders in alphabetical order

source "drivers/amlogic/algorithm/Kconfig"
source "drivers/amlogic/cpufreq/Kconfig"
source "drivers/amlogic/efuse_unifykey/Kconfig"
source "drivers/amlogic/ddr_tool/Kconfig"
source "drivers/amlogic/crypto/Kconfig"
source "drivers/amlogic/secmon/Kconfig"
source "drivers/amlogic/mailbox/Kconfig"
source "drivers/amlogic/reg_access/Kconfig"
source "drivers/amlogic/media/Kconfig"
source "drivers/amlogic/pci/Kconfig"
source "drivers/amlogic/thermal/Kconfig"
source "drivers/amlogic/clk_debug/Kconfig"
source "drivers/amlogic/input/Kconfig"
source "drivers/amlogic/tee/Kconfig"
source "drivers/amlogic/jtag/Kconfig"
source "drivers/amlogic/reboot/Kconfig"
source "drivers/amlogic/gki_tool/Kconfig"
source "drivers/amlogic/hifi4dsp/Kconfig"
source "drivers/amlogic/dvb/Kconfig"
source "drivers/amlogic/drm/Kconfig"
source "drivers/amlogic/irblaster/Kconfig"

source "drivers/amlogic/cpuidle/Kconfig"
source "drivers/amlogic/defendkey/Kconfig"
source "drivers/amlogic/free_reserved/Kconfig"
source "drivers/amlogic/usb/Kconfig"
source "drivers/amlogic/pm/Kconfig"
source "drivers/amlogic/power/Kconfig"
source "drivers/amlogic/debug/Kconfig"
source "drivers/amlogic/memory_ext/Kconfig"
source "drivers/amlogic/bluetooth/Kconfig"
source "drivers/amlogic/wifi/Kconfig"
source "drivers/amlogic/uart/Kconfig"
source "drivers/amlogic/smartcard_sc2/Kconfig"
source "drivers/amlogic/mtd/Kconfig"
source "drivers/amlogic/led/Kconfig"
source "drivers/amlogic/ledring/Kconfig"
source "drivers/amlogic/amaudio/Kconfig"
source "drivers/amlogic/audiodsp/Kconfig"
source "drivers/amlogic/audioinfo/Kconfig"
source "drivers/amlogic/dolby_fw/Kconfig"
source "drivers/amlogic/cpu_info/Kconfig"
source "drivers/amlogic/ethernet/phy/Kconfig"
source "drivers/amlogic/soc_info/Kconfig"
source "drivers/amlogic/gator-driver/Kconfig"
source "drivers/amlogic/global_timer/Kconfig"
source "drivers/amlogic/mfd/Kconfig"
source "drivers/amlogic/regulator/Kconfig"
source "drivers/amlogic/mfh/Kconfig"
source "drivers/amlogic/i2c_slave/Kconfig"
source "drivers/amlogic/aml_hwspinlock/Kconfig"
source "drivers/amlogic/rtc/Kconfig"
source "drivers/amlogic/iio/Kconfig"
source "drivers/amlogic/asr/Kconfig"
source "drivers/amlogic/mkl/Kconfig"
source "drivers/amlogic/freertos/Kconfig"

source "drivers/amlogic/aes_hwkey_gcm/Kconfig"

endmenu
endif
```

## drivers/amlogic/aes_hwkey_gcm/Kconfig
```kconfig
config	AES_HWKEY_GCM
	bool "AES-GCM using HW Unique Key"
	default n
	help
	  say y to enable
	  AES_HWKEY_GCM
```

## drivers/amlogic/algorithm/Kconfig
```kconfig
#
# Amlogic multimedia algorithm configuration
#

menu "Amlogic multimedia algorithm configuration"

config AMLOGIC_MEDIA_ALGORITHM
	tristate "Amlogic Multimedia Algorithm Support"
	default m
	help
		Amlogic multimedia algorithm include:
		dnlp
		hdr10
		sl_hdr
		ldim
		frc

if AMLOGIC_MEDIA_ALGORITHM
#source "drivers/amlogic/algorithm/ldim/Kconfig"
#source "drivers/amlogic/algorithm/dnlp/Kconfig"
#source "drivers/amlogic/algorithm/common/Kconfig"
#source "drivers/amlogic/algorithm/frc/Kconfig"
endif

endmenu
```

## drivers/amlogic/algorithm/common/Kconfig
```kconfig
#
# Amlogic multimedia common algorithm configuration
#

menu "Amlogic multimedia algorithm configuration"

config AMLOGIC_MEDIA_COMMON_ALGORITHM
	tristate "amlogic Multimedia Common Algorithm Support"
	default m
	help
		Amlogic multimedia common algorithm include:
		cabc
		aad
		pregm
		hdr10_tmo

if AMLOGIC_MEDIA_COMMON_ALGORITHM
source "drivers/amlogic/algorithm/common/cabc/Kconfig"
source "drivers/amlogic/algorithm/common/aad/Kconfig"
source "drivers/amlogic/algorithm/common/pregm/Kconfig"
source "drivers/amlogic/algorithm/common/hdr10_tmo/Kconfig"
source "drivers/amlogic/algorithm/common/blue_stretch/Kconfig"
source "drivers/amlogic/algorithm/common/cuva/Kconfig"
source "drivers/amlogic/algorithm/common/color_tune/Kconfig"
endif

endmenu
```

## drivers/amlogic/algorithm/common/aad/Kconfig
```kconfig
#
# cabc aad algorithm configuration
#

config AMLOGIC_AAD_ALGORITHM
	tristate "Amlogic AAD Algorithm"
	default m
	depends on AMLOGIC_MEDIA_ENHANCEMENT_VECM
	help
		AAD algorithm
		Configure algorithm for AAD function
```

## drivers/amlogic/algorithm/common/blue_stretch/Kconfig
```kconfig
#
# blue stretch algorithm configuration
#

config AMLOGIC_BLS_ALGORITHM
	tristate "Amlogic BLS Algorithm"
	default m
	depends on AMLOGIC_MEDIA_ENHANCEMENT_VECM
	help
		PREGM algorithm
		Configure algorithm for blue stretch function
```

## drivers/amlogic/algorithm/common/cabc/Kconfig
```kconfig
#
# cabc aad algorithm configuration
#

config AMLOGIC_CABC_ALGORITHM
	tristate "Amlogic CABC Algorithm"
	default m
	depends on AMLOGIC_MEDIA_ENHANCEMENT_VECM
	help
		CABC algorithm
		Configure algorithm for CABC function
```

## drivers/amlogic/algorithm/common/color_tune/Kconfig
```kconfig
#
# blue stretch algorithm configuration
#

config AMLOGIC_COLOR_TUNE_ALGORITHM
	tristate "Amlogic Color Tune Algorithm"
	default m
	depends on AMLOGIC_MEDIA_ENHANCEMENT_VECM
	help
		PREGM algorithm
		Configure algorithm for blue stretch function
```

## drivers/amlogic/algorithm/common/cuva/Kconfig
```kconfig
#
# cuva hdr Algorithm Driver Configuration
#

config AMLOGIC_CUVA_ALGORITHM
	tristate "Amlogic CUVA Algorithm"
	default m
	depends on AMLOGIC_MEDIA_ENHANCEMENT_VECM
	help
		CUVA algorithm
		Configure algorithm for CUVA function
```

## drivers/amlogic/algorithm/common/hdr10_tmo/Kconfig
```kconfig
#
# hdr10_tmo algorithm configuration
#

config AMLOGIC_HDR10_TMO_ALGORITHM
	tristate "Amlogic hdr10_tmo Algorithm"
	default m
	depends on AMLOGIC_MEDIA_ENHANCEMENT_VECM
	help
		HDR10_TMO algorithm
		Configure algorithm for HDR10_TMO function
```

## drivers/amlogic/algorithm/common/pregm/Kconfig
```kconfig
#
# cabc aad algorithm configuration
#

config AMLOGIC_PREGM_ALGORITHM
	tristate "Amlogic PREGM Algorithm"
	default m
	depends on AMLOGIC_MEDIA_ENHANCEMENT_VECM
	help
		PREGM algorithm
		Configure algorithm for PRE GAMMA function
```

## drivers/amlogic/algorithm/dnlp/Kconfig
```kconfig
#
# DNLP Algorithm Driver Configuration
#

config AMLOGIC_DNLP_ALGORITHM
	tristate "Amlogic DNLP Algorithm"
	default m
	depends on AMLOGIC_MEDIA_ENHANCEMENT_VECM
	help
		DNLP algorithm
		Configure algorithm for DNLP function
```

## drivers/amlogic/amaudio2/Kconfig
```kconfig
# AML AUDIO V2 control drivers

menu "Amlogic Audio Interface V2"

config	AMAUDIO2
	bool "Amlogic Audio Interface V2"
	default y
	help
		"Amlogic Audio Interface V2, The interface different from amaudio"

endmenu
```

## drivers/amlogic/aml_debug/Kconfig
```kconfig
# Amlogic DEBUG

config AML_DEBUG
    bool "Amlogic debug support"
    default n
    help
      This is the Amlogic debug sysfs interface driver
```

## drivers/amlogic/aml_hwspinlock/Kconfig
```kconfig
#
# Amlogic hwspinlock device configuration
#

menu "MESON hw spin lock Support"

config AMLOGIC_HWSPINLOCK
	bool "MESON HW SPIN LOCK"
	depends on AMLOGIC_MODIFY
	select HWSPINLOCK
	help
		MESON HWSPIN LOCK.
		.
		.
		.

endmenu
```
