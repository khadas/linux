## Documentation/devicetree/bindings/amlogic/cpuidle.txt
```
Amlogic Cpuidle

Required properties:
 - compatible: must be "amlogic,cpuidle"

 - suspend_power: do suspend power command, should be "0x8200009E"

 - resume_power: do resume power command, should be "0x8200009F"

Examples:

	aml_cpuidle{
		compatible = "amlogic,cpuidle";
		suspend_power = <0x8200009E>;
		resume_power = <0x8200009F>;
	};
```

## Documentation/devicetree/bindings/amlogic/ddr_bandwidth.txt
```
Amlogic DDR bandwidth drvier

This driver is used to measure DDR bandwidth, it can measure total
bandwidth of DDR, also can configure port in each channel and get
detailed bandwidth for each channel.

Required properties for the root node:
 - compatible: one of "amlogic,ddr-bandwidth-m8b"
		      "amlogic,ddr-bandwidth-gx"
		      "amlogic,ddr-bandwidth-gxl"
		      "amlogic,ddr-bandwidth-gxm"
		      "amlogic,ddr-bandwidth-gxlx"
		      "amlogic,ddr-bandwidth-axg"
		      "amlogic,ddr-bandwidth-g12a"
		      "amlogic,ddr-bandwidth-g12b"
		      "amlogic,ddr-bandwidth-txl"
		      "amlogic,ddr-bandwidth-txlx"
		      "amlogic,ddr-bandwidth-txhd"
		      "amlogic,ddr-bandwidth-tm2"
		      "amlogic,ddr-bandwidth-t7"
		      "amlogic,ddr-bandwidth-tl1"
		      "amlogic,ddr-bandwidth-a1"
		      "amlogic,ddr-bandwidth-c1"
		      "amlogic,ddr-bandwidth-t5"
		      "amlogic,ddr-bandwidth-t5d"
		      "amlogic,ddr-bandwidth-s4"
 - reg: address and size of registers controlling bandwidth function

Example:

	ddr_bandwidth {
		compatible = "amlogic,ddr-bandwidth-g12a";
		status = "okay";
		reg = <0xff638000 0x100
		       0xff638c00 0x100>;
		interrupts = <0 52 1>;
		interrupt-names = "ddr_bandwidth";
	};
```

## Documentation/devicetree/bindings/amlogic/dmc_monitor.txt
```
Amlogic DMC PROT drvier

This driver can be used to configure DMC PROT function. It can help
to catch hardware DMA caused memory pollution problems

Required properties for the root node:
 - compatible: one of "amlogic,dmc_monitor-gxl"
		      "amlogic,dmc_monitor-gxm"
		      "amlogic,dmc_monitor-gxlx"
		      "amlogic,dmc_monitor-axg"
		      "amlogic,dmc_monitor-g12a"
		      "amlogic,dmc_monitor-tm2"
		      "amlogic,dmc_monitor-sm1"
		      "amlogic,dmc_monitor-g12b"
		      "amlogic,dmc_monitor-txl"
		      "amlogic,dmc_monitor-txlx"
		      "amlogic,dmc_monitor-txhd"
		      "amlogic,dmc_monitor-t7"
		      "amlogic,dmc_monitor-tl1"
		      "amlogic,dmc_monitor-c1"
		      "amlogic,dmc_monitor-t5"
		      "amlogic,dmc_monitor-t5d"
		      "amlogic,dmc_monitor-s4"

Example:

	dmc_monitor {
		compatible = "amlogic,dmc_monitor-g12a";
		status = "okay";
		reg_base = <0xff639000>;
		interrupts = <0 51 1>;
	};
```

## Documentation/devicetree/bindings/amlogic/ir.txt
```
Amlogic IR remote control driver

This driver is used to configure Amlogic SoC internal IR remote
control decoder.

Required properties:
- compatible: Must be "amlogic, meson-ir".
- protocol: Specify the default protocol.
- map: Specify the map between scancode and keycode.
- customcode: Set customcode for each supported ir remote control.
- release_delay: Key up time when release a key.
- size: number of a map of scancode and keycode.
- keymap: actual key map between scancode and keycode.
- max_frame_time: use to soft decode.

Optional properties:
- status: Shall be "ok" or "okay" if enabled or "disabled" if disabled.
          Default is "ok".

Example:

should use REMOTE_TYPE_* form
<dt-bindings/input/meson_rc.h>

        ir: ir@8040{
		compatible = "amlogic, meson-ir";
		status = "okay";
		protocol = <REMOTE_TYPE_NEC>;
		interrupts = <0 196 IRQ_TYPE_EDGE_RISING>;
		pinctrl-names = "default";
		pinctrl-0 = <&remote_pins>;
		map = <&custom_maps>;
		max_frame_time = <200>;
	}
```

## Documentation/devicetree/bindings/amlogic/rtc.yaml
```yaml
# SPDX-License-Identifier: GPL-2.0-only OR BSD-2-Clause
%YAML 1.2
---
$id: http://devicetree.org/schemas/arm/rtc.yaml#
$schema: http://devicetree.org/meta-schemas/core.yaml#

title: Amlogic Meson RTC device tree bindings


maintainers:
  - Yao Jie <jie.yao@amlogic.com>

properties:
  compatible:
    description: Amlogic A5 board
    items:
      - const: amlogic,meson-rtc
  reg:
    description: physical base address and length of the controller registers
  clock-names:
    description: Must contain "core", "comp"
  clocks:
    description: Phandle of the input clock for RTC timer counter

required:
  - compatible
  - reg
  - clocks
  - clock-names
  - status

examples:
  rtc: rtc@0xfe09a000 {
	compatible = "amlogic,meson-rtc";
	reg = <0x0 0xfe09a000 0x0 0x38>,
	      <0x0 0xfe010288 0x0 0x4>,
	      <0x0 0xfe002010 0x0 0x4>;
	interrupts = <GIC_SPI 131 IRQ_TYPE_EDGE_FALLING>;
	mboxes = <&mhu_fifo A5_REE2AO>;
	status = "okay";
};
```

## Documentation/devicetree/bindings/amlogic/secmon.txt
```
Amlogic Secmon

This driver can be used to configure secure monitor.

Required properties:
 - compatible: must be "amlogic,secmon"
 - memory-region: refer to node<secmon_reserved>
 - reserve_men_size: reserved memory size
 - in_base_func: sip function id
 - out_base_func: sip function id
 - clear_range: bl31 used region

Examples:

	secmom{
		compatible = "amlogic,secmon";
		memory-region = <&secmon_reserved>;
		reserve_mem_size = <0x00300000>;
                in_base_func = <0x82000020>;
                out_base_func = <0x82000021>;
                clear_range = <0x05100000 0x200000>;
	};
```

## Documentation/devicetree/bindings/amlogic/smartcard-sc2.txt
```
Device-Tree bindings for smartcard driver

Required properties:
- compatible: Must be "amlogic,smartcard-sc2".
- interrupts: Smartcard IRQ.
- smc0_clock_source: Smartcard module's clock source selection.
- reset_level: Reset level.
- smc0_det_invert: Invert the DET level.
- pinctrl: Pinmux setting of the smartcard.
- resets: Clock domain of the smartcard.

If you want to use GPIO to replace the DET and RESET pins, the following properties should be set:
- reset_pin: RESET GPIO.
- detect_pin: DETECT GPIO.

If you want to switch 5v/3v by a GPIO, the following properties should be set:
- enable_5v3v_pin: 5v/3v switch GPIO.
- smc0_5v3v_level: 5v/3v GPIO output.

If you want to disable the CLK output when no card inserted, the following properties should be set:
- smc0_clk_pinmux_reg: CLK pinmux register address.
- smc0_clk_pinmux_bit: CLK pinmux bit.
- smc0_clk_oen_reg: CLK GPIO OEN register.
- smc0_clk_out_reg: CLK GPIO output register.
- smc0_clk_bit: CLK GPIO bit.
- smc0_clk_oebit: CLK GPIO OEN bit.;
- smc0_clk_oubit: BLK GPIO output bit.

Example:
	smartcard {
		compatible = "amlogic,smartcard";
		dev_name = "smartcard";
		status = "okay";

		reg = <0x0 0xfe000000 0x0 0x480000>;
		irq_trigger_type = "GPIO_IRQ_LOW";

		reset_pin-gpios = <&gpio GPIOC_3 GPIO_ACTIVE_HIGH>;
		detect_pin-gpios = <&gpio GPIOC_2 GPIO_ACTIVE_HIGH>;
		enable_5v3v_pin-gpios = <&gpio GPIOC_4 GPIO_ACTIVE_HIGH>;
		enable_pin-gpios = <&gpio GPIOC_1 GPIO_ACTIVE_HIGH>;

		interrupts = <0 37 1>;
		interrupt-names = "smc0_irq";
		/*
		 *Smc clock source, if change this,
		 *you must adjust clk and divider in smartcard.c
		 */
		smc0_clock_source = <0>;
		smc0_irq = <37>;		//smc irq
		/*0: high voltage on detect pin indicates card in.*/
		smc0_det_invert = <0>;
		smc0_5v3v_level = <0>;
		/*Ordinarily,smartcard controller needs a enable pin.*/
		smc_need_enable_pin = "yes";
		reset_level = <0>;
		smc0_enable_level = <0>;

		pinctrl-names = "default";
		pinctrl-0 = <&sd_iso7816_pins>;
		clocks = <&clkc CLKID_SC_CLK_GATE>;
		clock-names = "smartcard";
	};
```

## Documentation/devicetree/bindings/amlogic/spi-meson.yaml
```yaml
# SPDX-License-Identifier: GPL-2.0-only OR BSD-2-Clause
%YAML 1.2
---
$id: http://devicetree.org/schemas/arm/spi-meson.yaml#
$schema: http://devicetree.org/meta-schemas/core.yaml#

title: Amlogic Meson SPI slave controller device tree bindings

maintainers:
  - Sunny.luo <sunny.luo@amlogic.com>

properties:
  compatible:
    description: LSI AXM5516 Validation board (Amarillo)
    items:
      - const: amlogic,slave-spicc
  reg:
    description: physical base address and length of the controller registers
  interrupts:
    description: The interrupt specifier
  clock-names:
    description: Must contain "core", "comp"
  clocks:
    description: Phandle of the input clock for the baud rate generator
  pinctrl-names:
    description: Should contain only one value - "default"
  cs-num:
    description: Should be 0~3
  spi-mode:
    description: Refer to spi-summary.txt
  vmem-bus-num:
    description: Should be 0~16
```

## Documentation/devicetree/bindings/amlogic/unifykey.txt
```
Amlogic Unifykey

Required properties:
 - compatible: must be "amlogic,unifykey"

 - status: should be "okay" or "disabled"

 - key_n: property defination of each key, which contains key-name, key-device and key-permit
	 	key-name could be any ascii string within 48 bytes
		key-device must be one of "normal", "secure", "efuse"
		key-permit must be the combination of "read", "write" and "del"

Examples:

	unifykey {
		compatible = "amlogic,unifykey";
		status = "okay";

		key_0{
			key-name = "usid";
			key-device = "normal";
			key-permit = "read", "write", "del";
		};
		key_1{
			key-name = "mac";
			key-device = "normal";
			key-permit = "read", "write", "del";
		};
	};
```

## Documentation/devicetree/bindings/clock/scpi.txt
```
Device Tree Clock bindings for the clocks based on
System Control and Power Interface (SCPI) Message Protocol

This binding uses the common clock binding[1].

Required properties:
- compatible : shall be one of the following:
	"arm,scpi-clks" - for the container node with all the clocks
		based on the SCPI protocol
	"arm,scpi-clk-indexed" - all the clocks that are variable and index
		based. These clocks don't provide the full range between the
		limits but only discrete points within the range. The firmware
		provides the mapping for each such operating frequency and the
		index associated with it.
	"arm,scpi-clk-range" - all the clocks that are variable and provide
		full range within the specified range

Required properties for all clocks(all from common clock binding):
- #clock-cells : ; shall be set to 0 or 1 depending on whether it has single
	or multiple clock outputs.
- clock-output-names : shall be the corresponding names of the outputs.
- clock-indices: The identifyng number for the clocks in the node as expected
	by the firmware. It can be non linear and hence provide the mapping
	of identifiers into the clock-output-names array.
- frequency-range: The allowed range of clock frequency supported specified
	in the form of minimum and maximum limits(two u32 fields)
	This is required only if compatible is "arm,scpi-clk-range"

Clock consumers should specify the desired clocks they use with a
"clocks" phandle cell. Consumers should also provide an additional ID
in their clock property. This ID refers to the specific clock in the clock
provider list.

[1] Documentation/devicetree/bindings/clock/clock-bindings.txt
```

## Documentation/devicetree/bindings/crypto/aml-crypto.txt
```
* Amlogic HW cryptographic accelerators

These are the HW cryptographic accelerators found on Amlogic products.

*For S805 series and S905 series

* Advanced Encryption Standard (AES)

Required properties:
- compatible : Should be "amlogic,aes" for aes-128/192/256
- dev_name : Should be "aml_aes"
- interrupts: Should contain the IRQ line for the AES.
- resets: Should contain the clock to enable the module
- reg:  Should contain the base address of regs

Example:
aml_aes{
	compatible = "amlogic,aes";
	dev_name = "aml_aes";
	interrupts = <0 36 1>;
	resets = <&clock GCLK_IDX_BLK_MOV>;
	reg = <0x0 0xc8832000 0x0 0x2c4
		0x0 0xda832000 0x0 0xe4>;
};

* Triple Data Encryption Standard (Triple DES)

Required properties:
- compatible : Should be "amlogic,des,tdes".
- dev_name : Should be "aml_tdes"
- interrupts: Should contain the IRQ line for the TDES.
- resets: Should contain the clock to enable the module
- reg: Should contain the base address of regs

Example:
aml_tdes{
	compatible = "amlogic,des,tdes";
	dev_name = "aml_tdes";
	interrupts = <0 36 1>;
	resets = <&clock GCLK_IDX_BLK_MOV>;
	reg = <0x0 0xc8832000 0x0 0x2c4
		0x0 0xda832000 0x0 0xe4>;
};

********************************************************************************

* For S905X series and beyond
* S905X series use gxl
* T962X series use txlx
* S905X2 series use g12a

* Dma engine for crypto operations
Required properties:
- compatible : Should be "amlogic,aml_gxl_dma" or "amlogic,aml_txlx_dma"
- reg:  Should contain the base address of regs
- interrupts: Should contain the IRQ line for DMA.

Example:
aml_dma {
	compatible = "amlogic,aml_gxl_dma";
	reg = <0x0 0xff63e000 0x0 0x48>;
	interrupts = <0 180 1>;
};

* Advanced Encryption Standard (AES)

Required properties:
- compatible : Should be "amlogic,aes_dma" for aes-128/192/256
				or "amlogic,aes_g12a_dma" for aes-128/256
- dev_name : Should be "aml_aes_dma"

Example:
aml_aes{
	compatible = "amlogic,aes_dma";
	dev_name = "aml_aes_dma";
};


* Triple Data Encryption Standard (Triple DES)

Required properties:
- compatible : Should be "amlogic,des_dma,tdes_dma" for gxl
				or "amlogic,tdes_dma" for other series.
- dev_name : Should be "aml_tdes_dma"

Example:
aml_tdes{
	compatible = "amlogic,des_dma,tdes_dma";
	dev_name = "aml_tdes_dma";
};
* Secure Hash Algorithm (SHA1/SHA224/SHA256/HMAC)

Required properties:
- compatible : Should be "amlogic,sha_dma".
- dev_name : Should be "aml_sha_dma"

Example:
aml_sha{
	compatible = "amlogic,sha_dma";
	dev_name = "aml_sha_dma";
};
```

## Documentation/devicetree/bindings/meson-global-timer.yaml
```yaml
# SPDX-License-Identifier: (GPL-2.0 OR BSD-2-Clause)
# Copyright 2018 Linaro Ltd.
%YAML 1.2
---

$id: "http://devicetree.org/schemas/meson-global-timer.yaml#"

$schema: "http://devicetree.org/meta-schemas/core.yaml#"

title: Binding details about meson global timer

maintainers:
  - Qianggui Song <Qianggui.Song@amlogic.com>

description: |
  This file is used to depict detils of four blocks of meson global timer

properties:
  compatible:
    oneOf:
      - items:
        - enum:
          - amlogic,meson-glb-timer-core
          - amlogic,meson-glb-timer-isp
          - amlogic,meson-glb-timer-gpio-input
          - amlogic,meson-glb-timer-gpio-output
  reg:
    minItems: 1
    maxItems: 2
    description: output function need 2 regs other need 1.

  reg-names:
    minItems: 1
    maxItems: 2
    description: output function need 2 regs other need 1.

  clock:
    description: Only use in core node.

  clock-names:
    description: Only use in core node.
    items:
      - const: glb_clk

  amlogic,output-source:
    description: use to specify output source and only used in output function

  required:
  - compatible
  - reg
  - reg-names

  examples:
    - |
      gbl_timer_core: global_timer@8e000 {
        compatible = "amlogic,meson-glb-timer-core";
        reg = <0x0 0x8e000 0x0 0x28>;
        reg-names = "topctrl";
        clocks = <&clkc CLKID_SYS_CLK_GLB>;
        clock-names = "glb_clk";
      };
```
