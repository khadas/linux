## Documentation/devicetree/bindings/mfd/rohm,bd2657-pmic.yaml
```yaml
# SPDX-License-Identifier: GPL-2.0-only OR BSD-2-Clause
%YAML 1.2
---
$id: http://devicetree.org/schemas/mfd/rohm,bd2657-pmic.yaml#
$schema: http://devicetree.org/meta-schemas/core.yaml#

title: ROHM BD2657 Power Management Integrated Circuit bindings

maintainers:
  - Matti Vaittinen <matti.vaittinen@fi.rohmeurope.com>

description: |
  The BD2657SWV is a Power Management Integrated Circuit available in
  28pins-USMP028X3527 package and dedicated to application powered by one
  Li-Ion or Li-Ion polymer battery cell, or by an input from 2.85 V to
  5.5 V. The device provides 4 dynamic voltage scaling capable buck
  converters and is designed to support various power requirements. The
  BD2657 also provides two GPOs and a power-button connectivity.

properties:
  compatible:
    const: rohm,bd2657

  reg:
    description:
      I2C slave address.
    maxItems: 1

  interrupts:
    maxItems: 1

  gpio-controller: true

  "#gpio-cells":
    const: 2
    description: |
      The first cell is the pin number and the second cell is used to specify
      flags. See ../gpio/gpio.txt for more information.

  regulators:
    $ref: ../regulator/rohm,bd2657-regulator.yaml
    description:
      List of child nodes that specify the regulators.
  rohm,power-button-connected:
    description: Power-button is connected to PMIC.
    type: boolean

  rohm,output-power-state-gpio:
    description: |
      GPIO0 is used to advertice the PMIC power state and is not used as SW
      controllable GPIO pin.
    type: boolean

  gpio-reserved-ranges:
    description: |
      Usage of BD2657 GPIO0 pin can be changed by the register. Usage of
      the GPIO1 pin depends on OTP. GPIO0 can be used to advertice the
      PMIC power-state and GPIO1 pin may be used as PMIC_EN signal input.
      You should set this property to mark the pins which are not used for GPIO.
      Please see the ../gpio/gpio.txt for more information.

required:
  - compatible
  - reg
  - interrupts
  - regulators

additionalProperties: false

examples:
  - |
    #include <dt-bindings/interrupt-controller/irq.h>
    #include <dt-bindings/leds/common.h>
    i2c {
        #address-cells = <1>;
        #size-cells = <0>;
        pmic: pmic@6a {
            compatible = "rohm,bd2657";
            reg = <0x6a>;

            interrupt-parent = <&gpio1>;
            interrupts = <29 IRQ_TYPE_LEVEL_LOW>;

            gpio-controller;
            #gpio-cells = <2>;
            gpio-reserved-ranges = <0 1>;

            regulators {
                buck1: BUCK1 {
                    regulator-name = "buck1";
                    regulator-min-microvolt = <500000>;
                    regulator-max-microvolt = <2000000>;
                    regulator-ramp-delay = <2500>;
                };
                buck2: BUCK2 {
                    regulator-name = "buck2";
                    regulator-min-microvolt = <500000>;
                    regulator-max-microvolt = <2000000>;
                    regulator-ramp-delay = <2500>;
                };
                buck3: BUCK3 {
                    regulator-name = "buck3";
                    regulator-min-microvolt = <1200000>;
                    regulator-max-microvolt = <2000000>;
                };
                buck4: BUCK4 {
                    regulator-name = "buck4";
                    regulator-min-microvolt = <1000000>;
                    regulator-max-microvolt = <1800000>;
                };
            };
        };
    };
```

## Documentation/devicetree/bindings/misc/khadas-mcu.yaml
```yaml
# SPDX-License-Identifier: (GPL-2.0-only OR BSD-2-Clause)
%YAML 1.2
---

title: Khadas MCU Controller Device Tree Bindings

maintainers:
  - Yan <yan-wyb@foxmail.com>

properties:
  compatible:
    oneOf:
      - const: khadas-mcu
    description:
     This driver is for Khadas MCU.Control fan && WoL, and the power for CPU

required:
  - compatible
  - reg

examples:
  - |
    i2c {
       khadas-mcu {
           compatible = "khadas-mcu";
           reg = <0x18>;
           fan,trig_temp_level0 = <50>;
           fan,trig_temp_level1 = <60>;
           fan,trig_temp_level2 = <70>;
           hwver = "VIM4.V11";
       };
   };
```

## Documentation/devicetree/bindings/pci/amlogic,meson-pcie-ep.txt
```
* Amlogic PCIe endpoint controller

Required properties:
- compatible: Should contain "amlogic, amlogic-pcie-ep" to identify the IP used.
- reg: Should contain the controller register base address and AXI interface
  region base address respectively.
- reg-names: Must be "reg" and "mem" respectively.

Optional properties:
- max-functions: Maximum number of functions that can be configured (default 1).
- phys: From PHY bindings: List of Generic PHY phandles. One per lane if more
  than one in the list.  If only one PHY listed it must manage all lanes.
- phy-names:  List of names to identify the PHY.

Example:

		pcie_ep: pcie-ep@0xe0000000 {
			compatible = "amlogic, amlogic-pcie-ep",
				   "amlogic,amlogic-pcie-ep";
			reg = <0x0 0xe0000000 0x0 0x1000
				0x0 0xfe02c000 0x0 0x2000
				0x0 0xe0000000 0x0 0x10000000
				0x0 0xefe00000 0x0 0x200000
				0x0 0xfe072000 0x0 0x2000
				0x0 0xfe002040 0x0 0x10
				0x0 0xe4000000 0x0 0x8000000>;
			reg-names = "apb-base", "pcictrl-base", "axi-base",
				    "ecam-base", "phy-base", "reset-base",
				    "mem0";
			interrupts = <GIC_SPI 78 IRQ_TYPE_EDGE_RISING>;
			pinctrl-names = "default";
			pinctrl-0 = <&pcieck_pins>;

			clocks = <&clkc CLKID_PCIE_PLL
				&clkc CLKID_SYS_CLK_PCIE
				&clkc CLKID_SYS_CLK_PCIEPHY
				&clkc CLKID_PCIE_HCSL
				&clkc CLKID_PCIE_400M
				&clkc CLKID_PCIE_TL_CLK
				&clkc CLKID_PCIE_CLK>;
			clock-names = "pcie_refpll",
					"pcie",
					"pcie_phy",
					"pcie_hcsl",
					"pcie_400m_clk",
					"pcie_tl_clk",
					"cts_pcie_clk";
			/*reset-gpio-type 0:Shared pad(no reset)1:OD pad2:Normal pad*/
			gpio-type = <2>;
			pcie-m31phy-rst-bit = <21>;
			pcie-gen3-l0-rst-bit = <18>;
			pcie-apb-rst-bit = <14>;
			pcie-phy-rst-bit = <13>;
			pcie-a-rst-bit = <12>;
			pcie-rst-bit = <12>;
			pcie-rst-mask = <0xff>;
			power-domains = <&pwrdm PDID_P1_PCIE>;
			status = "disabled";
		};
```

## Documentation/devicetree/bindings/phy/phy-aml-new-usb2-v2.txt
```
* Amlogic Meson GXL and GXM USB2 PHY binding

Required properties:
- compatible:	Should be "amlogic,meson-gxl-usb2-phy"
- reg:		The base address and length of the registers
- #phys-cells:	must be 0 (see phy-bindings.txt in this directory)

Optional properties:
- clocks:	a phandle to the clock of this PHY
- clock-names:	must be "phy"
- resets:	a phandle to the reset line of this PHY
- reset-names:	must be "phy"
- phy-supply:	see phy-bindings.txt in this directory


Example:
	usb2_phy_v2: usb2phy@ffe09000 {
			compatible = "amlogic,amlogic-new-usb2-v2";
			status = "disable";
			#phy-cells = <0>;
			reg = <0x0 0xffe09000 0x0 0x80
				0x0 0xffd01008 0x0 0x100
				0x0 0xff636000 0x0 0x2000
				0x0 0xff63a000 0x0 0x2000>;
			resets = <&reset RESET_USB>,
					<&reset RESET_USB_PHY20>,
					<&reset RESET_USB_PHY21>;
			reset-names = "usb", "phy20", "phy21";
			clocks = <&xtal>;
			clock-names = "xtal";
			pll-setting-1 = <0x09400414>;
			pll-setting-2 = <0x927E0000>;
			pll-setting-3 = <0xac5f69e5>;
			pll-setting-4 = <0xfe18>;
			pll-setting-5 = <0x8000fff>;
			pll-setting-6 = <0x78000>;
			pll-setting-7 = <0xe0004>;
			pll-setting-8 = <0xe000c>;
			version = <2>;
			pwr-ctl = <1>;
			u2-ctrl-sleep-shift = <17>;
			u2-hhi-mem-pd-shift = <30>;
			u2-hhi-mem-pd-mask = <0x3>;
			u2-ctrl-iso-shift = <17>;
			phy20-reset-level-bit = <16>;
			phy21-reset-level-bit = <17>;
			usb-reset-bit = <2>;
		};
```

## Documentation/devicetree/bindings/phy/phy-aml-new-usb3-v2.txt
```
* Amlogic Meson GXL and GXM USB3 PHY and OTG detection binding

Required properties:
- compatible:	Should be "amlogic,meson-gxl-usb3-phy"
- #phys-cells:	must be 0 (see phy-bindings.txt in this directory)
- reg:		The base address and length of the registers
- interrupts:	the interrupt specifier for the OTG detection
- clocks:	phandles to the clocks for
		- the USB3 PHY
		- and peripheral mode/OTG detection
- clock-names:	must contain "phy" and "peripheral"
- resets:	phandle to the reset lines for:
		- the USB3 PHY and
		- peripheral mode/OTG detection
- reset-names:	must contain "phy" and "peripheral"

Optional properties:
- phy-supply:	see phy-bindings.txt in this directory


Example:
	usb3_phy_v2: usb3phy@ffe09080 {
			compatible = "amlogic,amlogic-new-usb3-v2";
			status = "disable";
			clocks = <&clkc CLKID_PCIE_PLL>;
			clock-names = "pcie_refpll";
			#phy-cells = <0>;
			reg = <0x0 0xffe09080 0x0 0x20
					0x0 0xffd01008 0x0 0x100>;
			phy-reg = <0xff646000>;
			phy-reg-size = <0x2000>;
			usb2-phy-reg = <0xffe09000>;
			usb2-phy-reg-size = <0x80>;
			interrupts = <GIC_SPI 16 IRQ_TYPE_LEVEL_HIGH>;
			pwr-ctl = <1>;
			u3-ctrl-sleep-shift = <18>;
			u3-hhi-mem-pd-shift = <26>;
			u3-hhi-mem-pd-mask = <0xf>;
			u3-ctrl-iso-shift = <18>;
		};
```

## Documentation/devicetree/bindings/power/amlogic,power_domain.txt
```
Amlogic power domain controller
==============================

The Amlogic Meson SoCs embeds an internal Power domain controller.

Power Domain
----------------

There are many power domains  controlled by this power controller.


The bindings must respect the power domain bindings as described in the file
power_domain.txt

Device Tree Bindings:
---------------------

Required properties:
- compatible:

Example:
-------

pwrdm: power-domains {
	compatible = "amlogic,tm2-power-domain";
	status = "okay";
};

pwrdm: power-domains {
	compatible = "amlogic,sm1-power-domain";
	status = "okay";
};
```

## Documentation/devicetree/bindings/power/supply/bq2570x.yaml
```yaml
# SPDX-License-Identifier: (GPL-2.0-only OR BSD-2-Clause)
%YAML 1.2
---

title: Battery driver for CW2015 shuntless fuel gauge by CellWise.

maintainers:
  - Yan <yan-wyb@foxmail.com>

description: |
  This driver will support the bq2570x and the bq25700. There are other ICs
  in the same family but those have not been tested.


properties:
  compatible:
    const: bq25703

  reg:
    maxItems: 1

  cellwise,battery-profile:
    description: |
      This property specifies characteristics of the battery used. The format
      of this binary blob is kept secret by CellWise. The only way to obtain
      it is to mail two batteries to a test facility of CellWise and receive
      back a test report with the binary blob.
    $ref: /schemas/types.yaml#/definitions/uint8-array
    minItems: 64
    maxItems: 64

  cellwise,monitor-interval-ms:
    description:
      Specifies the interval in milliseconds gauge values are polled at
    minimum: 250

  power-supplies:
    description:
      Specifies supplies used for charging the battery connected to this gauge
    $ref: /schemas/types.yaml#/definitions/phandle-array
    minItems: 1
    maxItems: 8 # Should be enough

  monitored-battery:
    description:
      Specifies the phandle of a simple-battery connected to this gauge
    $ref: /schemas/types.yaml#/definitions/phandle

required:
  - compatible
  - reg

additionalProperties: false

examples:
  - |
    i2c {
        #address-cells = <1>;
        #size-cells = <0>;

		bq25703@6b {
			compatible = "bq25703";
			reg = <0x6b>;
			ti,charge-current = <1500000>;
			ti,max-charge-voltage = <8500000>;
			ti,max-input-voltage = <20000000>;
			ti,max-input-current = <6000000>;
			ti,input-current-sdp = <500000>;
			ti,input-current-dcp = <2000000>;
			ti,input-current-cdp = <2000000>;
			ti,input-current-dc = <2000000>;
			ti,minimum-sys-voltage = <7400000>;
			ti,otg-voltage = <5000000>;
			ti,otg-current = <500000>;
			ti,input-current = <500000>;
			pd-charge-only = <0>;
		};

    };
```

## Documentation/devicetree/bindings/regulator/tps62864-regulator.txt
```
TPS62864 Voltage regulators

Required properties:
- compatible: Must be one of the following.
	"ti,tps62864"
	"ti,tps62866",
- reg: I2C slave address

Optional properties:

- ti,enable-vout-discharge: Enable output discharge. This is boolean value.

- ti,vout-reg-id: 0 ~ 1. VOUT register number.
  TPS628640AYCG, TPS628660AYCG:
  	VSET/VID:
  		ti,vout-reg-id = <0> if this pin is pulled low
  		ti,vout-reg-id = <1> if this pin is pulled high
  TPS628640BYCG, TPS628660BYCG, TPS628640DYCG, TPS628660DYCG
  	VSET/PG:  ti,vout-reg-id = <0>

Any property defined as part of the core regulator binding, defined in
regulator.txt, can also be used.

Example:

	tps62864: tps62864@40 {
		compatible = "ti,tps62864";
		reg =  <0x40>;
		regulator-name = "tps62864-regulator";
		regulator-min-microvolt = <400000>;
		regulator-max-microvolt = <1675000>;
		regulator-boot-on;
		ti,vout-reg-id = <0>;
		ti,enable-vout-discharge;
	};
```

## Documentation/devicetree/bindings/soc/amlogic/clk-measure.txt
```
Amlogic Internal Clock Measurer
===============================

The Amlogic SoCs contains an IP to measure the internal clocks.
The precision is multiple of MHz, useful to debug the clock states.

Required properties:
- compatible: Shall contain one of the following :
			"amlogic,meson-gx-clk-measure" for GX SoCs
			"amlogic,meson8-clk-measure" for Meson8 SoCs
			"amlogic,meson8b-clk-measure" for Meson8b SoCs
			"amlogic,meson-axg-clk-measure" for AXG SoCs
			"amlogic,meson-g12a-clk-measure" for G12a SoCs
			"amlogic,meson-sm1-clk-measure" for SM1 SoCs
			"amlogic,meson-sc2-clk-measure" for SC2 SoCs
			"amlogic,meson-tm2-clk-measure" for TM2 SoCs
			"amlogic,meson-t5d-clk-measure" for T5D SoCs
			"amlogic,meson-t7-clk-measure" for T7 SoCs
			"amlogic,meson-s4-clk-measure" for S4 SoCs
- reg: base address and size of the Clock Measurer register space.

Example:
	clock-measure@8758 {
		compatible = "amlogic,meson-gx-clk-measure";
		reg = <0x0 0x8758 0x0 0x10>;
	};
```

## Documentation/devicetree/bindings/sound/ESMT,ad82128.txt
```
ESMT - AD82128 Codec module

The AD82128 serial control bus communicates through I2C protocols

Required properties:
- compatible: Should be "ESMT,ad82128"
- reg: I2C slave address
- reset_pin: reset gpio

Example:
ad82128_30: ad82128_30@30 {
	compatible = "ESMT,ad82128";
	#sound-dai-cells = <0>;
	reg = <0x30>;
	reset_pin = <&gpio_ao GPIOAO_4 GPIO_ACTIVE_LOW>;
	status = "okay";
};
```

## Documentation/devicetree/bindings/sound/tas5805m.yaml
```yaml
# SPDX-License-Identifier: (GPL-2.0+ OR BSD-2-Clause)
%YAML 1.2
---
$id: http://devicetree.org/schemas/sound/tas5805m.yaml#
$schema: http://devicetree.org/meta-schemas/core.yaml#

title: TI TAS5805m Stereo Audio amplifier Device Tree Bindings

maintainers:
  - Chen-Yu Tsai <wens@csie.org>
  - Maxime Ripard <maxime.ripard@bootlin.com>

properties:
  compatible:
    const: ti,tas5805m_0
    const: ti,tas5805m_1

  "#sound-dai-cells":
    const: 0

  reg:
    maxItems: 1

  gpio:
    items:
      - description: ap
      - description: reset

examples:
  - |
    tas5805m: tas5805m@2d {
        compatible = "ti,tas5805m_0";
        #sound-dai-cells = <0>;
        reg = <0x2d>;
        reset-gpio = <&gpio GPIOW_12 0>;
        power-gpio = <&gpio GPIOW_17 0>;
        speaker-config = <0>;
        status = "okay";
    };

...
```
