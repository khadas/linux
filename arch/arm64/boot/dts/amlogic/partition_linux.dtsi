// SPDX-License-Identifier: (GPL-2.0+ OR MIT)
/*
 * Copyright (c) 2022 Wesion, Inc. All rights reserved.
 */
/ {
    partitions: partitions{
		parts = <1>;
		part-0 = <&rootfs>;

		rootfs:rootfs
		{
			pname = "rootfs";
			size = <0xffffffff 0xffffffff>;
			mask = <4>;
		};
	};
};/* end of / */
