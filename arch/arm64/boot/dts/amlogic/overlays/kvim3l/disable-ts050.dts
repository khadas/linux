/dts-v1/;
/plugin/;

/ {
	fragment@0 {
		target = <&lcd>;

		__overlay__ {
			status = "disabled";
		};
	};

	fragment@1 {
		target = <&backlight>;

		__overlay__ {
			status = "disabled";
		};
	};
};
