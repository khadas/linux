/dts-v1/;
/plugin/;

/ {
 	fragment@0 {
 		target = <&onewire>;

 		__overlay__ {
 			status = "okay";
 		};
 	};

 	fragment@1 {
 		target = <&spicc1>;

 		__overlay__ {
 			status = "disabled";
 		};
 	};

 	fragment@2 {
 		target = <&uart_C>;

 		__overlay__ {
 			status = "disabled";
 		};
 	};

};
