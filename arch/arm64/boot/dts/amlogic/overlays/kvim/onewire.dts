/dts-v1/;
/plugin/;

/ {
 	fragment@0 {
 		target = <&onewire>;

 		__overlay__ {
 			status = "okay";
 		};
 	};

 	fragment@1 {
 		target = <&uart_AO_B>;

 		__overlay__ {
 			status = "disabled";
 		};
 	};

};
