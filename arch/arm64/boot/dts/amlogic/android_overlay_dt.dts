// SPDX-License-Identifier: (GPL-2.0+ OR MIT)
/*
 * Copyright (c) 2019 Amlogic, Inc. All rights reserved.
 */

/dts-v1/;
/plugin/;

/ {
	fragment@0 {
		//target = <&some_node>;
		target-path="/";
		__overlay__ {
			dummy-battery {
				compatible = "amlogic, dummy-battery";
				status = "okay";
			};
		};
	};

	fragment@1 {
		//target = <&some_node>;
		target-path="/";
		__overlay__ {
			dummy-charger {
				compatible = "amlogic, dummy-charger";
				status = "okay";
			};
		};
	};
};
