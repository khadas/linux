// SPDX-License-Identifier: (GPL-2.0+ OR MIT)
/*
 * Copyright (c) 2021 Rockchip Electronics Co., Ltd.
 *
 */

/dts-v1/;

#include "rk3588-toybrickb-x0.dtsi"
#include "rk3588-linux.dtsi"
#include "rk3588-toybrickb-gc8034-csi1.dtsi"
#include "rk3588-toybrickb-gc8034-csi2.dtsi"
#include "rk3588-toybrickb-dsi1.dtsi"

/ {
	model = "Rockchip RK3588 Toybrick B0 Board";
	compatible = "rockchip,rk3588-toybrickb-x0-linux", "rockchip,rk3588";
};
