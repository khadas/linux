// SPDX-License-Identifier: (GPL-2.0+ OR MIT)
/*
 * Copyright (c) 2021 Rockchip Electronics Co., Ltd.
 *
 */

/dts-v1/;

#include "rk3588-toybrick-x0.dtsi"
#include "rk3588-linux.dtsi"
//#include "rk3588-toybrick-imx258.dtsi"
/ {
	model = "Rockchip RK3588 TOYBRICK X10 Board";
	compatible = "rockchip,rk3588-toybrick-x10-linux", "rockchip,rk3588";
};

&rockchip_suspend {
	rockchip,sleep-mode-config = <
		(0
		| RKPM_SLP_ARMOFF_DDRPD
		| RKPM_SLP_PMU_PMUALIVE_32K
		| RKPM_SLP_PMU_DIS_OSC
		| RKPM_SLP_32K_EXT
		| RKPM_SLP_PMU_DBG
		)
	>;
};

&vdd_log_s0 {
	regulator-state-mem {
	regulator-on-in-suspend;
		regulator-suspend-microvolt = <750000>;
	};
};


