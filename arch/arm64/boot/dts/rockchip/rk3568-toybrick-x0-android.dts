// SPDX-License-Identifier: (GPL-2.0+ OR MIT)
/*
 * Copyright (c) 2020 Rockchip Electronics Co., Ltd.
 *
 */
/dts-v1/;
#include "rk3568.dtsi"
#include "rk3568-android.dtsi"
#include "rk3568-toybrick-x0.dtsi"
/ {
	compatible = "rockchip,rk3568-toybrick-dev-android-x0","rockchip,rk3568";
};

