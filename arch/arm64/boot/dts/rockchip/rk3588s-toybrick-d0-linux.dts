// SPDX-License-Identifier: (GPL-2.0+ OR MIT)
/*
 * Copyright (c) 2021 Rockchip Electronics Co., Ltd.
 *
 */

/dts-v1/;

#include "rk3588s-toybrick-d0.dtsi"
#include "rk3588-linux.dtsi"
//#include "rk3588s-toybrick-d0-imx258.dtsi"

/ {
	model = "Rockchip RK3588s Toybrick D0 Board";
	compatible = "rockchip,rk3588s-toybrick-d0-linux", "rockchip,rk3588";
};
&chosen {
	bootargs = "earlycon=uart8250,mmio32,0xfeb50000 console=ttyFIQ0 irqchip.gicv3_pseudo_nmi=0 root=/dev/mmcblk1p2 rw rootwait mtdparts=sfc_nor:0x000a0000@0x000a0000(vnvm),0x00200000@0x00140000(uboot)";
};
